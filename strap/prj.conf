## CMakeLists.txt
```
cmake_minimum_required(VERSION 3.20.0)

# RadiANT heart-rate strap: a node, not a dongle. See src/main.c for why it
# exists and Kconfig for what it is allowed to do.
#
# UNLIKE sim/, THIS NEEDS NO sdk-ant AT ALL. sim/ is built entirely out of
# sdk-ant's profile libraries and its radio, and says so in a FATAL_ERROR;
# this one is built out of radiant and radiant/src/profiles/, both
# of which are in this repository. That is the whole point of it: it is the
# first image where
# the clean-room stack transmits as a master with a real ANT+ profile on top,
# and a dependency on the proven stack would defeat the demonstration.
#
# radiant is appended unconditionally and its backend chosen with
# -DRADIANT_BACKEND, exactly as the root CMakeLists.txt does - both now
# through the shared cmake/radiant_backend.cmake, included below. The
# duplication of *calling* it (rather than sharing one CMakeLists.txt) is
# deliberate and matches sim/'s note: `west build strap` must not depend on
# the dongle's build files existing or being current.
#
# THE DEFAULT IS nrf AND NOT null, and the asymmetry with radiant's own
# CMake default is the same one scripts/build_all.ps1 documents: null is right
# for a compile check and wrong for a script whose job is producing images
# somebody flashes. A null-radio strap boots, logs "transmitting", and puts
# nothing on the air - indistinguishable from a dead antenna, and it has cost
# this project a Feather flash and a whole session once already.
include("${CMAKE_CURRENT_SOURCE_DIR}/../cmake/radiant_backend.cmake")
radiant_select_backend("${CMAKE_CURRENT_SOURCE_DIR}/../radiant" "nrf" RADIANT_BACKEND_CONF)

set(strap_backend_conf "${CMAKE_CURRENT_BINARY_DIR}/strap_backend.conf")
file(WRITE "${strap_backend_conf}"
"# Generated by strap/CMakeLists.txt from -DRADIANT_BACKEND. Do not edit.
CONFIG_RADIANT=y
CONFIG_RADIANT_ANTR_API=y
${RADIANT_BACKEND_CONF}
")
list(APPEND EXTRA_CONF_FILE "${strap_backend_conf}")

find_package(Zephyr REQUIRED HINTS $ENV{ZEPHYR_BASE})
project(radiant_strap)

# The backend actually compiled is the backend that was asked for.
#
# radiant_assert_backend(), shared with the top-level CMakeLists.txt - see
# cmake/radiant_backend.cmake for the full rationale. What it guards against
# is a Kconfig `depends on` going silently unmet, falling back to the null
# backend: a null-radio strap boots, logs "transmitting", and puts nothing on
# the air. It has happened twice on the Nordic side, and is more likely on TI,
# where the cc26xx arm has to depend on SOC_SERIES_CC13X2_CC26X2 because no
# SOC_COMPATIBLE_* symbol exists for the part.
radiant_assert_backend("strap")

target_sources(app PRIVATE src/main.c)

# ── The antr_* adapter ──────────────────────────────────────────────────────
#
# ../src/ant_radio_radiant.c (radiant_api.c, before it moved out of
# radiant) is what actually implements antr_init() and the rest of
# src/ant_radio.h on top of radiant's modules - CONFIG_RADIANT=y
# alone no longer pulls it in, since it is application-side now (see
# src/Kconfig.antr_api). strap_backend_conf above forces
# CONFIG_RADIANT_ANTR_API=y unconditionally, so this is never
# conditional in practice, but target_sources_ifdef() is used anyway to match
# the root CMakeLists.txt exactly and to fail at configure rather than at
# link if that ever changes.
target_sources_ifdef(CONFIG_RADIANT_ANTR_API app PRIVATE
  ../src/ant_radio_radiant.c)
target_sources_ifdef(CONFIG_RADIANT_SEC_HOST_MESSAGES app PRIVATE
  ../src/ant_sec_host.c)

# ── radiant/src/profiles ───────────────────────────────────────────────
#
# THE FIRST NON-TEST CONSUMER OF THESE FILES. Until this application they were
# compiled only by radiant/tests/CMakeLists.txt, so every profile in the
# project had only ever run inside a unit test. Nothing in them needed changing
# to run for real, which is the claim this build makes and the reason it is
# worth making.
#
# WHAT THE LINKER SAYS IS NEEDED, WHICH IS MORE THAN THE PAGE NEEDS.
#
# The first four are the heart-rate page itself. The other two are pulled in by
# the seam rather than by the profile: profile_sched.c's slot rotation calls
# into profile_schedule.c to encode the descriptor, and profile_hr_next() calls
# profile_compat_next() unconditionally - the compat client is a *seam*, and
# whether it emits anything is a run-time question of whether a compat context
# was attached, not a compile-time one. This application attaches none, so
# profile_hr_set_compat() is never called and the strap stays a plain ANT+ 0x78
# sensor on the air.
#
# That distinction matters for P8b specifically. A strap being used to measure
# BLE coexistence must broadcast exactly what a commercial strap broadcasts;
# adding RadiANT beacon and attestation pages would change the airtime being
# measured, which is the one thing the phase is for. So the compat layer is
# LINKED and INERT, and the enrolment, private-mode, adaptive-frequency and
# command layers are not linked at all - they join when there is a reason.
target_sources(app PRIVATE
  ../radiant/src/profiles/profile_bits.c
  ../radiant/src/profiles/profile_common.c
  ../radiant/src/profiles/profile_sched.c
  ../radiant/src/profiles/profile_hr.c
  ../radiant/src/profiles/profile_schedule.c
  ../radiant/src/profiles/profile_compat.c
  ../radiant/src/profiles/profile_telemetry.c
  ../radiant/src/profiles/profile_handoff.c
)
target_include_directories(app PRIVATE ../radiant/src/profiles)

# ── radiant/src/node ───────────────────────────────────────────────────
#
# A LIBRARY, NOT AN APPLICATION - the plan's words, and the reason it can be
# linked here at all. The identity record decides the device number under
# ADR 0009, and the settings-backed NVM implementation is the one the dongle
# already uses.
target_sources(app PRIVATE
  ../radiant/src/node/node_ident.c
  ../radiant/src/node/node_nvm_settings.c
)
target_include_directories(app PRIVATE ../radiant/src/node)

# The antr_* declarations and the ANT wire constants. src/ is the application
# layer of the dongle, but these two headers are the interface radiant
# implements rather than anything dongle-specific.
target_include_directories(app PRIVATE ../src)

if(CONFIG_STRAP_BLE_HRS)
  target_sources(app PRIVATE src/strap_ble.c)
endif()
```

## Kconfig
```
#
# RadiANT heart-rate strap.
#
# One prefix for the whole application, STRAP_*, the same way the dongle uses
# ANT_DONGLE_* and the simulator uses ANT_SIM_*. The three never build together,
# but a shared prefix would make "which application does this symbol belong to"
# ambiguous, and the answer to that question is how the CI assertions stay
# honest.
#

rsource "../radiant/src/node/Kconfig"
rsource "../radiant/src/profiles/Kconfig"
rsource "../src/Kconfig.antr_api"

source "Kconfig.zephyr"

menuconfig STRAP
	bool "RadiANT heart-rate strap"
	default y
	help
	  A RadiANT NODE: radiant driving a master channel with
	  src/profiles/profile_hr.c on top, broadcasting ANT+ heart rate
	  (device type 0x78). No USB and no serial bridge - this is not a
	  dongle, and the only host interface is the log.

	  It exists for P8 of the multiprotocol plan: the BLE coexistence work
	  needs a node whose ANT+ side is a master, because a master owns its
	  slot phase and a slave does not, and what happens to a transmit
	  schedule under an arbiter is the whole question.

if STRAP

config STRAP_DEVICE_NUMBER
	int "ANT device number when the node is not provisioned"
	range 1 65535
	default 4242
	help
	  Used only when src/node/ has no identity record. A provisioned node
	  takes its device number from that record instead, which is what
	  ADR 0009 requires - the number is a property of the node's identity,
	  not of the image. The fallback keeps a freshly-flashed DK usable on a
	  bench without a provisioning step.

config STRAP_HR_BPM
	int "simulated heart rate, beats per minute"
	range 30 220
	default 72
	help
	  A DK has no electrodes. The beat generator produces beats at this
	  rate so the page 0 event count and event time - the fields that
	  actually survive a lost packet - advance the way a real strap's do.

config STRAP_MANUFACTURER_ID
	int "manufacturer id for the common pages"
	range 0 255
	default 255
	help
	  255 is the ANT+ development id. A shipped strap needs a real one from
	  the alliance; using it here would be claiming somebody else's.

config STRAP_BLE_HRS
	bool "also advertise the SIG Heart Rate Service over BLE"
	depends on BT && BT_PERIPHERAL
	select BT_HRS
	help
	  P8b: the SoftDevice Controller beside the ANT+ master, advertising
	  the standard SIG Heart Rate Service, so that one strap serves both a
	  phone and an ANT+ receiver.

	  THE CONNECTION AND ADVERTISING INTERVALS ARE THE PRIORITY MECHANISM,
	  not a power tuning. Finding 1 of the plan: MPSL's two
	  application-visible priorities rank us against ourselves and not
	  against the Bluetooth controller, which outranks anything an
	  application can request. So RadiANT keeps its slots by SHAPING the
	  other stack's demand, exactly as nrf/samples/esb/esb_ptx_ble does
	  with a 1 s connection interval.

config STRAP_BLE_ADV_INTERVAL_MS
	int "BLE advertising interval, milliseconds"
	depends on STRAP_BLE_HRS
	range 100 10000
	default 1000
	help
	  1-2 s is what the plan specifies for the strap. Shortening it is not
	  a power trade, it is a decision to take air away from ANT+, and the
	  coexistence gate is what says whether it can be afforded.

config STRAP_BLE_MIN_CONN_INTERVAL_UNITS
	int "shortest connection interval to accept, 1.25 ms units"
	depends on STRAP_BLE_HRS
	range 6 3200
	default 800
	help
	  800 units is 1 s, which is what nrf/samples/esb/esb_ptx_ble uses to
	  run BLE beside a timeslot user, and it is chosen for the same reason.
	  A phone will ask for far less - iOS asks for tens of milliseconds -
	  and accepting hands the controller a recurring high-priority event
	  every few milliseconds for the life of the connection. MPSL gives the
	  controller priority levels above anything this application can
	  request, so that air is simply gone; refusing the update is the only
	  place the decision can be made.

config STRAP_SUPPRESS_ANT_WHEN_CONNECTED
	bool "stop ANT+ while a BLE connection is live"
	depends on STRAP_BLE_HRS
	default y
	help
	  P9's suppression rule, as policy above the link layer: a phone that
	  has connected is receiving the same heart rate over the SIG service,
	  so continuing to broadcast ANT+ spends air on a duplicate - and it
	  means the hard contention case never normally arises at all.

	  Turn it off for the minority-manufacturer behaviour, where straps
	  keep transmitting ANT+ while connected so a watch and a phone can be
	  served at once. That configuration is the one the coexistence gate
	  actually stresses.

module = STRAP
module-str = strap
source "subsys/logging/Kconfig.template.log_config"

endif # STRAP
```

## prj.conf
```kconfig
# RadiANT heart-rate strap.
#
# Nothing here is shared with the dongle's prj.conf on purpose, and for the same
# reason sim/ says it: this build has no USB, no serial bridge and no
# partition-manager constraints. It is a sensor. What it does share with the
# dongle - and sim/ does not - is the whole radio stack, because that is the
# point of the application.

CONFIG_STRAP=y

# radiant_core and its antr_* adapter. The backend itself comes from
# -DRADIANT_BACKEND via the generated fragment in CMakeLists.txt, so that a
# null-radio build is a deliberate choice rather than a default nobody noticed.
CONFIG_RADIANT_CORE=y
CONFIG_RADIANT_CORE_ANTR_API=y

# The identity record and its storage. ADR 0009 makes the device number a
# property of the node rather than of the image, and settings-backed NVM is the
# same implementation the dongle uses.
#
# RADIANT_SEC is not optional here and not a feature choice: src/node/Kconfig
# says `depends on RADIANT_SEC` because everything in node_ident derives keys,
# down to the boot counter's epoch. A strap without it is a strap with no
# identity, which is the one thing ADR 0009 says a node must have.
CONFIG_RADIANT_SEC=y
CONFIG_RADIANT_NODE_IDENT=y
CONFIG_RADIANT_NODE_NVM_SETTINGS=y
CONFIG_SETTINGS_NVS=y

CONFIG_HEAP_MEM_POOL_SIZE=2048

# Logs out the DK's first VCOM. Not RTT: RTT needs SEGGER's JLinkARM DLL
# installed, whereas the VCOM is carried by the cable that already programs the
# board.
CONFIG_LOG=y
CONFIG_LOG_MODE_DEFERRED=y
CONFIG_SERIAL=y
CONFIG_CONSOLE=y
CONFIG_UART_CONSOLE=y
CONFIG_LOG_BACKEND_UART=y

# Halt on a fault rather than rebooting into it. A sensor that resets in a loop
# still transmits between resets, which reads as an intermittent radio fault
# from the receiving end - the most expensive kind of symptom to chase, and one
# this project has already paid for twice.
CONFIG_RESET_ON_FATAL_ERROR=n
CONFIG_THREAD_NAME=y
```

## strap_ble.conf
```kconfig
# P8b: enable the BLE HRS branch on top of the ANT+ master build.
#
# Passed with -Dstrap_EXTRA_CONF_FILE=strap_ble.conf (image-scoped, per the
# root CMakeLists.txt's note on sysbuild EXTRA_CONF_FILE resolution: a plain
# -DEXTRA_CONF_FILE= lands in the sysbuild cache and never reaches the image).

CONFIG_STRAP_BLE_HRS=y
CONFIG_BT=y
CONFIG_BT_PERIPHERAL=y
# The name a phone, Zwift, or a BLE scanner shows for this node. It is a
# simulated heart rate monitor, so it is named as one - "RadiANT HR", not
# "RadiANT Strap". strap_ble.c puts this same string in the advertising
# payload (BT_DATA_NAME_COMPLETE), so it is visible in a scan list without
# connecting first.
CONFIG_BT_DEVICE_NAME="RadiANT HR"

# radiant/Kconfig: RADIANT_BACKEND_NRF's choice entry carries
# `depends on !BT || RADIANT_BACKEND_NRF_GATE_MPSL`. CONFIG_BT=y above
# breaks the first half, so without this the choice silently falls back to
# RADIANT_BACKEND_NULL - an image that enumerates, answers the host, and
# transmits nothing, with the fallback buried in a warning among a hundred
# others. This IS the arbitrated build P8b needs anyway: a strap advertising
# BLE HRS beside an ANT+ master is exactly the case the gate exists for.
CONFIG_RADIANT_BACKEND_NRF_GATE_MPSL=y
CONFIG_MPSL_TIMESLOT_SESSION_COUNT=1
```

## boards/nrf54l15dk_nrf54l15_cpuapp.overlay
```dts
/*
 * nRF54L15 DK, as a RadiANT strap.
 *
 * Deliberately NOT a copy of the dongle's overlay. That one's whole subject is
 * the ANT serial transport on the second VCOM - `aliases { ant-uart = &uart30 }`
 * and `&uart30 { status = "okay" }` - and a strap has no transport at all. It is
 * a sensor: the only thing leaving the board is the log on the console UART,
 * which the board's own devicetree already provides.
 *
 * What IS shared is the one line radiant's nrf backend cannot start
 * without.
 */

/ {
	chosen {
		/*
		 * The TIMER the backend owns outright. It runs at 1 MHz forever
		 * and is what t_sync is hardware-captured into from RADIO's
		 * ADDRESS event, so it cannot be shared - naming it here rather
		 * than in the source is what makes a second user a devicetree
		 * conflict instead of two drivers reprogramming each other's
		 * prescaler.
		 *
		 * timer20 is free on this board, and is `status = "disabled"`
		 * by default like every TIMER on this SoC. An unclocked
		 * peripheral is not addressable, which the backend found once
		 * by taking a bus fault on its first register write.
		 *
		 * ⚠ IT IS ALSO WHAT P0's TIMER AUDIT WAS ABOUT. mpsl.rst lists
		 * MPSL as owning TIMER10 *and* TIMER20 on nRF54L, while
		 * mpsl_hwres.h reserves only TIMER10. Measured: TIMER20 does not
		 * collide, and TIMER22 behaves identically. If a future MPSL
		 * revision does claim it, this is the line that moves, and
		 * mpsl_init.c's BUILD_ASSERTs will say so loudly rather than
		 * letting it fail on the air.
		 */
		radiant,radio-timer = &timer20;
	};
};

&timer20 {
	status = "okay";
};
```

## src/main.c
```c
/*
 * SPDX-License-Identifier: Apache-2.0
 *
 * RadiANT heart-rate strap: a NODE, not a dongle. P8a of the multiprotocol
 * plan - the first image where radiant_core transmits as an ANT+ master
 * with a real profile on top, rather than a dongle bridge.
 *
 * P8b pairs this with a SoftDevice Controller advertising the SIG Heart
 * Rate Service while ANT+ 0x78 keeps broadcasting, testing coexistence on
 * a MASTER channel (a dongle, as a slave, can't stand in for this - a
 * master owns its slot phase). P9 adds the suppression rule on top.
 *
 * No USB/serial bridge: the dongle app is a transparent bridge with no
 * profile logic; this is the opposite shape. The log is the only host
 * interface.
 */

#include <zephyr/kernel.h>
#include <zephyr/logging/log.h>

#include "ant_radio.h"
#include "ant_wire.h"
#include "profile_hr.h"
#include "node_ident.h"

#if defined(CONFIG_STRAP_BLE_HRS)
#include "strap_ble.h"
#endif

LOG_MODULE_REGISTER(strap, CONFIG_STRAP_LOG_LEVEL);

/*
 * The public ANT+ network key, used by every ANT+ device on the air - not
 * the stack licence key (an sdk-ant concept radiant_core doesn't have).
 * Confusing the two produces a node that runs and is heard by nothing.
 */
static const uint8_t ant_plus_key[8] = {
	0xB9, 0xA5, 0x21, 0xFB, 0xBD, 0x72, 0xC3, 0x45
};

/*
 * ANT+ Heart Rate Monitor, device type 0x78. The period is the profile's, not a
 * choice: 8070 counts of 32768 Hz is 4.06 Hz, and a receiver that has been told
 * 8070 will not find a strap transmitting at anything else.
 */
#define HR_DEVICE_TYPE   0x78u
#define HR_PERIOD_COUNTS 8070u
#define HR_RF_FREQ       57u
#define HR_CHANNEL       0u
#define HR_NETWORK       0u

static struct profile_hr hr;

/*
 * A beat generator rather than a bpm setting: profile_hr's page 0 carries
 * an event count and event time, the fields that survive a lost packet, so
 * only a real generator exercises those - a node that just set a computed
 * bpm would be testing the field that doesn't matter.
 */
#define BEAT_TICK_MS 100u

static uint16_t event_time_1024(void)
{
	/* 1/1024 s, wrapping at 16 bits (ANT+ common time base). ms * 1024 /
	 * 1000 rather than ms<<10/1000: the latter's ~2.4% error would show
	 * up in a receiver's bpm-from-interval calculation. */
	uint64_t ms = (uint64_t)k_uptime_get();

	return (uint16_t)((ms * 1024u) / 1000u);
}

static void beat_work_fn(struct k_work *w);
static K_WORK_DELAYABLE_DEFINE(beat_work, beat_work_fn);

/* Defined below with the EVENT_TX handler, because that is where the reasoning
 * about who paces the stream lives; the suppression rule needs it earlier. */
static void load_next_page(void);

#if defined(CONFIG_STRAP_SUPPRESS_ANT_WHEN_CONNECTED)
/*
 * P9 suppression rule lives here, not in strap_ble.c: stopping an ANT+
 * channel is ANT+'s business, so the BLE module only reports the fact and
 * this decides what to do - keeping the dependency one-way. Taken on the
 * beat tick rather than the connect callback, since that runs in
 * controller context - the wrong place to be closing a radio channel.
 *
 * Defaults on because a connected phone already gets HR over BLE, so the
 * ANT+ broadcast is a duplicate - suppressing it means the contention this
 * project exists to arbitrate never arises on a strap. Turn it off to
 * stress the arbiter; that's the config the coexistence gate should run.
 */
static bool ant_open = true;

static void ant_suppression_update(void)
{
	bool want_open = !strap_ble_connected();

	if (want_open == ant_open) {
		return;
	}

	if (want_open) {
		/* Stage a payload before reopening, for the same reason the
		 * first open does: a master transmits the instant the channel
		 * opens. */
		load_next_page();
		if (antr_channel_open(HR_CHANNEL) == ANTW_RESPONSE_NO_ERROR) {
			ant_open = true;
			LOG_INF("ANT+ resumed (BLE disconnected)");
		}
	} else {
		if (antr_channel_close(HR_CHANNEL) == ANTW_RESPONSE_NO_ERROR) {
			ant_open = false;
			LOG_INF("ANT+ suppressed (BLE connected)");
		}
	}
}
#endif /* CONFIG_STRAP_SUPPRESS_ANT_WHEN_CONNECTED */

static void beat_work_fn(struct k_work *w)
{
	static uint32_t elapsed_ms;
	static uint32_t next_beat_ms;

	uint32_t bpm = CONFIG_STRAP_HR_BPM;
	uint32_t interval_ms = (bpm != 0u) ? (60000u / bpm) : 1000u;

	ARG_UNUSED(w);

	elapsed_ms += BEAT_TICK_MS;
	if (elapsed_ms >= next_beat_ms) {
		/*
		 * Advance the schedule; don't re-anchor it to the tick.
		 * `next_beat_ms = elapsed_ms + interval_ms` looks equivalent
		 * but isn't: elapsed_ms is quantised to BEAT_TICK_MS, so
		 * re-anchoring every beat compounds rounding instead of
		 * cancelling it. Measured effect at 72 bpm (833 ms interval):
		 * a 60 s BLE connection saw 67 HR notifications, not 72 -
		 * exactly the event-count/interval disagreement the profile
		 * tests exist to catch. Accumulating the exact interval keeps
		 * the average right; individual beats still land on a tick.
		 */
		next_beat_ms += interval_ms;
		if (next_beat_ms <= elapsed_ms) {
			/* Recovery, not steady state: a bpm change or missed
			 * ticks can leave the schedule far behind; re-anchor
			 * here, once, rather than burst-fire catch-up beats. */
			next_beat_ms = elapsed_ms + interval_ms;
		}
		profile_hr_beat(&hr, event_time_1024());
		profile_hr_set_computed(&hr, (uint8_t)bpm);
#if defined(CONFIG_STRAP_BLE_HRS)
		/* One heart, two radios: the SIG service is notified from the
		 * same beat that advances the ANT+ accumulators, so the two
		 * sides can't disagree about the rate. */
		strap_ble_notify_hr((uint8_t)bpm);
#endif
	}
	profile_hr_set_operating_time(&hr, elapsed_ms / 1000u);

#if defined(CONFIG_STRAP_SUPPRESS_ANT_WHEN_CONNECTED)
	ant_suppression_update();
#endif

	k_work_schedule(&beat_work, K_MSEC(BEAT_TICK_MS));
}

/*
 * Load the next page, paced by EVENT_TX rather than a wall clock: the stack
 * raises this exactly when a payload just went on air, which is when the
 * next one should be staged. A timer-driven load would drift against the
 * channel period and, under an arbiter, stage for slots never granted.
 */
static void load_next_page(void)
{
	uint8_t body[8];
	enum profile_slot_kind kind;

	kind = profile_hr_next(&hr, (uint64_t)k_uptime_get() * 1000u, body);
	if (kind == PROFILE_SLOT_IDLE) {
		/* A sparse node's silent slot. The radio stays off and the
		 * channel period keeps running; nothing to stage. */
		return;
	}

	(void)antr_broadcast_message_tx(HR_CHANNEL, sizeof(body), body);
}

/*
 * The backend's only way up. The dongle implements this by forwarding to USB;
 * a node implements it by being the application the messages were for.
 */
void antr_on_message(const struct antr_msg *msg)
{
	if (msg == NULL || msg->data == NULL) {
		return;
	}

	if (msg->id == ANTW_MESG_RESPONSE_EVENT_ID &&
	    msg->len >= ANTW_MESG_RESPONSE_EVENT_SIZE) {
		/* data[0] channel, data[1] the message id being responded to
		 * (0 for an event), data[2] the code. */
		if (msg->data[0] == HR_CHANNEL && msg->data[2] == ANTW_EVENT_TX) {
			load_next_page();
		}
	}
}

static int ant_start(uint16_t devnum)
{
	antr_err_t rc;

	rc = antr_network_address_set(HR_NETWORK, ant_plus_key);
	if (rc != ANTW_RESPONSE_NO_ERROR) {
		LOG_ERR("network key: %d", (int)rc);
		return -EIO;
	}

	rc = antr_channel_assign(HR_CHANNEL, ANTW_CHANNEL_TYPE_MASTER,
				 HR_NETWORK, 0u);
	if (rc != ANTW_RESPONSE_NO_ERROR) {
		LOG_ERR("assign: %d", (int)rc);
		return -EIO;
	}

	/* Transmission type 5, matching sim/ and tools/ant_sim.py - part of
	 * the channel id a receiver matches on. */
	rc = antr_channel_id_set(HR_CHANNEL, devnum, HR_DEVICE_TYPE, 5u);
	if (rc != ANTW_RESPONSE_NO_ERROR) {
		LOG_ERR("channel id: %d", (int)rc);
		return -EIO;
	}

	rc = antr_channel_period_set(HR_CHANNEL, HR_PERIOD_COUNTS);
	if (rc != ANTW_RESPONSE_NO_ERROR) {
		LOG_ERR("period: %d", (int)rc);
		return -EIO;
	}

	rc = antr_channel_radio_freq_set(HR_CHANNEL, HR_RF_FREQ);
	if (rc != ANTW_RESPONSE_NO_ERROR) {
		LOG_ERR("rf freq: %d", (int)rc);
		return -EIO;
	}

	/*
	 * Stage the first page before opening, not after: a master transmits
	 * the instant the channel opens, so the first slot is gone before any
	 * EVENT_TX could stage it - otherwise the first frame goes out empty.
	 */
	load_next_page();

	rc = antr_channel_open(HR_CHANNEL);
	if (rc != ANTW_RESPONSE_NO_ERROR) {
		LOG_ERR("open: %d", (int)rc);
		return -EIO;
	}

	return 0;
}

int main(void)
{
	struct profile_hr_cfg cfg;
	uint16_t devnum = CONFIG_STRAP_DEVICE_NUMBER;
	int err;

	LOG_INF("RadiANT strap: ANT+ 0x78 heart rate");

	if (antr_init() != ANTW_RESPONSE_NO_ERROR) {
		LOG_ERR("antr_init failed");
		return 0;
	}

	/*
	 * Device number comes from the identity record when provisioned (see
	 * docs/decisions/0009-hostless-node-identity.md); falls back to
	 * Kconfig so a freshly-flashed DK works on a bench without a
	 * provisioning step.
	 */
	if (node_ident_boot() == 0 && node_ident_is_provisioned()) {
		uint16_t d;

		if (node_ident_devnum(&d) == 0 && d != 0u) {
			devnum = d;
			LOG_INF("device number %u from the identity record", d);
		}
	} else {
		LOG_INF("device number %u from Kconfig (node not provisioned)",
			devnum);
	}

	/*
	 * cfg.id is the common-page identity (0x50/0x51), not the ANT channel
	 * id set in ant_start() - conflating them produces a strap that's
	 * found and then misidentifies itself.
	 */
	memset(&cfg, 0, sizeof(cfg));
	cfg.id.hw_revision = 1u;
	cfg.id.manufacturer_id = CONFIG_STRAP_MANUFACTURER_ID;
	cfg.id.model_number = 1u;
	cfg.id.sw_revision_main = 1u;
	cfg.id.sw_revision_supplemental = PROFILE_COMMON_INVALID_U8;
	cfg.id.serial_number = devnum;
	cfg.manufacturer_id_8 = CONFIG_STRAP_MANUFACTURER_ID;
	cfg.serial_upper16 = devnum;
	cfg.model_number_8 = 1u;
	cfg.hw_version = 1u;
	cfg.sw_version = 1u;
	cfg.common_82_every = 0u; /* no battery page rotation on a DK */

	err = profile_hr_init(&hr, &cfg);
	if (err != 0) {
		LOG_ERR("profile_hr_init: %d", err);
		return 0;
	}

	err = ant_start(devnum);
	if (err != 0) {
		return 0;
	}

	k_work_schedule(&beat_work, K_MSEC(BEAT_TICK_MS));
	LOG_INF("transmitting: device #%u, type 0x%02x, %u bpm",
		devnum, HR_DEVICE_TYPE, (unsigned)CONFIG_STRAP_HR_BPM);

#if defined(CONFIG_STRAP_BLE_HRS)
	/* P8b, started last: bringing the controller up after the ANT+
	 * channel means a failure to advertise can't be mistaken for a
	 * failure to transmit. */
	(void)strap_ble_start();
#endif

	return 0;
}
```

## src/strap_ble.c
```c
/*
 * SPDX-License-Identifier: Apache-2.0
 *
 * P8b: BLE beside RadiANT on one node. SoftDevice Controller advertises the
 * SIG Heart Rate Service while radiant keeps an ANT+ 0x78 master
 * running - one RADIO peripheral, arbitrated by the MPSL gate (P3).
 *
 * The intervals ARE the priority mechanism. Per nrfxlib's timeslot.rst,
 * applications only get PRIORITY_NORMAL and other MPSL users (the SDC) rank
 * above anything an app can request - there is no setting that makes ANT+
 * outrank BLE. So RadiANT's priority is delivered by shaping BLE's demand
 * instead: long advertising/connection intervals (cf.
 * nrf/samples/esb/esb_ptx_ble/prj.conf, MIN_INT = MAX_INT = 800, a 1 s
 * interval) are the arbitration policy, not power tuning.
 *
 * Bench data (P3): a tracked ANT+ window coexists fine with a 100 ms
 * advertiser - it's acquisition/sweep that a busy neighbour starves. A
 * strap is a master and never sweeps, hence the BLE branch lives on a node
 * rather than the dongle.
 */

#include <zephyr/kernel.h>
#include <zephyr/logging/log.h>
#include <zephyr/bluetooth/bluetooth.h>
#include <zephyr/bluetooth/conn.h>
#include <zephyr/bluetooth/uuid.h>
#include <zephyr/bluetooth/gatt.h>
#include <zephyr/bluetooth/services/hrs.h>

#include "strap_ble.h"

LOG_MODULE_DECLARE(strap, CONFIG_STRAP_LOG_LEVEL);

static atomic_t connected;

/* 0.625 ms units, which is what the advertising interval is expressed in. */
#define ADV_UNITS(ms) ((uint32_t)(((uint32_t)(ms) * 1000u) / 625u))

/*
 * The name goes in the advertising payload, not just the GAP Device Name
 * characteristic, so an unconnected scanner sees a name rather than a bare
 * MAC. Budget vs the 31-byte legacy adv limit: flags 3 + UUID16 4 + name
 * (2 + strlen) = 19 for "RadiANT HR"; longer than ~24 chars silently fails
 * bt_le_adv_start() with -EINVAL.
 */
static const struct bt_data ad[] = {
	BT_DATA_BYTES(BT_DATA_FLAGS, (BT_LE_AD_GENERAL | BT_LE_AD_NO_BREDR)),
	BT_DATA_BYTES(BT_DATA_UUID16_ALL,
		      BT_UUID_16_ENCODE(BT_UUID_HRS_VAL)),
	BT_DATA(BT_DATA_NAME_COMPLETE, CONFIG_BT_DEVICE_NAME,
		sizeof(CONFIG_BT_DEVICE_NAME) - 1u),
};

static void on_connected(struct bt_conn *conn, uint8_t err)
{
	if (err != 0u) {
		LOG_WRN("BLE connect failed (0x%02x)", err);
		return;
	}
	atomic_set(&connected, 1);
	LOG_INF("BLE connected");
	/* Nothing is done to ANT+ from here - P9's suppression rule lives
	 * with the ANT+ side; a BLE callback reaching into radiant
	 * (from controller context, no less) would be the layering violation
	 * the gate seam exists to avoid. */
}

static void on_disconnected(struct bt_conn *conn, uint8_t reason)
{
	atomic_set(&connected, 0);
	LOG_INF("BLE disconnected (0x%02x)", reason);
}

/*
 * Refuse a short connection interval rather than accept it quietly: a phone
 * (iOS especially) will ask for tens of ms, handing the controller a
 * recurring high-priority event MPSL can't make ANT+ outrank. Reject and
 * hold at the advertised preference, logging it so a degraded strap is
 * traceable to a phone connection.
 */
static bool on_param_req(struct bt_conn *conn, struct bt_le_conn_param *param)
{
	if (param->interval_max < CONFIG_STRAP_BLE_MIN_CONN_INTERVAL_UNITS) {
		LOG_INF("refusing %u-unit connection interval, holding at %u "
			"- see finding 1: this is the arbitration policy",
			param->interval_max,
			(unsigned)CONFIG_STRAP_BLE_MIN_CONN_INTERVAL_UNITS);
		param->interval_min = CONFIG_STRAP_BLE_MIN_CONN_INTERVAL_UNITS;
		param->interval_max = CONFIG_STRAP_BLE_MIN_CONN_INTERVAL_UNITS;
	}
	return true;
}

BT_CONN_CB_DEFINE(strap_conn_cb) = {
	.connected = on_connected,
	.disconnected = on_disconnected,
	.le_param_req = on_param_req,
};

bool strap_ble_connected(void)
{
	return atomic_get(&connected) != 0;
}

void strap_ble_notify_hr(uint8_t bpm)
{
	if (atomic_get(&connected) == 0) {
		return;
	}
	(void)bt_hrs_notify(bpm);
}

int strap_ble_start(void)
{
	struct bt_le_adv_param param = *BT_LE_ADV_CONN_FAST_1;
	int err;

	err = bt_enable(NULL);
	if (err != 0) {
		LOG_ERR("bt_enable: %d", err);
		return err;
	}

	param.interval_min = ADV_UNITS(CONFIG_STRAP_BLE_ADV_INTERVAL_MS);
	param.interval_max = ADV_UNITS(CONFIG_STRAP_BLE_ADV_INTERVAL_MS) + 16u;

	err = bt_le_adv_start(&param, ad, ARRAY_SIZE(ad), NULL, 0);
	if (err != 0) {
		LOG_ERR("bt_le_adv_start: %d", err);
		return err;
	}

	LOG_INF("BLE: SIG HRS advertising every %u ms",
		(unsigned)CONFIG_STRAP_BLE_ADV_INTERVAL_MS);
	return 0;
}
```

## src/strap_ble.h
```c
/* SPDX-License-Identifier: Apache-2.0 */
#ifndef STRAP_BLE_H_
#define STRAP_BLE_H_

/*
 * P8b: the SIG Heart Rate Service beside the ANT+ 0x78 master.
 *
 * Enables the controller and starts advertising. Everything after that is
 * driven by the beat generator in main.c, which notifies the HRS at the same
 * instants it advances the ANT+ accumulators - one heart, two radios.
 */
int strap_ble_start(void);

/*
 * True while a phone is connected.
 *
 * P9's suppression rule reads this: a connected phone is receiving the same
 * heart rate over the SIG service, so continuing to broadcast ANT+ spends air
 * on a duplicate. It is exposed rather than acted on internally because
 * stopping an ANT+ channel is the ANT+ side's business, and a BLE module that
 * reached into radiant_core would be the layering this project keeps out.
 */
bool strap_ble_connected(void);

/* Push a heart rate to the SIG service. No-op when nothing is connected. */
void strap_ble_notify_hr(uint8_t bpm);

#endif /* STRAP_BLE_H_ */
```
