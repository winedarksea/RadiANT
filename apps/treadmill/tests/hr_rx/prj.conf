## CMakeLists.txt
```
# SPDX-License-Identifier: Apache-2.0
#
# The treadmill's ANT+ heart-rate slave (src/treadmill_hr_rx.c), against a
# stub radiant_ant_* layer.
#
# WHY A STUB AND NOT THE REAL STACK. The defect this image was added for
# (review 2026-10-31, B2-3) is an ORDERING one: the HR slave reopened its
# channel when RX_SEARCH_TIMEOUT arrived, before the CHANNEL_CLOSED that
# follows it, and on the real stack that open is refused with WRONG_STATE
# whenever a scan window is still bound to the channel. A stub whose open
# answers WRONG_STATE until it has been told the channel closed is the
# smallest thing that states that contract - and it is what lets the case run
# in microseconds with no radio, no scheduler and no fake HAL.
#
# CI discovers it because .github/workflows/ci.yml's ztest job passes
# `-T app/apps/treadmill/tests`, which walks subdirectories.
#
# On Windows there is no native_sim; use
#   scripts\run_ztest_hw.ps1 -App apps\treadmill\tests\hr_rx
# on a DK.

cmake_minimum_required(VERSION 3.20.0)

find_package(Zephyr REQUIRED HINTS $ENV{ZEPHYR_BASE})
project(treadmill_hr_rx_test)

target_sources(app PRIVATE
  src/main.c
  ../../src/treadmill_hr_rx.c
)
target_include_directories(app PRIVATE
  ../../src
  ../../../../radiant/include
)
```

## Kconfig
```
# SPDX-License-Identifier: Apache-2.0
#
# treadmill_hr_rx.c declares its log module against the application's
# CONFIG_TREADMILL_LOG_LEVEL, which lives in apps/treadmill/Kconfig behind the
# whole application's dependencies. This image needs only the level.

module = TREADMILL
module-str = treadmill
source "subsys/logging/Kconfig.template.log_config"

source "Kconfig.zephyr"
```

## prj.conf
```kconfig
# SPDX-License-Identifier: Apache-2.0
#
# ztest plus logging (treadmill_hr_rx.c logs through the treadmill module).
# No radiant, no backend, no BLE: radiant_ant_* is stubbed in src/main.c.
CONFIG_ZTEST=y
CONFIG_LOG=y
```

## src/main.c
```c
/*
 * SPDX-License-Identifier: Apache-2.0
 *
 * The treadmill's heart-rate slave (src/treadmill_hr_rx.c) against a stub
 * radiant_ant_* layer that keeps the one piece of channel state the module's event
 * handling depends on: whether the channel has finished closing.
 *
 * The stub's contract is the real stack's (radiant_ant.h): open() on a channel
 * that is still open or still CLOSING answers RADIANT_WIRE_CHANNEL_IN_WRONG_STATE, and
 * a search timeout closes the channel ITSELF - RX_SEARCH_TIMEOUT first, then
 * CHANNEL_CLOSED once any scan window bound to it has ended. That gap is the
 * whole of review 2026-10-31's B2-3: the module reopened on the timeout, the
 * reopen was refused, and nothing ever tried again.
 */

#include <stdint.h>
#include <string.h>

#include <zephyr/kernel.h>
#include <zephyr/logging/log.h>
#include <zephyr/ztest.h>

#include <radiant/radiant_ant.h>
#include <radiant/radiant_wire.h>
#include "treadmill_hr_rx.h"
#include "treadmill_state.h"

/* treadmill_hr_rx.c declares the application's log module; main.c owns it in
 * the real image. */
LOG_MODULE_REGISTER(treadmill, CONFIG_TREADMILL_LOG_LEVEL);

#define HR_CH 3u

enum stub_state {
	STUB_UNASSIGNED = 0,
	STUB_ASSIGNED,   /* closed: open() is legal */
	STUB_OPEN,
	STUB_CLOSING,    /* timed out, a scan window still bound */
};

static struct {
	enum stub_state state;
	uint32_t        open_calls;
	uint32_t        open_ok;
	uint8_t         last_prox;
	uint32_t        prox_calls;
} stub;

static uint8_t  last_bpm_seen = 0xEEu;
static uint32_t bpm_calls;

/* ── The stub radiant_ant_* layer ─────────────────────────────────────────────── */

radiant_ant_err_t radiant_ant_channel_assign(uint8_t channel, uint8_t type, uint8_t network,
			       uint8_t ext_assign)
{
	ARG_UNUSED(channel);
	ARG_UNUSED(type);
	ARG_UNUSED(network);
	ARG_UNUSED(ext_assign);
	stub.state = STUB_ASSIGNED;
	return RADIANT_WIRE_RESPONSE_NO_ERROR;
}

radiant_ant_err_t radiant_ant_channel_id_set(uint8_t channel, uint16_t device_number,
			       uint8_t device_type, uint8_t trans_type)
{
	ARG_UNUSED(channel);
	ARG_UNUSED(device_number);
	ARG_UNUSED(device_type);
	ARG_UNUSED(trans_type);
	return RADIANT_WIRE_RESPONSE_NO_ERROR;
}

radiant_ant_err_t radiant_ant_channel_period_set(uint8_t channel, uint16_t period)
{
	ARG_UNUSED(channel);
	ARG_UNUSED(period);
	return RADIANT_WIRE_RESPONSE_NO_ERROR;
}

radiant_ant_err_t radiant_ant_channel_radio_freq_set(uint8_t channel, uint8_t freq)
{
	ARG_UNUSED(channel);
	ARG_UNUSED(freq);
	return RADIANT_WIRE_RESPONSE_NO_ERROR;
}

radiant_ant_err_t radiant_ant_channel_search_timeout_set(uint8_t channel, uint8_t timeout)
{
	ARG_UNUSED(channel);
	ARG_UNUSED(timeout);
	return RADIANT_WIRE_RESPONSE_NO_ERROR;
}

radiant_ant_err_t radiant_ant_search_channel_priority_set(uint8_t channel, uint8_t priority)
{
	ARG_UNUSED(channel);
	ARG_UNUSED(priority);
	return RADIANT_WIRE_RESPONSE_NO_ERROR;
}

radiant_ant_err_t radiant_ant_prox_search_set(uint8_t channel, uint8_t threshold,
				uint8_t custom)
{
	ARG_UNUSED(channel);
	ARG_UNUSED(custom);
	stub.last_prox = threshold;
	stub.prox_calls++;
	return RADIANT_WIRE_RESPONSE_NO_ERROR;
}

radiant_ant_err_t radiant_ant_lib_config_set(uint8_t config)
{
	ARG_UNUSED(config);
	return RADIANT_WIRE_RESPONSE_NO_ERROR;
}

radiant_ant_err_t radiant_ant_channel_open_with_offset(uint8_t channel, uint16_t offset)
{
	ARG_UNUSED(channel);
	ARG_UNUSED(offset);
	stub.open_calls++;
	if (stub.state != STUB_ASSIGNED) {
		return RADIANT_WIRE_CHANNEL_IN_WRONG_STATE;
	}
	stub.state = STUB_OPEN;
	stub.open_ok++;
	return RADIANT_WIRE_RESPONSE_NO_ERROR;
}

radiant_ant_err_t radiant_ant_channel_close(uint8_t channel)
{
	ARG_UNUSED(channel);
	if (stub.state != STUB_OPEN) {
		return RADIANT_WIRE_CHANNEL_IN_WRONG_STATE;
	}
	stub.state = STUB_ASSIGNED;
	return RADIANT_WIRE_RESPONSE_NO_ERROR;
}

/* What main.c does with a reading: record it. */
void treadmill_node_heart_rate(uint8_t bpm)
{
	last_bpm_seen = bpm;
	bpm_calls++;
}

/* ── Helpers ───────────────────────────────────────────────────────────── */

static void feed_event(uint8_t code)
{
	uint8_t data[3] = { HR_CH, RADIANT_WIRE_MESG_EVENT_ID, code };
	struct radiant_ant_msg m = {
		.id = RADIANT_WIRE_MESG_RESPONSE_EVENT_ID,
		.len = sizeof(data),
		.data = data,
	};

	zassert_true(treadmill_hr_rx_message(&m), "event not claimed");
}

static void feed_bpm(uint8_t bpm)
{
	/* [ch][page, x, x, x, event time lo, hi, count, computed bpm] */
	uint8_t data[9] = { HR_CH, 0x04u, 0u, 0u, 0u, 0u, 0u, 1u, bpm };
	struct radiant_ant_msg m = {
		.id = RADIANT_WIRE_MESG_BROADCAST_DATA_ID,
		.len = sizeof(data),
		.data = data,
	};

	zassert_true(treadmill_hr_rx_message(&m), "broadcast not claimed");
}

/* The module hands readings to the system workqueue. */
static void let_work_run(void)
{
	k_sleep(K_MSEC(10));
}

static void before(void *f)
{
	ARG_UNUSED(f);
	memset(&stub, 0, sizeof(stub));
	zassert_ok(treadmill_hr_rx_start(HR_CH));
	zassert_equal(STUB_OPEN, stub.state, "setup: the slave did not open");
}

ZTEST_SUITE(treadmill_hr_rx, NULL, NULL, before, NULL, NULL);

/* ── The cases ─────────────────────────────────────────────────────────── */

/*
 * B2-3: the reopen after a search timeout waits for CHANNEL_CLOSED. The
 * timeout arrives while the channel is still CLOSING (a scan window bound to
 * it); reopening then is refused, and the module used to have no second try.
 */
ZTEST(treadmill_hr_rx, test_reopen_waits_for_channel_closed)
{
	uint8_t  prox_at_open = stub.last_prox;
	uint32_t opens = stub.open_calls;

	stub.state = STUB_CLOSING;
	feed_event(RADIANT_WIRE_EVENT_RX_SEARCH_TIMEOUT);
	zassert_equal(opens, stub.open_calls,
		      "reopened on RX_SEARCH_TIMEOUT, before CHANNEL_CLOSED - "
		      "refused while the channel is CLOSING");

	stub.state = STUB_ASSIGNED;
	feed_event(RADIANT_WIRE_EVENT_CHANNEL_CLOSED);
	zassert_equal(STUB_OPEN, stub.state,
		      "the slave was not reopened after its search timed out: "
		      "no strap will ever be acquired again until reboot");
	zassert_equal(opens + 1u, stub.open_calls, "reopened more than once");
	/* Bin 1 is the closest (ANT MP Rev 5.1 6.4), so relaxing is one bin
	 * UP, and past 10 it turns proximity off. */
	zassert_equal(prox_at_open == 0u    ? 0u
		      : prox_at_open >= 10u ? 0u
					    : prox_at_open + 1u,
		      stub.last_prox,
		      "the proximity floor did not relax by one bin");
}

/* A CHANNEL_CLOSED with no search timeout before it (a host close, say) is
 * not a reason to reopen. */
ZTEST(treadmill_hr_rx, test_stray_channel_closed_does_not_reopen)
{
	uint32_t opens = stub.open_calls;

	stub.state = STUB_ASSIGNED;
	feed_event(RADIANT_WIRE_EVENT_CHANNEL_CLOSED);
	zassert_equal(opens, stub.open_calls,
		      "reopened on a CHANNEL_CLOSED no timeout asked for");
}

/* B2-2: the strap has gone (RX_FAIL_GO_TO_SEARCH), so its last bpm must stop
 * being reported for the whole search, not linger for 30 s or more. */
ZTEST(treadmill_hr_rx, test_go_to_search_clears_bpm)
{
	feed_bpm(140u);
	let_work_run();
	zassert_equal(140u, last_bpm_seen, "setup: the reading was not delivered");

	feed_event(RADIANT_WIRE_EVENT_RX_FAIL_GO_TO_SEARCH);
	let_work_run();
	zassert_equal(TREADMILL_HR_NONE, last_bpm_seen,
		      "a strap that went away kept its last reading (%u bpm) "
		      "through the search", (unsigned int)last_bpm_seen);
}

/* Proximity search is one-shot: the acquisition cleared the floor, so the
 * module sets it again on the first message after it, while tracking. Without
 * that, RX_FAIL_GO_TO_SEARCH sent the channel back to a wildcard search with
 * no floor, free to lock onto a neighbour's strap at any distance. */
ZTEST(treadmill_hr_rx, test_floor_is_rearmed_after_each_acquisition)
{
	uint8_t  floor_at_open = stub.last_prox;
	uint32_t calls = stub.prox_calls;

	/* The acquiring frame: the floor goes back in, once. */
	feed_bpm(120u);
	zassert_equal(calls + 1u, stub.prox_calls,
		      "the floor was not set again after the acquisition");
	zassert_equal(floor_at_open, stub.last_prox,
		      "re-armed at bin %u, not the bin %u it opened with",
		      stub.last_prox, floor_at_open);
	feed_bpm(121u);
	zassert_equal(calls + 1u, stub.prox_calls,
		      "re-armed on every message, not once per acquisition");

	/* The strap drops and is reacquired: that clears it again. */
	feed_event(RADIANT_WIRE_EVENT_RX_FAIL_GO_TO_SEARCH);
	zassert_equal(calls + 1u, stub.prox_calls,
		      "nothing to do yet: the search runs on the floor already set");
	feed_bpm(122u);
	zassert_equal(calls + 2u, stub.prox_calls,
		      "the floor was not set again after the reacquisition");
	zassert_equal(floor_at_open, stub.last_prox);
}
```
