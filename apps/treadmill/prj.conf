## CMakeLists.txt
```
# SPDX-License-Identifier: Apache-2.0

cmake_minimum_required(VERSION 3.20.0)

# RadiANT treadmill: a node, not a dongle, and the second manufacturer
# reference design in this tree. See src/main.c for what it is,
# src/treadmill_source.h for the one seam a manufacturer implements, Kconfig for
# what it is allowed to do, and docs/treadmill-reference-design.md for the
# porting guide.
#
# LIKE apps/hrm_ble AND UNLIKE apps/sim, THIS NEEDS NO sdk-ant AT ALL. It is
# built out of radiant and radiant/src/profiles/, both of which are in this
# repository.
#
# THE DEFAULT IS nrf AND NOT null. Every application in this repository now
# defaults to a backend its silicon can really use, so this is no longer the
# odd one out - see cmake/radiant_backend.cmake for why the old `null` default
# was withdrawn everywhere. A null-radio node boots, logs "transmitting", and
# puts nothing on the air - indistinguishable from a dead antenna, and it has
# cost this project a Feather flash and a whole session once already.
#
# radiant's own KCONFIG default is still RADIANT_BACKEND_NULL, and that
# asymmetry is deliberate and permanent: it is what tests/import_smoke builds
# against on native_sim, where no real backend could resolve.
include("${CMAKE_CURRENT_SOURCE_DIR}/../../cmake/radiant_backend.cmake")
radiant_select_backend("${CMAKE_CURRENT_SOURCE_DIR}/../../radiant" "nrf" RADIANT_BACKEND_CONF)

set(treadmill_backend_conf "${CMAKE_CURRENT_BINARY_DIR}/treadmill_backend.conf")
file(WRITE "${treadmill_backend_conf}"
"# Generated by apps/treadmill/CMakeLists.txt from -DRADIANT_BACKEND. Do not edit.
CONFIG_RADIANT=y
CONFIG_RADIANT_ANT_API=y
${RADIANT_BACKEND_CONF}
")
list(APPEND EXTRA_CONF_FILE "${treadmill_backend_conf}")

find_package(Zephyr REQUIRED HINTS $ENV{ZEPHYR_BASE})
project(radiant_treadmill)

# ── The BLE interlock, from the other side ──────────────────────────────────
#
# TREADMILL_BLE `select`s RADIANT_BACKEND_NRF_GATE_MPSL, which covers the route
# through this application's own Kconfig. This covers the other route: any conf
# fragment, board file or -DCONFIG_ that turns CONFIG_BT on WITHOUT going
# through TREADMILL_BLE.
#
# That combination is not merely unsupported, it is silent. radiant/Kconfig's
# nrf arm carries `depends on !BT || ..._GATE_MPSL`, so CONFIG_BT=y with no gate
# makes the arm unselectable and Kconfig falls back to the choice default - the
# NULL backend. The resulting node boots, logs "transmitting", and puts nothing
# on the air.
#
# BEFORE radiant_assert_backend(), NOT AFTER, and the ordering was measured
# rather than assumed - see apps/hrm_ble/CMakeLists.txt, which records the
# experiment. The generic assert's message is about a CMake cache variable and
# lists three unrelated `depends on` symbols; the specific message has to come
# first to be the one anybody reads.
if(CONFIG_BT AND NOT CONFIG_TREADMILL_BLE)
  message(FATAL_ERROR
    "treadmill: CONFIG_BT is set but CONFIG_TREADMILL_BLE is not.\n"
    "  radiant/Kconfig's nrf backend has `depends on !BT || "
    "RADIANT_BACKEND_NRF_GATE_MPSL`, so BT without the gate makes the nrf arm "
    "unselectable and Kconfig silently falls back to the null backend - a node "
    "that boots, logs 'transmitting' and puts nothing on the air.\n"
    "  Turn BLE on through this application's own symbol, which selects the "
    "gate for you:\n"
    "    west build ... -- -Dtreadmill_EXTRA_CONF_FILE=ble.conf\n"
    "  THE PREFIX IS THE BASENAME OF THIS DIRECTORY. Sysbuild names an image "
    "after the basename of APP_DIR, so a wrong prefix names an image that does "
    "not exist and is accepted in silence - apps/hrm_ble shipped exactly that "
    "no-op for a while after a directory rename, and two builds with and "
    "without the flag produced byte-identical .config files.")
endif()

# The backend actually compiled is the backend that was asked for. See
# cmake/radiant_backend.cmake for the full rationale.
radiant_assert_backend("treadmill")

target_sources(app PRIVATE
  src/main.c
  src/treadmill_source.c
  src/treadmill_state.c
  src/treadmill_session.c
  # Every path that can move the machine, behind the one motion rule, and
  # the capability derivation. Kernel-free; tests/pages compiles both.
  src/treadmill_cmd.c
  src/treadmill_caps.c
)

# ── The treadmill source ────────────────────────────────────────────────────
#
# A Kconfig `choice`, so exactly one of these is ever compiled and exactly one
# treadmill_source_register() call is ever linked. CONFIG_TREADMILL_SOURCE_CUSTOM
# compiles the stub, which registers nothing on purpose: see that symbol's help
# for why there is deliberately no fallback to the simulator.
if(CONFIG_TREADMILL_SOURCE_SIMULATED)
  target_sources(app PRIVATE src/treadmill_sim.c)
elseif(CONFIG_TREADMILL_SOURCE_CUSTOM)
  target_sources(app PRIVATE src/treadmill_source_custom.c)
endif()

if(CONFIG_TREADMILL_BLE)
  target_sources(app PRIVATE src/treadmill_ble.c
                             src/treadmill_ftms_data.c)
endif()

if(CONFIG_TREADMILL_HR_RX)
  target_sources(app PRIVATE src/treadmill_hr_rx.c)
endif()

# ── The radiant_ant_* adapter ──────────────────────────────────────────────────────
#
# radiant/src/ant_api/radiant_ant.c is what implements radiant_ant_init() and the rest of
# radiant/include/radiant/radiant_ant.h on top of radiant's modules. The generated backend
# fragment above forces CONFIG_RADIANT_ANT_API=y unconditionally.
include("${CMAKE_CURRENT_SOURCE_DIR}/../common/sources.cmake")

# ── radiant/src/profiles ────────────────────────────────────────────────────
#
# WHAT THE LINKER SAYS IS NEEDED, WHICH IS MORE THAN THE PAGES NEED.
#
# radiant_profile_fec_tx.c and radiant_profile_sdm.c are the two masters. radiant_profile_common.c is
# pages 80 and 81. radiant_profile_sched.c is the slot engine both masters drive, and it
# pulls in radiant_profile_schedule.c and radiant_profile_telemetry.c for the descriptor path -
# which NEITHER master uses (both configure cfg.desc = NULL, because an ANT+
# compatibility type announces no schema) but which the engine references
# unconditionally. radiant_profile_bits.c is under those.
#
# radiant_profile_compat.c is deliberately ABSENT, unlike in apps/hrm_ble. That
# application links the compat client inert so that a coexistence measurement is
# taken against a strap broadcasting exactly what a commercial strap
# broadcasts. Here there is no equivalent argument and no compat allocation for
# device types 0x11 or 0x7C - docs/decisions/0008's two page numbers are
# registered on 0x0B and 0x78 only - so linking it would be linking a layer
# with no page numbers to put anything on.
#
# radiant_profile_fec.c (the DECODER) is also absent, and that absence is the point of
# the two-translation-unit split: a treadmill transmits and does not decode
# another machine's pages.
target_sources(app PRIVATE
  ../../radiant/src/profiles/radiant_profile_bits.c
  ../../radiant/src/profiles/radiant_profile_common.c
  ../../radiant/src/profiles/radiant_profile_sched.c
  ../../radiant/src/profiles/radiant_profile_schedule.c
  ../../radiant/src/profiles/radiant_profile_telemetry.c
  ../../radiant/src/profiles/radiant_profile_handoff.c
  ../../radiant/src/profiles/radiant_profile_fec_tx.c
)
if(CONFIG_TREADMILL_ANT_SDM)
  target_sources(app PRIVATE ../../radiant/src/profiles/radiant_profile_sdm.c)
endif()
if(CONFIG_TREADMILL_HR_RX)
  # Only the header is needed for the one byte the slave reads (see
  # src/treadmill_hr_rx.c), but radiant_profile_hr.c is what defines
  # RADIANT_PROFILE_HR_INVALID_BPM's neighbours and the encoders a future console
  # would want. Compiled so the constants and the profile stay one file.
  target_sources(app PRIVATE ../../radiant/src/profiles/radiant_profile_hr.c
                             ../../radiant/src/profiles/radiant_profile_compat.c)
endif()

# ── radiant/src/node ────────────────────────────────────────────────────────
#
# The identity record decides the device number under ADR 0009, and the
# settings-backed NVM implementation is the one the dongle already uses.
target_sources(app PRIVATE
  ../../radiant/src/node/radiant_node_ident.c
  ../../radiant/src/node/radiant_node_nvm_settings.c
)
```

## sample.yaml
```
# SPDX-License-Identifier: Apache-2.0
#
# Twister coverage for the treadmill node.
#
# build_only on every entry. These are compile-and-configure assertions, not
# tests - the node's actual behaviour needs a radio, a head unit, a phone and a
# stopwatch, and docs/treadmill-reference-design.md's bench procedure is where
# that lives. The properties that ARE testable without hardware have their own
# ztest applications: radiant/tests (the two page codecs and the interleave) and
# tests/pages/ here (the state module and every unit conversion).
#
# THE VALUE IS NOT IN THE COMPILE. It is in the .config read-back that the
# build-treadmill CI job does afterwards. apps/hrm_ble learned this the
# expensive way: `-Dstrap_EXTRA_CONF_FILE=` turned out to be a silent no-op
# after a directory rename, because sysbuild derives the image name from the
# basename of APP_DIR. The flag named an image that no longer existed, CMake
# emitted only its end-of-run "manually-specified variables were not used"
# warning, and the BLE image built green with no BLE in it. A build-only entry
# would have passed that too. Asserting the resulting .config is the only thing
# that would not have.
#
# WHO ACTUALLY RUNS THIS FILE. Not CI, today: the ztest job's twister
# invocation walks the test directories, and this file sits beside them rather
# than under one. The configurations below are built and asserted by the
# build-treadmill job in .github/workflows/release.yml and by
# scripts/build_all.ps1's $treadmillTargets loop; this file is for
# `twister -T apps/treadmill -p nrf54l15dk/nrf54l15/cpuapp` by hand, and for
# stating the matrix in one place the two of them can be read against.
#
# sysbuild: true, and it is load-bearing rather than boilerplate. Every
# `treadmill_`-prefixed argument below is an IMAGE-SCOPED sysbuild setting; run
# without sysbuild, twister would pass them to a build that has no image scoping
# at all and they would be silently ignored.
common:
  build_only: true
  sysbuild: true
  tags:
    - radiant
    - treadmill

tests:
  # Both ANT+ masters, no BLE, no arbiter. The baseline the others are read
  # against, and the configuration a manufacturer starts from.
  treadmill.ant:
    platform_allow:
      - nrf54l15dk/nrf54l15/cpuapp
    extra_args:
      - RADIANT_BACKEND=nrf

  # THE OTHER HALF OF THE BACKEND'S `depends on`.
  #
  # radiant/Kconfig's nrf arm is `SOC_COMPATIBLE_NRF52X || SOC_COMPATIBLE_NRF54LX`,
  # and this row is what keeps the nRF52 half compiled. ANT+ only on purpose -
  # see boards/nrf52840dk_nrf52840.overlay for why the BLE arm is not built
  # here.
  treadmill.ant_nrf52840:
    platform_allow:
      - nrf52840dk/nrf52840
    extra_args:
      - RADIANT_BACKEND=nrf

  # THE COEXISTENCE FALLBACK, BUILT SO IT CANNOT ROT.
  #
  # One ANT+ master instead of two. It is not a shipping configuration - FE-C
  # alone is invisible to anything that only knows foot pods - and it is the
  # first thing a bench operator reaches for when two masters plus BLE
  # misbehave. A fallback that has never been compiled is not a fallback.
  treadmill.fec_only:
    platform_allow:
      - nrf54l15dk/nrf54l15/cpuapp
    extra_args:
      - RADIANT_BACKEND=nrf
      - treadmill_EXTRA_CONF_FILE=fec_only.conf

  # The BLE half, image-scoped through the CORRECT image name. `treadmill_`
  # here is the basename of this directory; anything else addresses nothing.
  treadmill.ble:
    platform_allow:
      - nrf54l15dk/nrf54l15/cpuapp
    extra_args:
      - RADIANT_BACKEND=nrf
      - treadmill_EXTRA_CONF_FILE=ble.conf

  # THE HEAVIEST CONFIGURATION THIS APPLICATION HAS: two ANT+ masters, one
  # ANT+ slave, and BLE with SMP and a bonding store. It is the one that
  # decides whether the RAM budget holds, which is the constraint the Matter
  # spike already established matters more than flash on this part.
  treadmill.ble_hr:
    platform_allow:
      - nrf54l15dk/nrf54l15/cpuapp
    extra_args:
      - RADIANT_BACKEND=nrf
      - treadmill_EXTRA_CONF_FILE="ble.conf;hr_rx.conf"

  # THE ARM WITH NO SOURCE IN IT, and it is here to prove a negative.
  #
  # CONFIG_TREADMILL_SOURCE_CUSTOM compiles no implementation of the seam. The
  # image must still LINK - if it does not, an integrator's first build fails
  # for a reason that has nothing to do with their driver - and it must still
  # run, warning at boot and reporting a stopped belt rather than falling back
  # to the simulator. Only the link half is checkable here.
  treadmill.custom:
    platform_allow:
      - nrf54l15dk/nrf54l15/cpuapp
    extra_args:
      - RADIANT_BACKEND=nrf
      - treadmill_EXTRA_CONF_FILE=source_custom.conf

# Deliberately not here, so the absence is a recorded decision rather than an
# oversight:
#
#   * nrf54lm20dk/nrf54lm20a/cpuapp. The overlay exists and
#     scripts/build_all.ps1's rows build it, but it adds nothing to THIS file:
#     it is the same SOC_COMPATIBLE_NRF54LX arm as the L15 with the same TIMER
#     answer, so an entry would cost a full build per run to re-prove what the
#     L15 rows already prove. The nRF52840 row is the one covering a different
#     arm.
#   * A BLE row on nRF52840. See boards/nrf52840dk_nrf52840.overlay.
#   * CONFIG_TREADMILL_FEC_METABOLIC. It is one optional page behind one
#     `#if`, and the code it guards is exercised by tests/pages/ rather than by
#     a whole extra image.
```

## prj.conf
```kconfig
# RadiANT treadmill node.
#
# Nothing here is shared with the dongle's prj.conf, for the same reason
# apps/hrm_ble says it: this build has no USB, no serial bridge and no
# partition-manager constraints. It is fitness equipment. What it does share is
# the whole radio stack, because that is the point of the application.

CONFIG_TREADMILL=y

# radiant and its radiant_ant_* adapter. The backend itself comes from
# -DRADIANT_BACKEND via the generated fragment in CMakeLists.txt, so a
# null-radio build is a deliberate choice rather than a default nobody noticed.
CONFIG_RADIANT=y
CONFIG_RADIANT_ANT_API=y

# The identity record and its storage. ADR 0009 makes the device number a
# property of the node rather than of the image.
#
# RADIANT_SEC is not optional here and not a feature choice: src/node/Kconfig
# says `depends on RADIANT_SEC` because everything in node_ident derives keys,
# down to the boot counter's epoch.
CONFIG_RADIANT_SEC=y
CONFIG_RADIANT_NODE_IDENT=y
CONFIG_RADIANT_NODE_NVM_SETTINGS=y
CONFIG_SETTINGS=y
CONFIG_SETTINGS_NVS=y

# The entropy source K_dev is generated from on first boot (ADR 0020): the
# board's zephyr,entropy node through Zephyr's entropy driver - CRACEN on
# nRF54L, the RNG peripheral on nRF52840 (boards/nrf52840dk_nrf52840.overlay
# chooses it). With it, CONFIG_RADIANT_NODE_IDENT_SELF_PROVISION defaults on,
# and every machine flashed from one image gets its own device number.
# Its cost (+2.5 KB RAM main stack on a plain nRF54L build) is accepted only for
# products that self-provision. A product that opts out must drop this line, not
# just set SELF_PROVISION=n, unless something else needs radiant_sec_rng()
# (ADR 0020, "Accepted costs").
CONFIG_RADIANT_SEC_RNG_ENTROPY=y

CONFIG_HEAP_MEM_POOL_SIZE=2048

# THE CONTROL PATH NEEDS ACKNOWLEDGED DATA IN BOTH DIRECTIONS. FE-C's control
# pages 48-51 arrive as acknowledged messages into a channel this node is the
# MASTER of, which is not the usual direction. radiant/src/radiant_burst.c
# refuses at config time any backend that cannot acknowledge - loudly, which is
# the right behaviour - so this is worth knowing before the first control page
# rather than at it.

# Logs out the DK's first VCOM. Not RTT: RTT needs SEGGER's JLinkARM DLL
# installed, whereas the VCOM is carried by the cable that already programs the
# board.
CONFIG_LOG=y
CONFIG_LOG_MODE_DEFERRED=y
CONFIG_SERIAL=y
CONFIG_CONSOLE=y
CONFIG_UART_CONSOLE=y
CONFIG_LOG_BACKEND_UART=y

# THE BOOT BANNER USED TO BE DROPPED, and this is the line that stops it.
#
# Measured on an nRF54L15 DK, 2026-08-17: a treadmill boot printed
# "--- 3 messages dropped ---" and no banner. That was read as "no treadmill
# build emits console output, not even the boot banner", and from there as a
# dead console or a hung board. It was neither, and the console was fine the
# whole time - the evidence is that the same capture carried every later line,
# through to "BLE: FTMS + RSC advertising ... as 'RadiANT Treadmill'".
#
# The mechanism is DEFERRED + OVERFLOW + a 1024-byte ring. Every console byte
# here, printk included (CONFIG_LOG_PRINTK=y), goes into that ring and comes out
# only when the log processing thread runs - and that thread sleeps 1000 ms and
# wakes at 10 queued messages (LOG_PROCESS_THREAD_SLEEP_MS,
# LOG_PROCESS_TRIGGER_THRESHOLD). radiant's own init is far more than 10 lines
# and emits them faster than the first drain, so with LOG_MODE_OVERFLOW=y the
# ring discards its OLDEST entries - which are precisely the banner and the
# first application lines.
#
# 4096 rather than 1024 covers the boot burst with margin. The alternatives are
# both worse: LOG_MODE_IMMEDIATE makes every LOG_* call in a radio callback
# synchronous and stops ANT+ transmission outright (measured), and
# LOG_MODE_OVERFLOW=n would block the radio thread on a full ring instead of
# dropping - trading three lost log lines for lost slots on the air.
CONFIG_LOG_BUFFER_SIZE=4096

# Halt on a fault rather than rebooting into it. A machine that resets in a loop
# still transmits between resets, which reads as an intermittent radio fault
# from the receiving end - the most expensive kind of symptom to chase, and one
# this project has already paid for twice.
CONFIG_RESET_ON_FATAL_ERROR=n
CONFIG_THREAD_NAME=y
```

## ble.conf
```kconfig
# FTMS + RSC on top of the ANT+ node build.
#
# Passed IMAGE-SCOPED:
#
#   -Dtreadmill_EXTRA_CONF_FILE=ble.conf
#
# THE PREFIX IS THE BASENAME OF THE APPLICATION DIRECTORY, and getting it wrong
# is silent. Sysbuild derives an image's name from the basename of APP_DIR, so a
# flag naming an image that does not exist is accepted with nothing beyond
# CMake's end-of-run "manually-specified variables were not used" warning, and
# the BLE image builds green with no BLE in it. apps/hrm_ble shipped exactly
# that no-op after a directory rename and MEASURED it: two builds, one with the
# flag and one without, produced byte-identical .config files.
#
# A plain -DEXTRA_CONF_FILE= is no better: it lands in the sysbuild cache and
# never reaches the image at all. .github/workflows/release.yml's build-treadmill
# job asserts the resulting .config for exactly this reason - a build-only check
# passes the no-op without noticing.

CONFIG_TREADMILL_BLE=y
CONFIG_BT=y
CONFIG_BT_PERIPHERAL=y

# THE CONTROL POINT REQUIRES ENCRYPTION, so this build pairs and bonds.
#
# FTMS v1.0 Table 4.1 gives the Fitness Machine Control Point security
# permission "Encryption", and src/treadmill_ble.c puts BT_GATT_PERM_WRITE_ENCRYPT
# on the attribute accordingly. CONFIG_BT_SMP is `select`ed by
# CONFIG_TREADMILL_BLE rather than set here, so it cannot be lost by editing
# this file; the storage below is what makes a bond survive a power cycle.
#
# WITHOUT THE BOND STORE the machine still works and every power cycle costs the
# user a re-pair, which on a gym floor is worse than it sounds: a phone that
# remembers a bond the machine has forgotten fails to encrypt and reports the
# machine as broken rather than as unpaired.
CONFIG_BT_SETTINGS=y
CONFIG_BT_MAX_PAIRED=4

# NCS's Running Speed and Cadence service. `select`ed by CONFIG_TREADMILL_BLE
# as well - noted here because CONFIG_BT_RSCS=y PUBLISHES THE SERVICE WHETHER OR
# NOT bt_rscs_init() IS CALLED (rscs.c uses a static BT_GATT_SERVICE_DEFINE), so
# a build that enabled the symbol and skipped the init would advertise a service
# whose features and location are whatever zeroed memory says.
# src/treadmill_ble.c fails loudly if the init fails, which is this repository's
# house answer to that shape of problem.
#
# It also publishes Sensor Location (0x2A5D) and SC Control Point (0x2A55)
# whether a treadmill wants them or not. Nothing can be done about that from
# here and it is harmless; it is written down so a scan list is not a surprise.

# The name a phone, Zwift or a BLE scanner shows. IT IS IN THE SCAN RESPONSE,
# not the advertisement: the advertising payload is already 16 bytes of flags,
# a two-UUID16 list and the FTMS Service Data element, leaving 13 for a name -
# too few for a machine name anybody would choose. src/treadmill_ble.c
# BUILD_ASSERTs the 29-character scan-response budget.
#
# NO TRADEMARKED DEFAULT, and that is a decision rather than an oversight:
# docs/decisions/0003 is the home for it and ADR 0017 amends it here. Some apps
# key compatibility off a device name, which makes a plausible-looking default
# an invitation to impersonate somebody's product. An end user renaming their
# own machine on their own initiative is a different act entirely.
CONFIG_BT_DEVICE_NAME="RadiANT Treadmill"

# NOT SET HERE, and their absence is the point:
#
#   CONFIG_RADIANT_BACKEND_NRF_GATE_MPSL=y
#   CONFIG_MPSL_TIMESLOT_SESSION_COUNT=2   (1 for the gate, +1 for D2)
#
# Both are a `select` and a `default` on TREADMILL_BLE in apps/treadmill/Kconfig,
# so turning the BLE branch on carries them with it however it is turned on.
# CMakeLists.txt keeps a FATAL_ERROR backstop for the same interlock approached
# from the other side (CONFIG_BT set without CONFIG_TREADMILL_BLE).
```

## dual.conf
```kconfig
# SPDX-License-Identifier: Apache-2.0
#
# The named dual-radio preset: ANT+ FE-C (0x11) and SDM (0x7C) with FTMS and
# RSC over BLE, and strict product identity. The build a manufacturer ships,
# once a product .conf supplies the identity:
#
#   west build -b <board> apps/treadmill -- \
#     -Dtreadmill_EXTRA_CONF_FILE="dual.conf;product.conf"
#
# (product.conf is your copy of product.conf.example.) THE PREFIX IS THE
# BASENAME OF THIS DIRECTORY - see ble.conf.
#
# ON ITS OWN THIS PRESET FAILS TO CONFIGURE, ON PURPOSE.
# CONFIG_RADIANT_PRODUCT_STRICT refuses the placeholder identity at configure
# time, and at run time a machine whose identity fails to boot stays off the
# air and retries instead of transmitting on the device number every machine
# of the image shares - which in a gym is twenty treadmills a receiver cannot
# tell apart. scripts/build_all.ps1's tread_dual_fail row asserts the
# refusal; tread_dual_* rows build it with tests/product_test.conf.
#
# The BLE lines are ble.conf's (ble.conf is the development variant, without
# strict identity): TREADMILL_BLE selects RADIANT_BLE, SMP and the MPSL gate;
# bonds persist in settings.

CONFIG_TREADMILL_BLE=y
CONFIG_BT=y
CONFIG_BT_PERIPHERAL=y
CONFIG_BT_SETTINGS=y
# 5 key slots = 4 phones: the pairing window keeps one slot spare
# (radiant_ble_pairing.h), so its user-visible capacity is MAX_PAIRED - 1.
CONFIG_BT_MAX_PAIRED=5
CONFIG_RADIANT_PRODUCT_STRICT=y

# Equipment bonding: new pairings only inside a pairing window, LRU eviction
# when the bond store is full (radiant_ble_pairing.h). The console's pairing
# control (TREADMILL_EVT_PAIRING_WINDOW; the simulator's sw3) opens the window
# for TREADMILL_PAIRING_WINDOW_S and a long press forgets every bond. The
# power-on window below stays as a fallback for a console that has no such
# control yet: power-cycle the machine to pair a new phone. Drop it once yours
# does (production checklist item 8).
CONFIG_RADIANT_BLE_PAIRING_WINDOW=y
CONFIG_RADIANT_BLE_PAIRING_WINDOW_AT_BOOT_S=120
```

## fec_only.conf
```kconfig
# One ANT+ master instead of two: FE-C only, no SDM.
#
#   -Dtreadmill_EXTRA_CONF_FILE=fec_only.conf
#
# THE COEXISTENCE FALLBACK, BUILT BEFORE IT IS NEEDED.
#
# Two ANT+ masters plus BLE on one radio is more contention than anything this
# project has measured. The arbiter has been characterised with ONE master
# beside BLE (P8b) and with EIGHT masters beside 802.15.4 (P3.5), but never
# this mix - and the two periods, 8192 and 8134 counts, beat against each other
# with a period of about 32 seconds. If they interact badly the symptom is a
# slow cycle of loss on both channels rather than a steady figure, which is
# exactly the kind of number a short bench run reads as noise.
#
# So this fragment exists to answer "is it the second master?" in one build
# rather than in an afternoon of editing Kconfig. It is not a shipping
# configuration: FE-C alone is invisible to anything that only knows foot pods,
# which includes Zwift Run and most watches.
CONFIG_TREADMILL_ANT_SDM=n
```

## hr_rx.conf
```kconfig
# Phase 5: add the ANT+ heart-rate slave, a THIRD channel.
#
#   -Dtreadmill_EXTRA_CONF_FILE="ble.conf;hr_rx.conf"
#
# Layered on top of whatever else is being built, and the semicolon-list form is
# the one already used elsewhere in this tree for exactly that.
#
# WHAT IT ADDS TO THE RADIO. Two masters transmitting, one slave tracking, and
# possibly a BLE connection - which is the heaviest configuration this
# application has. The slave acquires ONCE and then stops searching, because a
# tracking slave beside two masters is benign and an acquisition sweep beside
# them is what starves the arbiter (ADR 0013). src/treadmill_hr_rx.h explains
# what "strongest strap wins" actually means here, which is a proximity floor
# rather than a sweep, and is honest about the difference.
#
# WHAT IT BUYS. The bpm reaches three consumers from one strap: FE-C page 16
# byte 6 with the HR-source nibble set to ANT+, the FTMS Treadmill Data
# heart-rate field, and a console display when one exists. There is no display
# code in this tree and none is proposed.
CONFIG_TREADMILL_HR_RX=y
```

## source_custom.conf
```kconfig
# Compile NO implementation of the treadmill seam - the integrator's starting
# point.
#
#   -Dtreadmill_EXTRA_CONF_FILE=source_custom.conf
#
# A fragment rather than a bare -DCONFIG_ for the reason ble.conf gives: under
# sysbuild a bare -DCONFIG_x lands in the sysbuild cache and never reaches the
# image.
#
# WHAT THIS BUILD DOES. It links - which is the whole reason it is in CI, since
# an integrator's very first build failing for a reason unrelated to their
# driver is an expensive way to start - and at boot it warns, then
# treadmill_source_start() returns -ENODEV and the node reports a stopped belt
# at zero grade in the READY state, forever, on both ANT+ channels.
#
# THAT IS THE CORRECT FAILURE AND IT IS NOT A BUG. There is deliberately no
# fallback to the simulator: a machine quietly reporting a synthetic runner
# while somebody stands on it is invisible from the receiving end, and one
# reporting a stopped belt is not. On a gym dashboard it reads as "unoccupied",
# which is the safe direction to be wrong in.
#
# Your code calls treadmill_source_register() from a SYS_INIT() before main()
# reaches treadmill_source_start(); see src/treadmill_source.h,
# src/treadmill_source_custom.c and docs/treadmill-reference-design.md.
CONFIG_TREADMILL_SOURCE_CUSTOM=y
```

## boards/nrf52840dk_nrf52840.conf
```kconfig
# nRF52840 DK, as a RadiANT treadmill node.
#
# The other half of the overlay's `zephyr,entropy = &rng`, for the reason
# apps/hrm_ble/boards/nrf52840dk_nrf52840.conf gives: without this the
# CryptoCell entropy driver is still built for the enabled cryptocell node and
# links CryptoCell's platform library for a driver nothing calls (~6.7 KB of
# flash and ~1.9 KB of RAM, measured on hrm_ble).
CONFIG_ENTROPY_CC3XX=n
```

## boards/nrf52840dk_nrf52840.overlay
```dts
/*
 * nRF52840 DK, as a RadiANT treadmill.
 *
 * THE POINT OF THIS BOARD IS THAT IT IS NOT AN nRF54L. radiant's nrf backend
 * has `depends on SOC_COMPATIBLE_NRF52X || SOC_COMPATIBLE_NRF54LX`, and this
 * row is what keeps the nRF52 half of that compiled - on the family most
 * existing ANT+ silicon actually is.
 *
 * BUILD-VERIFIED ONLY, AND ANT+ ONLY. Nothing here has been on a bench, and
 * this application's BLE arm is deliberately NOT built on this part: it would
 * be the first time SDC, MPSL, the gate, two hand-written GATT services and
 * SMP were compiled together on the nRF52 family, which makes it valuable and
 * also makes it the configuration most likely to fail for a reason nobody here
 * can reproduce - there is no nRF52 bench slot for this application.
 * docs/radiant-bridge.md section 11 already rates the part "very tight" for a
 * full build, and this application is heavier than that one. It lands with the
 * first nRF52 bench session, not before it.
 *
 * radiant/Kconfig's own help records that this part's on-air behaviour is
 * predicted from the nRF54L15 measurements rather than confirmed. Do not read a
 * green build here as a working machine.
 */

/ {
	chosen {
		/*
		 * The TIMER radiant's nrf backend owns outright. It runs at
		 * 1 MHz forever and is what t_sync is hardware-captured into
		 * from RADIO's ADDRESS event, so it cannot be shared: naming it
		 * here rather than in the source is what makes a second user a
		 * devicetree conflict instead of two drivers reprogramming
		 * each other's prescaler.
		 *
		 * TIMER4, and the choice is constrained from both ends. The
		 * backend needs FIVE compare/capture channels - t_sync capture,
		 * RX start, window close, software now-capture, TX start - and
		 * on nRF52 only TIMER3 and TIMER4 have more than four, which is
		 * a compile-time #error in radiant_radio_nrf.c rather than
		 * something to discover on the air.
		 *
		 * TIMER4 rather than TIMER3 to match apps/dongle's and
		 * apps/hrm_ble's overlays, so that the nRF52 answer is one
		 * number across this repository rather than three. MPSL on
		 * nRF52 reserves TIMER0 (mpsl_hwres.h), not these.
		 */
		radiant,radio-timer = &timer4;

		/*
		 * The entropy source K_dev is drawn from on first boot (ADR
		 * 0020), for the reason apps/hrm_ble's overlay gives: the RNG
		 * peripheral, not the SoC default &cryptocell, whose driver
		 * links CryptoCell's platform library for one 16-byte draw.
		 */
		zephyr,entropy = &rng;
	};
};

&timer4 {
	status = "okay";
};
```

## boards/nrf54l15dk_nrf54l15_cpuapp.overlay
```dts
/*
 * nRF54L15 DK, as a RadiANT treadmill.
 *
 * THE TARGET PART FOR THIS APPLICATION, and the only one it has been sized
 * against. docs/radiant-bridge.md section 11 rates the nRF52840 as "very
 * tight" for a full build; this application adds two hand-written GATT
 * services, SMP and a bonding store on top of the BLE second stack that
 * the radiant/spike/mpsl_arb spike measured at +78.7 kB flash / +16.0 kB RAM,
 * and phase 5 adds a third ANT+ channel. Watch RAM specifically - the Matter
 * flash spike already established for this project that flash is not the wall,
 * RAM is.
 *
 * Deliberately NOT a copy of the dongle's overlay. That one's whole subject is
 * the ANT serial transport on the second VCOM; a treadmill has no transport at
 * all. It is fitness equipment: the only thing leaving the board over a wire is
 * the log on the console UART, which the board's own devicetree already
 * provides.
 *
 * What IS shared is the one line radiant's nrf backend cannot start without.
 */

/ {
	chosen {
		/*
		 * The TIMER the backend owns outright. It runs at 1 MHz forever
		 * and is what t_sync is hardware-captured into from RADIO's
		 * ADDRESS event, so it cannot be shared - naming it here rather
		 * than in the source is what makes a second user a devicetree
		 * conflict instead of two drivers reprogramming each other's
		 * prescaler.
		 *
		 * timer20 is free on this board, and is `status = "disabled"`
		 * by default like every TIMER on this SoC. An unclocked
		 * peripheral is not addressable, which the backend found once
		 * by taking a bus fault on its first register write.
		 *
		 * IT IS ALSO WHAT P0's TIMER AUDIT WAS ABOUT. mpsl.rst lists
		 * MPSL as owning TIMER10 *and* TIMER20 on nRF54L, while
		 * mpsl_hwres.h reserves only TIMER10. Measured: TIMER20 does not
		 * collide, and TIMER22 behaves identically. If a future MPSL
		 * revision does claim it, this is the line that moves.
		 */
		radiant,radio-timer = &timer20;
	};
};

&timer20 {
	status = "okay";
};
```

## boards/nrf54lm20dk_nrf54lm20a_cpuapp.overlay
```dts
/*
 * nRF54LM20A DK, as a RadiANT treadmill.
 *
 * The same family as the nRF54L15 and the same answer, which is why this file
 * is short: SOC_COMPATIBLE_NRF54LX covers both, the peripheral map is the same
 * shape, and TIMER20 is free on both. It earns its place by proving that the
 * family is a family rather than by exercising anything new - and, for this
 * application specifically, by being the part with the most RAM, which is the
 * wall this build is closest to.
 *
 * BUILD-VERIFIED ONLY, and there is no LM20 on this bench. See
 * apps/dongle/boards/nrf54lm20dk_nrf54lm20a_cpuapp.conf for what else about
 * this part is untested.
 */

/ {
	chosen {
		/*
		 * The TIMER the backend owns outright, hardware-capturing
		 * t_sync from RADIO's ADDRESS event. See the nRF54L15 DK
		 * overlay beside this one for the full reasoning, including
		 * P0's TIMER audit: mpsl.rst lists MPSL as owning TIMER10 and
		 * TIMER20 on nRF54L while mpsl_hwres.h reserves only TIMER10,
		 * and TIMER20 was measured not to collide - ON THE L15. That
		 * measurement has not been repeated on this part, so if a
		 * timeslot build here misbehaves, this is the first line to
		 * suspect and TIMER22 is the alternative that behaved
		 * identically on the L15.
		 */
		radiant,radio-timer = &timer20;
	};
};

&timer20 {
	status = "okay";
};
```

## src/treadmill_ble.h
```c
/*
 * SPDX-License-Identifier: Apache-2.0
 *
 * treadmill_ble.h - the BLE half: FTMS (0x1826) and RSC (0x1814) beside two
 * ANT+ masters on one radio.
 *
 * The FTMS service is radiant's shared core (<radiant/radiant_ble_ftms.h>);
 * treadmill_ble.c plugs the treadmill into it. This file is what main.c calls
 * and what it implements in return.
 */

#ifndef TREADMILL_BLE_H_
#define TREADMILL_BLE_H_

#include <stdbool.h>
#include <stdint.h>

#include "treadmill_caps.h"
#include "treadmill_session.h"

struct treadmill_state;

/* Bring the controller up, publish both services, set the Device Information
 * Service from radiant_product and the unit's 32-bit `serial`, and start
 * advertising through radiant_ble_adv (which keeps it running across
 * connections). With CONFIG_RADIANT_BLE_NAME_DEVNUM_SUFFIX the name is
 * "<name> <devnum>". Called last from main(), after both ANT+ channels are
 * open, so a failure to advertise cannot be mistaken for a failure to
 * transmit. `caps` (treadmill_caps.c) is what FTMS's Feature characteristic
 * declares and which target op codes are honoured. */
int treadmill_ble_start(uint16_t devnum, uint32_t serial, const struct treadmill_caps *caps);

/* From the node tick: the advertising watchdog. */
void treadmill_ble_tick(void);

/* True while at least one central is connected. Exposed for the log and for a
 * future policy; NOTHING in this application suppresses ANT+ on it, and that
 * is a decision rather than an omission - see main.c's header.
 *
 * IT IS ALSO NOT THE ARBITRATION INPUT, and using it as one would be the
 * natural mistake. Whether a phone is CONNECTED and whether it OWNS THE DECK
 * are different facts: a phone can be connected for a whole session reading
 * Treadmill Data and never once run Request Control, and gating an FE-C
 * controller on this would lock it out for exactly that phone.
 * radiant_ctrl_owner() is the question the control paths ask. */
bool treadmill_ble_connected(void);

/*
 * The state changed. Called from the workqueue on every node tick and on every
 * source report; this module decides for itself how often to actually notify,
 * because FTMS fixes the Treadmill Data rate at "typically once per second"
 * and the client cannot configure it.
 */
void treadmill_ble_state_changed(const struct treadmill_state *s);

/*
 * The session moved (main.c, on the workqueue): Training Status and the
 * machine status it owes go to every FTMS subscriber. `revoke` (a safety-key
 * pull) also takes FTMS control away, with 0xFF to the client that had it.
 */
void treadmill_ble_session_changed(enum treadmill_run prev, enum treadmill_run next,
				   bool revoke);

/* The target incline changed through FE-C page 51 or the grade provider:
 * FTMS subscribers get 0x06 Target Incline Changed, as for an FTMS change. */
void treadmill_ble_target_incline_changed(int32_t centi_pct);

/*
 * THE ZWIFT SEAM: specified, and deliberately not built.
 *
 * An optional hook a future module can register to supply grade from somewhere
 * other than the FTMS control point. If one is registered it is asked on every
 * notify tick for a grade in 0.01 % - FE-C's unit, the finer of the two - and
 * anything other than INT32_MIN replaces whatever the control point last set.
 * INT32_MIN means "no opinion this tick", which a provider that only has a
 * grade sometimes needs and which 0 could not express (0 is flat).
 *
 * WHY IT IS EMPTY. Zwift's native treadmill incline does not travel over FTMS
 * at all: it sends route grade to a KICKR RUN over a *proprietary Wahoo
 * service*, not over `Set Target Inclination` and not over FE-C. The protocol
 * is undocumented, and implementing it would need its own ADR in the shape of
 * docs/decisions/0002-clean-room-policy.md - which is the same ruling
 * docs/ble-running-dynamics-notes.md already carries for the Garmin BLE path.
 * So the seam is named, the shape is fixed, and nothing ships behind it.
 *
 * Returns 0, or -EEXIST if one is already registered (same rule as the source
 * seam: exactly one wins, loudly).
 */
typedef int32_t (*treadmill_ble_grade_provider_t)(void *user);

int treadmill_ble_grade_provider_register(treadmill_ble_grade_provider_t fn,
					  void *user);

/* ---------------------------------------------------------------------------
 * Implemented by main.c.
 * ---------------------------------------------------------------------------
 *
 * The actuating calls that used to be here (treadmill_node_set_*()) are gone:
 * every path that moves the machine is in treadmill_cmd.c, behind the motion
 * rule, and the FTMS core reaches it through the hooks treadmill_ble.c
 * registers.
 */

/* The live state, for the encoders. Read-only, system workqueue. */
const struct treadmill_state *treadmill_node_state(void);

/* The session, for Training Status. Read-only, system workqueue. */
const struct treadmill_session *treadmill_node_session(void);

/* An FTMS Reset succeeded: return the session to IDLE and bump the epoch,
 * without a second FTMS status (the core has notified Reset). Workqueue. */
void treadmill_node_session_reset(void);

/* The session epoch, from ANY thread (an atomic mirror): FTMS records it when
 * a Control Point write is received, on the BT RX thread. */
uint32_t treadmill_node_epoch(void);

#endif /* TREADMILL_BLE_H_ */
```

## src/treadmill_caps.c
```c
/*
 * SPDX-License-Identifier: Apache-2.0
 *
 * treadmill_caps.c - see treadmill_caps.h. Kernel-free.
 */

#include <radiant/radiant_ble_ftms.h>

#include "treadmill_caps.h"

/* The data fields the Treadmill Data record always carries
 * (treadmill_ftms_data.c), keyed to their feature bits. */
#define FMF_ALWAYS (RADIANT_BLE_FTMS_FMF_TOTAL_DISTANCE | RADIANT_BLE_FTMS_FMF_INCLINATION | \
		    RADIANT_BLE_FTMS_FMF_ELEVATION_GAIN | RADIANT_BLE_FTMS_FMF_ELAPSED_TIME)

void treadmill_caps_derive(const struct treadmill_source_caps *src,
			   const struct treadmill_caps_cfg *cfg,
			   struct treadmill_caps *out)
{
	*out = (struct treadmill_caps){ 0 };

	out->speed_cmd = src->set_speed && cfg->allow_speed;
	out->incline_cmd = src->set_incline && cfg->allow_incline;
	out->heart_rate = cfg->heart_rate;

	out->ftms_features = FMF_ALWAYS;
	if (out->heart_rate) {
		out->ftms_features |= RADIANT_BLE_FTMS_FMF_HEART_RATE;
	}
	if (out->speed_cmd) {
		out->ftms_targets |= RADIANT_BLE_FTMS_TSF_SPEED;
	}
	if (out->incline_cmd) {
		out->ftms_targets |= RADIANT_BLE_FTMS_TSF_INCLINATION;
	}
	out->fec_simulation = out->incline_cmd;
}
```

## src/treadmill_caps.h
```c
/*
 * SPDX-License-Identifier: Apache-2.0
 *
 * treadmill_caps.h - WHAT THE MACHINE ADVERTISES, derived from what its driver
 * can do.
 *
 * A capability bit is a claim that a command will be honoured: FTMS Target
 * Setting bit 0 with op code 0x02, bit 1 with 0x03 (§4.16.2 makes each pair
 * conditionally mandatory/excluded together), FE-C page 54's Simulation bit
 * with page 51. Declaring one and refusing its command is how a controller
 * decides a machine is broken. So the bits are computed, once at boot, from
 * which source entry points are non-NULL, and Kconfig can only take one away
 * (CONFIG_TREADMILL_CAP_*_TARGET). The FTMS Heart Rate feature (and the
 * Treadmill Data heart-rate field) exist only with an ANT+ strap receiver
 * (CONFIG_TREADMILL_HR_RX): without one the field could only ever be empty.
 *
 * Kernel-free.
 */

#ifndef TREADMILL_CAPS_H_
#define TREADMILL_CAPS_H_

#include <stdbool.h>
#include <stdint.h>

#include "treadmill_source.h"

#ifdef __cplusplus
extern "C" {
#endif

struct treadmill_caps_cfg {
	bool allow_speed;   /* CONFIG_TREADMILL_CAP_SPEED_TARGET */
	bool allow_incline; /* CONFIG_TREADMILL_CAP_INCLINE_TARGET */
	bool heart_rate;    /* CONFIG_TREADMILL_HR_RX */
};

struct treadmill_caps {
	bool speed_cmd;      /* FTMS 0x02 honoured */
	bool incline_cmd;    /* FTMS 0x03 and FE-C page 51 honoured */
	bool heart_rate;     /* HR feature bit and Treadmill Data field */
	uint32_t ftms_features; /* Fitness Machine Features */
	uint32_t ftms_targets;  /* Target Setting Features */
	bool fec_simulation; /* FE-C page 54 Simulation mode bit */
};

void treadmill_caps_derive(const struct treadmill_source_caps *src,
			   const struct treadmill_caps_cfg *cfg,
			   struct treadmill_caps *out);

#ifdef __cplusplus
}
#endif

#endif /* TREADMILL_CAPS_H_ */
```

## src/treadmill_cmd.h
```c
/*
 * SPDX-License-Identifier: Apache-2.0
 *
 * treadmill_cmd.h - EVERY PATH THAT CAN MOVE THE MACHINE, in one file.
 *
 * This is the only module that includes treadmill_source_ctrl.h, and every one
 * of its calls into the source's actuating entry points sits in one of four
 * DOORS - treadmill_cmd_drive_speed/_incline/_start/_stop - each of which calls
 * treadmill_motion_permitted() on its first line and returns before the source
 * if it refuses. The paths:
 *
 *   FE-C page 51                 treadmill_cmd_fec_track_resistance()
 *   FE-C page 50                 treadmill_cmd_fec_wind()   (moves nothing)
 *   the BLE grade provider       treadmill_cmd_grade_provider()
 *   FTMS Set Target Speed        treadmill_cmd_ftms_set_target()  (0x02)
 *   FTMS Set Target Inclination  treadmill_cmd_ftms_set_target()  (0x03)
 *   FTMS Start/Resume, Stop/Pause treadmill_cmd_ftms_workout()
 *   FTMS Reset                   treadmill_cmd_ftms_reset()
 *   FTMS motion authorisation    treadmill_cmd_ftms_auth()  (the core asks
 *                                before it executes; the doors ask again with
 *                                the epoch recorded at receipt)
 *
 * Kernel-free: no Zephyr header, no lock, no clock. System workqueue only,
 * like the state and the session it is bound to. apps/treadmill/tests/pages
 * links it against a fake source and the real arbiter.
 */

#ifndef TREADMILL_CMD_H_
#define TREADMILL_CMD_H_

#include <stdbool.h>
#include <stdint.h>

#include <radiant/radiant_ble_ftms.h>
#include <radiant/radiant_ctrl_arbiter.h>

#include "treadmill_session.h"
#include "treadmill_state.h"

#ifdef __cplusplus
extern "C" {
#endif

/*
 * The node's state and session, and the arbiter:
 *
 *   ctrl_owner  radiant_ctrl_owner under exclusive arbitration; NULL means no
 *               arbitration (TREADMILL_CTRL_POLICY_NONE) and every token holds.
 *   fec_claim   the FE-C implicit claim (radiant_ctrl_claim(ANT, false, now)
 *               == 0); NULL means no arbitration. Called only AFTER a page has
 *               passed the epoch check, so a stale page cannot re-claim.
 *
 * `incline_cmd` and `speed_cmd` are the DERIVED capabilities (treadmill_caps.c):
 * a capability the machine does not advertise is refused as not supported
 * before anything else.
 */
struct treadmill_cmd_cfg {
	struct treadmill_state *state;
	struct treadmill_session *session;
	enum radiant_ctrl_src (*ctrl_owner)(void);
	bool (*fec_claim)(void);
	bool incline_cmd;
	bool speed_cmd;
};

void treadmill_cmd_bind(const struct treadmill_cmd_cfg *cfg);

/* (d) for an FTMS path and for the grade provider: the arbiter's owner is BLE
 * (the FTMS core has separately checked this client holds FTMS control). The
 * grade provider uses the same token as FTMS, never a weaker one. */
bool treadmill_cmd_ftms_token(void);
bool treadmill_cmd_grade_token(void);

/*
 * FE-C page 51, a simulation grade in 0.01 % (the 0xFFFF "assume flat"
 * sentinel already decoded to 0), received under `rx_epoch`. In order:
 * NOT_SUPPORTED without the incline capability (the page is then ungated);
 * REJECTED if the epoch moved since receipt (before any claim); REJECTED if
 * the implicit claim fails; REJECTED if the motion rule refuses; then the
 * clamped grade goes to the source (PASS / NOT_SUPPORTED / FAIL).
 */
uint8_t treadmill_cmd_fec_track_resistance(int32_t grade_centi, uint32_t rx_epoch);

/* FE-C page 50: moves nothing, but it is half of the simulation parameter set
 * and follows page 51's capability, epoch and claim answers. */
uint8_t treadmill_cmd_fec_wind(uint32_t rx_epoch);

/* The BLE grade provider's value, 0.01 %, a simulation grade like page 51.
 * 0 when applied, -EACCES/-ECANCELED when the rule refuses it (the value is
 * DROPPED), -ENOTSUP without the incline capability, else the source's rc. */
int treadmill_cmd_grade_provider(int32_t grade_centi);

/* The FTMS machine hooks (struct radiant_ble_ftms_ops / _auth). `epoch` is the
 * session epoch at receipt; `ctx` is unused. */
int treadmill_cmd_ftms_set_target(struct radiant_ble_ftms_target *t, uint32_t epoch,
				  void *ctx);
int treadmill_cmd_ftms_workout(enum radiant_ble_ftms_workout w, uint32_t epoch, void *ctx);
int treadmill_cmd_ftms_reset(bool motion_ok, uint32_t epoch, void *ctx);
enum radiant_ble_ftms_verdict treadmill_cmd_ftms_auth(const struct radiant_ble_ftms_motion *m,
						      const struct radiant_ble_ftms_session *s,
						      void *ctx);

/*
 * THE FOUR DOORS to the source. Public so their own gate can be tested
 * directly; nothing outside this module calls them. Each returns the gate's
 * refusal, or the source's answer.
 */
int treadmill_cmd_drive_speed(enum treadmill_motion_kind kind, uint32_t mm_s, uint32_t epoch,
			      bool token);
int treadmill_cmd_drive_incline(enum treadmill_motion_kind kind, int32_t centi, uint32_t epoch,
				bool token);
int treadmill_cmd_drive_start(bool resume, uint32_t epoch, bool token);
int treadmill_cmd_drive_stop(bool pause);

#ifdef __cplusplus
}
#endif

#endif /* TREADMILL_CMD_H_ */
```

## src/treadmill_control.c
```c
/*
 * SPDX-License-Identifier: Apache-2.0
 *
 * The control-owner token. See treadmill_control.h for the policy and for why
 * this file has no kernel in it.
 */

#include <errno.h>

#include "treadmill_control.h"

/*
 * One owner, and the instant it last did something. `last_ms` is only ever
 * consulted for an ANT owner: a BLE claim is released by an event (Reset, or a
 * disconnect) and must NOT lapse on a timer, because a phone that has connected
 * and taken control is still there whether or not it has commanded anything
 * this minute. Expiring it would hand the machine back to a head unit
 * mid-workout with the phone still on screen showing that it owns the deck.
 */
static enum treadmill_ctrl_src ctrl_owner;
static uint32_t                ctrl_last_ms;
static uint32_t                ctrl_ant_timeout_ms;

void treadmill_control_init(uint32_t ant_timeout_ms)
{
	ctrl_owner = TREADMILL_CTRL_NONE;
	ctrl_last_ms = 0u;
	ctrl_ant_timeout_ms = ant_timeout_ms;
}

int treadmill_control_claim(enum treadmill_ctrl_src src, bool explicit_req,
			    uint32_t now_ms)
{
	if (src == TREADMILL_CTRL_NONE) {
		return -EACCES;
	}

	if (ctrl_owner == src) {
		/* A refresh, which is the common case: every FE-C command page
		 * from the owning controller pushes the idle timeout out. */
		ctrl_last_ms = now_ms;
		return 0;
	}

	if (ctrl_owner != TREADMILL_CTRL_NONE && !explicit_req) {
		/* Somebody else has it and this is a claim inferred from the
		 * mere act of commanding. Refused - and the caller owes the
		 * refusal an answer on the wire. */
		return -EACCES;
	}

	/* Free, or an explicit acquire preempting an implicit holder. */
	ctrl_owner = src;
	ctrl_last_ms = now_ms;
	return 0;
}

void treadmill_control_release(enum treadmill_ctrl_src src)
{
	if (ctrl_owner == src) {
		ctrl_owner = TREADMILL_CTRL_NONE;
	}
}

void treadmill_control_tick(uint32_t now_ms)
{
	if (ctrl_owner != TREADMILL_CTRL_ANT || ctrl_ant_timeout_ms == 0u) {
		return;
	}

	/*
	 * Unsigned subtraction, so a wrapped k_uptime_get_32() (49.7 days)
	 * still yields the true elapsed interval rather than a huge one that
	 * would drop the claim instantly. Same idiom as treadmill_ble.c's
	 * notify pacing, and for the same reason.
	 */
	if ((now_ms - ctrl_last_ms) >= ctrl_ant_timeout_ms) {
		ctrl_owner = TREADMILL_CTRL_NONE;
	}
}

enum treadmill_ctrl_src treadmill_control_owner(void)
{
	return ctrl_owner;
}

bool treadmill_control_page_is_gated(uint8_t fec_page)
{
	return (fec_page == TREADMILL_CTRL_PAGE_TRACK_RESISTANCE) ||
	       (fec_page == TREADMILL_CTRL_PAGE_WIND_RESISTANCE);
}
```
