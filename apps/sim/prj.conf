## CMakeLists.txt
```
# SPDX-License-Identifier: Apache-2.0

cmake_minimum_required(VERSION 3.20.0)

# Same sdk-ant handling as apps/common/ant_radio_backend.cmake, and
# deliberately a copy rather than an include: the two applications are built
# independently and `west build apps/sim` must not depend on the dongle's
# build files existing or being current.
#
# The duplication is why the resolution order below has to be spelled out twice
# rather than factored into a shared .cmake file: a factored version would be a
# file in the dongle's tree that apps/sim includes, which reintroduces exactly
# the dependency this copy exists to avoid. Keep the two blocks in step by hand
# - they are short, and the only thing that differs is the number of `..`
# needed to reach a sibling checkout (this file is one directory deeper) and
# the application name in the messages.
#
# Unlike the dongle, this one genuinely cannot build without the module - the
# profile libraries and the radio both come from it, and there is no stub
# equivalent here.
if(DEFINED ENV{SDK_ANT_DIR})
  file(TO_CMAKE_PATH "$ENV{SDK_ANT_DIR}" ANT_MODULE_DIR_DEFAULT)
else()
  set(ANT_MODULE_DIR_DEFAULT "${CMAKE_CURRENT_SOURCE_DIR}/../../../sdk-ant")
endif()

set(ANT_MODULE_DIR "${ANT_MODULE_DIR_DEFAULT}" CACHE PATH
    "Path to the sdk-ant Zephyr module (the directory holding zephyr/module.yml)")

if(EXISTS "${ANT_MODULE_DIR}/zephyr/module.yml")
  message(STATUS "ant_sim: sdk-ant module at ${ANT_MODULE_DIR}")
  list(APPEND ZEPHYR_EXTRA_MODULES "${ANT_MODULE_DIR}")
else()
  message(FATAL_ERROR
    "ant_sim: no sdk-ant module at '${ANT_MODULE_DIR}'.\n"
    "This application is built entirely out of sdk-ant's ANT+ profile "
    "libraries and its radio, so there is nothing to build without it. Either "
    "set the SDK_ANT_DIR environment variable to the sdk-ant checkout (the "
    "per-machine setting, shared with the dongle application), or pass "
    "-DANT_MODULE_DIR=<path> for a single build. Both must point at the "
    "directory that contains zephyr/module.yml.\n"
    "With neither set, the default is a sibling checkout at "
    "'${CMAKE_CURRENT_SOURCE_DIR}/../../../sdk-ant'. In a west workspace, "
    "`west config manifest.group-filter +ant && west update` puts it there.")
endif()

find_package(Zephyr REQUIRED HINTS $ENV{ZEPHYR_BASE})
project(ant_sim)

target_sources(app PRIVATE
  src/main.c
  src/sim_signal.c
)
```

## Kconfig
```
#
# ANT+ sensor simulator.
#
# One prefix for the whole application, ANT_SIM_*, the same way the dongle uses
# ANT_DONGLE_*. The two never build together, but a shared prefix would make a
# grep for "which application does this symbol belong to" ambiguous, and the
# answer to that question is how the sysbuild and CI assertions stay honest.
#

source "Kconfig.zephyr"

menuconfig ANT_SIM
	bool "ANT+ sensor simulator"
	select ANT
	select ANT_KEY_MANAGER
	select ANT_CHANNEL_CONFIG
	select ANT_STATE_INDICATOR
	select DK_LIBRARY
	default y
	help
	  Transmits as a realistic ANT+ sensor so a dongle can be tested
	  without owning one. Not a dongle build: this application has no USB
	  and no serial bridge.

if ANT_SIM

choice ANT_SIM_PROFILE
	prompt "Sensor profile to transmit"
	default ANT_SIM_PROFILE_BPWR_STANDARD

config ANT_SIM_PROFILE_BPWR_STANDARD
	bool "Bicycle power, standard power page 0x10"
	select ANT_BPWR
	help
	  The page every power meter emits. Instantaneous power, accumulated
	  power and cadence, one power event per message.

config ANT_SIM_PROFILE_BPWR_CRANK_TORQUE
	bool "Bicycle power, crank torque page 0x12"
	select ANT_BPWR
	help
	  Power carried as accumulated torque and accumulated crank period,
	  with one event per crank revolution rather than one per message. At
	  80 rpm that is roughly one message in three, which is the case a
	  receiver's delta arithmetic has to survive.

config ANT_SIM_PROFILE_BPWR_WHEEL_TORQUE
	bool "Bicycle power, wheel torque page 0x11"
	select ANT_BPWR
	help
	  The same arithmetic against wheel revolutions at road speed. Torque
	  is lower for the same power, so a receiver that confuses this page
	  with 0x12 is wrong by the gear ratio rather than obviously wrong.

config ANT_SIM_PROFILE_BSC_COMBINED
	bool "Combined speed and cadence, device type 0x79"
	select ANT_BSC
	help
	  Cadence event time and crank revolutions alongside speed event time
	  and wheel revolutions, in a page that carries no page number at all.

endchoice

menu "Signal"

config ANT_SIM_TARGET_WATTS
	int "Target power, watts"
	default 100
	range 0 2000
	help
	  Held, not swept. A receiver cannot be shown to be right about a value
	  that never settles, which is what the stock sdk-ant simulators
	  produce.

config ANT_SIM_TARGET_RPM
	int "Target cadence, rpm"
	default 80
	range 0 254
	help
	  254 is the maximum: 255 is the profile's "cadence not reported"
	  sentinel, and a target that reached it would turn cadence off rather
	  than report a very fast rider.

config ANT_SIM_WHEEL_RPM
	int "Wheel speed, rpm"
	default 238
	range 0 1000
	help
	  Used by the wheel torque page and by the speed half of the combined
	  page. 238 rpm is 30 km/h on a 2.105 m wheel.

config ANT_SIM_NOISE
	int "Noise band, plus or minus, on both signals"
	default 3
	help
	  Zero makes every delta identical, which hides an accumulator that is
	  recomputed from the target instead of accumulated.

config ANT_SIM_SEED
	int "Seed for the noise generator"
	default 1
	help
	  A run that cannot be replayed is not a measurement. Zero is accepted
	  and replaced internally, because xorshift is dead at zero.

endmenu

menu "Channel"

config ANT_SIM_CHANNEL_NUM
	int "ANT channel number"
	default 0

config ANT_SIM_NETWORK_NUM
	int "ANT+ network number"
	default 0

config ANT_SIM_DEVICE_NUMBER
	int "Channel ID: device number"
	default 14871
	range 1 65535
	help
	  Matches tools/ant_sim.py's default (0x3A17), so a capture from either
	  transmitter carries the same identity and the two are directly
	  comparable. Zero is excluded: on a channel ID it is the wildcard.

	  This is the TIER 0 number: provisioned once and stable thereafter.
	  Generate one with `tools/ant_identity.py provision` and set it here
	  rather than shipping the same number on every unit - a device number
	  that is a factory serial ties the node to a purchase record, a
	  warranty and a previous owner, and that is what the identity tiers in
	  docs/radiant-security.md section 4 exist to correct.

	  Avoid numbers with a long alternating bit run in the on-air address:
	  nRF-based receivers lose up to ~5 % of their frames (ADR 0019). Check
	  one with `tools/ant_identity.py check <number>`, which provisioning
	  already does for you. This image is built on sdk-ant, so it cannot
	  warn at run time the way a RadiANT image does, and its Tier 2 random
	  roll does not avoid them either.

config ANT_SIM_IDENTITY_TIER_2
	bool "Tier 2: re-roll the device number at every power-up"
	default n
	select ENTROPY_GENERATOR
	help
	  Take a fresh random device number on every boot, instead of using
	  ANT_SIM_DEVICE_NUMBER. This is identity Tier 2 in
	  docs/radiant-security.md section 4.

	  IT SILENTLY LOSES STANDARD RECEIVERS. A Garmin head unit or Zwift
	  pairs by device number, so every session looks like a new sensor and
	  the user has to re-pair. That is the cost, it is why the tier is
	  off by default, and it is why the tier is RadiANT-device-types-only
	  in the specification.

	  A keyed RadiANT receiver does NOT re-pair: it wildcard-searches its
	  device type and confirms identity by whether X_AUTH verifies under
	  its key. Resolution happens once at acquisition rather than every 128
	  seconds, which is the entire reason this is affordable and continuous
	  rotation was not.

	  Tier 1 - re-roll on explicit user action - has no expression here:
	  this application has no non-volatile storage, so "re-roll and keep
	  the new number" cannot be honoured across a reset. Provision a new
	  number with `tools/ant_identity.py reroll` and rebuild, which is the
	  same thing at a simulator's granularity.

	  Selects ENTROPY_GENERATOR rather than falling back to a weak source:
	  a device number an attacker can enumerate is not a re-roll.

config ANT_SIM_PRIVACY_PAGES
	bool "Emit the privacy common pages"
	default n
	help
	  Page 81 carries the not-supplied serial sentinel (0xFFFFFFFF) instead
	  of ANT_SIM_SERIAL_NUM.

	  This matters more than the device number does. A 32-bit globally
	  unique serial broadcast in the clear every 30 seconds is STRICTLY
	  MORE IDENTIFYING than a 16-bit device number, and it is unaffected by
	  any re-roll - so a Tier 2 node that keeps broadcasting its serial has
	  not changed identity, it has added a field. See
	  docs/radiant-security.md section 5.4, where the rule is normative and
	  independent of every security switch.

	  Page 82 is not emitted by this application at all, which is the other
	  half of the rule already satisfied, and ANT_SIM_MFG_ID already
	  defaults to the generic development id rather than to somebody
	  else's.

config ANT_SIM_TRANS_TYPE
	int "Channel ID: transmission type"
	default 5
	range 1 255
	help
	  5 throughout this project - tools/ant_sim.py, this application, and
	  the master path in zephyr_aerosense. The profile permits others; what
	  matters is that everything here picks the same one.

config ANT_SIM_RF_FREQ
	int "RF frequency, MHz above 2400"
	default 57
	range 0 124
	help
	  57 is 2457 MHz, the ANT+ public network frequency, and is the only
	  value at which this simulator is a valid ANT+ sensor. Leave it there
	  for any test of what a dongle will do in the field.

	  Change it only to answer one question: whether packet loss on the
	  bench is the radio environment or the boards. 2457 MHz is inside
	  Wi-Fi channel 11 and shared with every other ANT+ device in range,
	  so a run there measures the room as much as the dongle. Repeating a
	  run somewhere quiet - 2 or 78, either end of the band and clear of
	  Wi-Fi 1, 6 and 11 - separates the two. Loss that vanishes was the
	  room; loss that follows is worth chasing.

	  tools/ant_verify.py --rf-freq has to be given the same number, or
	  the two are not on the same channel and nothing is heard at all.

config ANT_SIM_TX_POWER
	int "Transmit power level"
	default 3
	range 0 5
	help
	  sdk-ant's levels: 0 is -20 dBm, 1 is -12, 2 is -4, 3 is 0 dBm and
	  the ANT default, 4 is +4 dBm. Level 5 (+8 dBm) exists only on the
	  nRF52820, nRF52833 and nRF52840 and is refused elsewhere.

	  THAT RESULT IS REGIME-DEPENDENT AND THE PARAGRAPH BELOW OVERSTATES
	  IT. Read this first.

	  Changing this does not measurably change packet loss WHEN THE LINK
	  ALREADY HAS MARGIN. Across 300 s runs at -12, 0 and +4 dBm - a 16 dB
	  spread - loss stayed between 0.85 and 1.37 %, which is the
	  run-to-run spread of the 0 dBm setting on its own. Loss that
	  survives 16 dB is not a link-budget problem: it is other traffic
	  landing on top of a 150 us slot, and a slot that is occupied is
	  occupied at any power.

	  BUT THAT WAS MEASURED AT ~1 % LOSS, and it does not generalise to a
	  marginal link. Re-measured 2026-08-15 on an nRF54L15 DK master
	  against an unchanged Feather receiver, in a room where the same rig
	  was losing 5-8 %:

	      level 3 (0 dBm)   4.87 / 7.04 / 7.23 / 7.94 %   -53..-55 dBm
	      level 4 (+4 dBm)  3.07 / 2.22 %                 -49 dBm

	  One rebuild, nothing else changed. Power more than halved the loss,
	  and it halved the RUN-TO-RUN SPREAD too, from 3.07 pp to 0.85 pp -
	  which is what tools/ab_gates.toml's repeat_a_max_delta_pp actually
	  gates on. So when loss is already near the floor, power is
	  irrelevant and the paragraph above holds; when the link is short of
	  margin, power is the first thing to check and the paragraph above
	  will send you looking in the wrong place.

	  Note level 5 (+8 dBm) is nRF52-only, so an nRF54L master CANNOT
	  reach the power a Feather master can. That is a concrete reason to
	  prefer the Feather as the transmitter for any loss baseline, and it
	  is what docs/radiant-bridge.md section 7.4.3 asks for in as many
	  words.

	  Those figures were taken before a host-side USB read timeout was
	  found to be inventing about 0.4 points of loss on every run, so they
	  are all too high by roughly the same amount - see the README. The
	  error is common to all three, so the comparison they were made for
	  survives it. The real floor on that bench is nearer 0.4 %.

	  There is now a number behind the reasoning rather than an argument.
	  ant_verify.py asks for RSSI and reports it: the two boards on a desk
	  sit near -28 dBm against a tracking threshold around -90, so there
	  is some 60 dB of margin and this knob spans 16. Loss measured within
	  one run went the wrong way against signal strength as the room
	  changed - more of it in the strongest stretch, none in the weakest -
	  which is not what running out of signal looks like.

	  So this is here to rule that out, not to tune it. A real power meter
	  runs at 0 dBm and a dongle has to work with one, which is what level
	  3 leaves you testing.

endmenu

menu "Bench"

config ANT_SIM_DROPOUT_EVERY_S
	int "Seconds between deliberate dropouts, 0 disables"
	default 0
	help
	  Every this many seconds, close the channel for ANT_SIM_DROPOUT_S
	  seconds and reopen it - an exact, timer'd gap unlike a power-cycle
	  or a bench operator's stopwatch, for tools/ant_verify.py's
	  --expect-dropout SECONDS mode (T2) to measure reacquire_s against.

	  0 (the default) never drops the channel; every existing sitting is
	  unaffected.

config ANT_SIM_DROPOUT_S
	int "Dropout duration, seconds"
	default 10
	range 1 60
	help
	  How long the channel stays closed each time ANT_SIM_DROPOUT_EVERY_S
	  fires. Ignored when ANT_SIM_DROPOUT_EVERY_S is 0.

	  Must match tools/ant_verify.py's --expect-dropout argument exactly,
	  or reacquire_s is computed against the wrong duration and reads
	  wrong in a way that looks like a real number.

	  The sitting default this project uses is EVERY=90, D=10 over a
	  240 s run (two dropouts, deliberately under ab_gates.toml's
	  min_seconds=300 for the loss gate, so a dropout run can never leak
	  into it).

endmenu

menu "Product information"

config ANT_SIM_HW_VERSION
	int "Hardware revision"
	default 1
	range 0 255

config ANT_SIM_MFG_ID
	int "Manufacturer ID"
	default 255
	range 0 65535
	help
	  255 is the development manufacturer id. Borrowing a real one would
	  make this sensor claim to be somebody's product.

config ANT_SIM_MODEL_NUM
	int "Model number"
	default 1
	range 0 65535

config ANT_SIM_SW_VERSION
	int "Software version"
	default 1
	range 0 255

config ANT_SIM_SERIAL_NUM
	int "Serial number"
	default 5526867
	range 0 2147483647

config ANT_SIM_CALIBRATION_DATA
	int "Calibration data returned to a display that asks"
	default 21930
	range 0 65535

endmenu

endif # ANT_SIM
```

## sample.yaml
```
sample:
  description: >
    ANT+ sensor simulator - transmits as a realistic power meter or
    speed-and-cadence sensor so an ANT+ dongle can be tested without one.
  name: ANT+ sensor simulator
tests:
  # Every profile is built, not just the default. The four differ only by a
  # Kconfig choice, so three of them would otherwise never be compiled - and
  # the one that is hardest to get right, the combined page, is not the
  # default.
  sample.ant_sim.bpwr_standard:
    sysbuild: true
    platform_allow:
      - nrf52840dk/nrf52840
      - nrf54l15dk/nrf54l15/cpuapp
      - nrf54lm20dk/nrf54lm20a/cpuapp
    integration_platforms:
      - nrf54l15dk/nrf54l15/cpuapp
    tags: ant
    build_only: true
    extra_args: CONFIG_ANT_SIM_PROFILE_BPWR_STANDARD=y
  sample.ant_sim.bpwr_crank_torque:
    sysbuild: true
    platform_allow:
      - nrf54l15dk/nrf54l15/cpuapp
    integration_platforms:
      - nrf54l15dk/nrf54l15/cpuapp
    tags: ant
    build_only: true
    extra_args: CONFIG_ANT_SIM_PROFILE_BPWR_CRANK_TORQUE=y
  sample.ant_sim.bpwr_wheel_torque:
    sysbuild: true
    platform_allow:
      - nrf54l15dk/nrf54l15/cpuapp
    integration_platforms:
      - nrf54l15dk/nrf54l15/cpuapp
    tags: ant
    build_only: true
    extra_args: CONFIG_ANT_SIM_PROFILE_BPWR_WHEEL_TORQUE=y
  sample.ant_sim.bsc_combined:
    sysbuild: true
    platform_allow:
      - nrf54l15dk/nrf54l15/cpuapp
    integration_platforms:
      - nrf54l15dk/nrf54l15/cpuapp
    tags: ant
    build_only: true
    extra_args: CONFIG_ANT_SIM_PROFILE_BSC_COMBINED=y
```

## prj.conf
```kconfig
# ANT+ sensor simulator.
#
# Nothing here is shared with the dongle's prj.conf on purpose. This build has
# no USB, no serial bridge and no partition-manager constraints; it is a
# sensor, and the only thing the two applications have in common is the radio.

CONFIG_ANT=y

# The evaluation licence key for the ANT stack on single-core parts. This is
# the stack's *licence*, not the ANT+ *network* key - a different thing that
# ant_plus_key_set() supplies at runtime, and confusing the two produces a
# build that runs happily and is never heard by anything.
#
# A product shipped with this would need a commercial key:
# https://www.thisisant.com/developer/ant/licensing
CONFIG_ANT_EVALUATION_KEY=y

CONFIG_NCS_SAMPLES_DEFAULTS=y

# Logs out the DK's first VCOM (COM7 on the nRF54L15 DK here; COM8 is where the
# dongle's UART transport lives, so the two boards do not collide). Not RTT:
# RTT needs SEGGER's JLinkARM DLL installed, whereas the VCOM is a plain COM
# port carried by the cable that already programs the board.
CONFIG_LOG=y
CONFIG_LOG_MODE_DEFERRED=y
CONFIG_SERIAL=y
CONFIG_CONSOLE=y
CONFIG_UART_CONSOLE=y
CONFIG_LOG_BACKEND_UART=y

# The ±target buttons and the channel-state LEDs. Both are genuinely useful on
# a bench transmitter: the LED says whether the channel came up, which is the
# first question when the receiver hears nothing.
CONFIG_DK_LIBRARY=y

CONFIG_HEAP_MEM_POOL_SIZE=4096

# Halt on a fault rather than rebooting into it. A sensor that resets in a loop
# still transmits between resets, which reads as an intermittent radio fault
# from the receiving end - the most expensive kind of symptom to chase.
CONFIG_RESET_ON_FATAL_ERROR=n
```

## src/main.c
```c
/* SPDX-License-Identifier: Apache-2.0 */

/*
 * An ANT+ sensor that does not exist, on a board that does.
 *
 * The dongle this repo builds is a transparent bridge with no profile
 * logic, so testing the radio needs a separate sensor. Kept as its own
 * application (not a dongle mode) because the root build's sysbuild/CMake
 * transport selection and CI flash-offset assertions are all dongle-
 * specific and would be wrong here.
 *
 *   west build app/apps/sim -b nrf54l15dk/nrf54l15/cpuapp --sysbuild -p auto
 *   scripts\flash_sim_jlink.ps1
 *
 * Runs on the nRF54L15 DK (no USB device controller in silicon, so it can
 * never be mistaken for a dongle), keeping the nRF5340 DK free for
 * debugging the thing under test.
 *
 * Profile plumbing is sdk-ant's (ant_bpwr/ant_bsc). sim_signal.c is ours:
 * the stock simulators ramp 0-2000 W, which never settles and so can't be
 * checked against a reference value; this holds a target with bounded
 * noise so tools/ant_verify.py can report a mean absolute error.
 */

#include <zephyr/kernel.h>
#include <zephyr/logging/log.h>
#if defined(CONFIG_ANT_SIM_IDENTITY_TIER_2)
#include <zephyr/random/random.h>
#endif

/*
 * ant_interface.h, and it is load-bearing rather than tidy-up: ant_channel_open
 * is a MACRO there (ant_channel_open_with_offset(ch, CHANNEL_START_OFFSET_NONE)),
 * not a function. Without this include the dropout timer's call compiles as an
 * implicit declaration and the image fails at link with `undefined reference to
 * ant_channel_open` - while ant_channel_close() beside it links fine, because
 * that one really is a function. The file previously relied on implicit
 * declarations for the two ANT calls it made; that worked only by luck of both
 * being real symbols.
 */
#include <ant_interface.h>
#include <ant_key_manager.h>
#include <ant_parameters.h>
#include <ant_state_indicator.h>
#include <dk_buttons_and_leds.h>

#if defined(CONFIG_ANT_SIM_PROFILE_BSC_COMBINED)
#include <ant_profiles/bsc/ant_bsc.h>
#else
#include <ant_profiles/bpwr/ant_bpwr.h>
#endif

#include "sim_signal.h"

LOG_MODULE_REGISTER(ant_sim, LOG_LEVEL_INF);

#define BUTTON_DECREASE DK_BTN1_MSK
#define BUTTON_INCREASE DK_BTN2_MSK

/* How much one button press moves the target. Small enough that a press is a
 * nudge rather than a new experiment.
 */
#define TARGET_STEP 5

/* Channel period in microseconds, computed from the profile's ticks rather
 * than written separately: the revolution counter uses this, and a mismatch
 * would be a cadence error indistinguishable from a receiver bug.
 */
#define TICKS_PER_S 32768u
#define PERIOD_US(ticks) ((uint32_t)(((uint64_t)(ticks) * 1000000u) / TICKS_PER_S))

static struct sim_signal sig_power;
static struct sim_signal sig_cadence;
static struct sim_revs crank_revs;
static struct sim_revs wheel_revs;

/* Buttons move these; the signal generators are re-seeded around them. */
static int32_t target_watts = CONFIG_ANT_SIM_TARGET_WATTS;
static int32_t target_rpm = CONFIG_ANT_SIM_TARGET_RPM;

/* The device number this boot reports. See sim_identity_init(). */
static uint16_t sim_devnum = CONFIG_ANT_SIM_DEVICE_NUMBER;

/*
 * Identity tier, resolved once at start-up.
 *
 * Tier 0 (default): provisioned number, never moves, no channel disruption.
 * Tier 2: fresh number every power-up - answers the stalking case (a strap
 * that power-cycles between rides looks like a new node each time) at the
 * cost of a re-pair per session for standard receivers (see Kconfig help).
 * Tier 1 isn't implemented here: no non-volatile storage, so a re-rolled
 * number can't survive a reset. Provision with tools/ant_identity.py.
 */
static void sim_identity_init(void)
{
#if defined(CONFIG_ANT_SIM_IDENTITY_TIER_2)
	/* 1..65535: zero is the wildcard on a channel ID, so a node that rolled
	 * it would match every search and belong to nobody. */
	sim_devnum = (uint16_t)((sys_rand32_get() % 65535u) + 1u);
	LOG_INF("identity tier 2: device #%u this boot - a STANDARD receiver "
		"must re-pair; a keyed RadiANT receiver re-acquires by MAC",
		sim_devnum);
#else
	LOG_INF("identity tier 0: device #%u, provisioned and stable",
		sim_devnum);
#endif
}

/* sdk-ant bakes the ANT+ frequency into a const channel-config macro, so
 * changing it means patching a copy. One instance is enough - a build only
 * ever opens one channel. At the default this is a no-op and the sensor
 * stays a valid ANT+ device; see CONFIG_ANT_SIM_RF_FREQ.
 */
static const ant_channel_config_t *sim_channel_config(
	const ant_channel_config_t *base)
{
	static ant_channel_config_t patched;

	patched = *base;
	patched.rf_freq = CONFIG_ANT_SIM_RF_FREQ;
	/* The device number is baked into sdk-ant's config macro at compile
	 * time, so a tier that chooses one at boot has to patch the copy - the
	 * same reason the frequency is patched here. */
	patched.device_number = sim_devnum;
	return &patched;
}

/*
 * Page 81's serial: a 32-bit globally unique serial, broadcast in the clear
 * every 30 s, is more identifying than the device number and unaffected by
 * a tier-2 re-roll - so a tier-2 node still leaks identity through it
 * unless privacy pages sentinel it out (0xFFFFFFFF, the page's own "not
 * supplied" value).
 */
#if defined(CONFIG_ANT_SIM_PRIVACY_PAGES)
#define SIM_SERIAL_NUM 0xFFFFFFFFu
#else
#define SIM_SERIAL_NUM CONFIG_ANT_SIM_SERIAL_NUM
#endif

/* Transmit power isn't part of the channel config, so it's set separately
 * once the channel exists. Logged rather than fatal: a sensor at default
 * power still works, so failing hard here would cost a bench session.
 */
static void sim_tx_power_set(uint8_t channel)
{
	int err = ant_channel_radio_tx_power_set(
		channel, CONFIG_ANT_SIM_TX_POWER, 0);

	if (err) {
		LOG_WRN("tx power level %d refused (%d) - staying at the "
			"default 0 dBm", CONFIG_ANT_SIM_TX_POWER, err);
	} else {
		LOG_INF("tx power level %d", CONFIG_ANT_SIM_TX_POWER);
	}
}

/*
 * F1: deliberate, timer'd dropouts for tools/ant_verify.py's --expect-dropout
 * SECONDS mode (T2). A power-cycle or a bench operator's stopwatch cannot
 * give a receiver an exact duration to subtract; a k_work_delayable pair can.
 * Compiled out entirely at the default ANT_SIM_DROPOUT_EVERY_S=0, which is
 * also the zero-cost proof - every existing sitting never sees this code.
 */
#if CONFIG_ANT_SIM_DROPOUT_EVERY_S > 0
static struct k_work_delayable dropout_close_work;
static struct k_work_delayable dropout_reopen_work;
static uint8_t dropout_channel;

static void dropout_reopen_fn(struct k_work *work)
{
	ARG_UNUSED(work);

	int err = ant_channel_open(dropout_channel);

	if (err) {
		LOG_ERR("dropout: channel %u reopen failed (%d)",
			dropout_channel, err);
	} else {
		LOG_INF("dropout: channel %u reopened", dropout_channel);
	}
	k_work_schedule(&dropout_close_work,
			 K_SECONDS(CONFIG_ANT_SIM_DROPOUT_EVERY_S));
}

static void dropout_close_fn(struct k_work *work)
{
	ARG_UNUSED(work);

	int err = ant_channel_close(dropout_channel);

	if (err) {
		LOG_ERR("dropout: channel %u close failed (%d)",
			dropout_channel, err);
	} else {
		LOG_INF("dropout: channel %u closed for %u s",
			dropout_channel, CONFIG_ANT_SIM_DROPOUT_S);
	}
	k_work_schedule(&dropout_reopen_work,
			 K_SECONDS(CONFIG_ANT_SIM_DROPOUT_S));
}

static void dropout_init(uint8_t channel)
{
	dropout_channel = channel;
	k_work_init_delayable(&dropout_close_work, dropout_close_fn);
	k_work_init_delayable(&dropout_reopen_work, dropout_reopen_fn);
	k_work_schedule(&dropout_close_work,
			 K_SECONDS(CONFIG_ANT_SIM_DROPOUT_EVERY_S));
	LOG_INF("dropout: channel %u will close for %u s every %u s", channel,
		CONFIG_ANT_SIM_DROPOUT_S, CONFIG_ANT_SIM_DROPOUT_EVERY_S);
}
#else
static void dropout_init(uint8_t channel)
{
	ARG_UNUSED(channel);
}
#endif

static void signals_init(void)
{
	sim_signal_init(&sig_power, target_watts, CONFIG_ANT_SIM_NOISE,
			CONFIG_ANT_SIM_SEED);
	/* A different seed for the second generator: sharing one would make
	 * cadence noise a copy of power noise, so their errors would cancel
	 * instead of compounding - flattering a receiver's torque arithmetic.
	 */
	sim_signal_init(&sig_cadence, target_rpm, CONFIG_ANT_SIM_NOISE,
			CONFIG_ANT_SIM_SEED + 1);
}

static void target_adjust(int32_t delta)
{
	target_watts += delta * (TARGET_STEP);
	target_rpm += delta;
	if (target_watts < 0) {
		target_watts = 0;
	}
	if (target_rpm < 0) {
		target_rpm = 0;
	}
	if (target_rpm > 254) {
		/* 255 is the profile's "cadence not reported" sentinel, so a
		 * target that reaches it would silently turn cadence off.
		 */
		target_rpm = 254;
	}

	signals_init();
	LOG_INF("target now %d W, %d rpm", target_watts, target_rpm);
}

#if defined(CONFIG_ANT_SIM_PROFILE_BSC_COMBINED)

/* ---- Combined speed and cadence, device type 0x79 ------------------------ */

#define SIM_PERIOD_US PERIOD_US(BSC_MSG_PERIOD_COMBINED)

static void bsc_evt_handler(ant_bsc_profile_t *p_profile, ant_bsc_evt_t event);

BSC_SENS_CHANNEL_CONFIG_DEF(bsc, CONFIG_ANT_SIM_CHANNEL_NUM,
			    CONFIG_ANT_SIM_TRANS_TYPE, BSC_COMBINED_DEVICE_TYPE,
			    CONFIG_ANT_SIM_DEVICE_NUMBER,
			    CONFIG_ANT_SIM_NETWORK_NUM);
BSC_SENS_PROFILE_CONFIG_DEF(bsc, true, true, ANT_BSC_COMB_PAGE_0,
			    bsc_evt_handler);

static ant_bsc_profile_t bsc;

static void bsc_update(ant_bsc_profile_t *p_profile)
{
	uint32_t rpm = (uint32_t)sim_signal_next(&sig_cadence);
	uint32_t crank = sim_revs_advance(&crank_revs, SIM_PERIOD_US, rpm);
	uint32_t wheel = sim_revs_advance(&wheel_revs, SIM_PERIOD_US,
					  CONFIG_ANT_SIM_WHEEL_RPM);

	/* Event time advances only when a revolution completed, not once per
	 * message. That is what makes roughly two messages in three carry no
	 * new event at 80 rpm - the case a receiver's delta arithmetic has to
	 * survive, and the one a per-message simulator never produces.
	 */
	while (crank-- > 0u) {
		p_profile->BSC_PROFILE_cadence_event_time +=
			sim_event_time_ticks(rpm);
		p_profile->BSC_PROFILE_cadence_rev_count++;
	}

	while (wheel-- > 0u) {
		p_profile->BSC_PROFILE_speed_event_time +=
			sim_event_time_ticks(CONFIG_ANT_SIM_WHEEL_RPM);
		p_profile->BSC_PROFILE_speed_rev_count++;
	}
}

static void bsc_evt_handler(ant_bsc_profile_t *p_profile, ant_bsc_evt_t event)
{
	switch (event) {
	case ANT_BSC_COMB_PAGE_0_UPDATED:
		bsc_update(p_profile);
		break;

	default:
		break;
	}
}

static void ant_evt_handler(ant_evt_t *p_ant_evt)
{
	ant_bsc_sens_evt_handler(p_ant_evt, &bsc);
}

static int profile_setup(void)
{
	int err = ant_bsc_sens_init(&bsc,
				    sim_channel_config(BSC_SENS_CHANNEL_CONFIG(bsc)),
				    BSC_SENS_PROFILE_CONFIG(bsc));

	if (err) {
		LOG_ERR("ant_bsc_sens_init failed: %d", err);
		return err;
	}

	bsc.BSC_PROFILE_manuf_id = CONFIG_ANT_SIM_MFG_ID;
	bsc.BSC_PROFILE_serial_num = SIM_SERIAL_NUM;
	bsc.BSC_PROFILE_hw_version = CONFIG_ANT_SIM_HW_VERSION;
	bsc.BSC_PROFILE_sw_version = CONFIG_ANT_SIM_SW_VERSION;
	bsc.BSC_PROFILE_model_num = CONFIG_ANT_SIM_MODEL_NUM;

	sim_tx_power_set(bsc.channel_number);

	err = ant_bsc_sens_open(&bsc);
	if (err) {
		LOG_ERR("ant_bsc_sens_open failed: %d", err);
		return err;
	}

	ant_state_indicator_channel_opened();
	LOG_INF("combined speed and cadence (0x79) open: device #%d, "
		"trans type %d, %d rpm crank, %d rpm wheel",
		sim_devnum, CONFIG_ANT_SIM_TRANS_TYPE,
		target_rpm, CONFIG_ANT_SIM_WHEEL_RPM);
	dropout_init(bsc.channel_number);
	return 0;
}

static int indicator_setup(void)
{
	return ant_state_indicator_init(bsc.channel_number,
					BSC_SENS_CHANNEL_TYPE);
}

#else

/* ---- Bicycle power, device type 0x0B ------------------------------------ */

#define SIM_PERIOD_US PERIOD_US(BPWR_MSG_PERIOD)

#if defined(CONFIG_ANT_SIM_PROFILE_BPWR_WHEEL_TORQUE)
#define SIM_TORQUE_USE TORQUE_WHEEL
#elif defined(CONFIG_ANT_SIM_PROFILE_BPWR_CRANK_TORQUE)
#define SIM_TORQUE_USE TORQUE_CRANK
#else
#define SIM_TORQUE_USE TORQUE_NONE
#endif

static void bpwr_evt_handler(ant_bpwr_profile_t *p_profile,
			     ant_bpwr_evt_t event);
static void bpwr_calib_handler(ant_bpwr_profile_t *p_profile,
			       ant_bpwr_page1_data_t *p_page1);

BPWR_SENS_CHANNEL_CONFIG_DEF(bpwr, CONFIG_ANT_SIM_CHANNEL_NUM,
			     CONFIG_ANT_SIM_TRANS_TYPE,
			     CONFIG_ANT_SIM_DEVICE_NUMBER,
			     CONFIG_ANT_SIM_NETWORK_NUM);
BPWR_SENS_PROFILE_CONFIG_DEF(bpwr, SIM_TORQUE_USE, bpwr_calib_handler,
			     bpwr_evt_handler);

static ant_bpwr_profile_t bpwr;

static void bpwr_update_standard(ant_bpwr_profile_t *p_profile)
{
	uint16_t watts = (uint16_t)sim_signal_next(&sig_power);

	p_profile->BPWR_PROFILE_instantaneous_power = watts;
	/* Left to wrap at 65536 per the profile spec (receivers undo it in
	 * 16-bit arithmetic), rather than resetting to zero like the stock
	 * simulator, which puts a discontinuity on air no real sensor
	 * produces.
	 */
	p_profile->BPWR_PROFILE_accumulated_power += watts;
	p_profile->BPWR_PROFILE_instantaneous_cadence =
		(uint8_t)sim_signal_next(&sig_cadence);
	p_profile->BPWR_PROFILE_power_update_event_count++;
}

static void bpwr_update_torque(ant_bpwr_profile_t *p_profile)
{
	uint32_t rpm = (uint32_t)sim_signal_next(&sig_cadence);
	uint32_t watts = (uint32_t)sim_signal_next(&sig_power);

	/* The cadence byte always carries crank rpm, whichever torque page is
	 * being sent - a wheel-torque sensor still reports the rider's
	 * cadence, not the wheel's.
	 */
	p_profile->BPWR_PROFILE_instantaneous_cadence = (uint8_t)rpm;

#if defined(CONFIG_ANT_SIM_PROFILE_BPWR_WHEEL_TORQUE)
	/* Wheel revolutions, at road speed, not crank revolutions. Torque at
	 * the wheel is correspondingly lower for the same power, and a
	 * receiver that mixes the two up gets a number that is wrong by the
	 * gear ratio rather than obviously wrong.
	 */
	uint32_t revs = sim_revs_advance(&wheel_revs, SIM_PERIOD_US,
					 CONFIG_ANT_SIM_WHEEL_RPM);

	while (revs-- > 0u) {
		p_profile->BPWR_PROFILE_wheel_period +=
			sim_period_ticks(CONFIG_ANT_SIM_WHEEL_RPM);
		p_profile->BPWR_PROFILE_wheel_accumulated_torque +=
			sim_torque_ticks(watts, CONFIG_ANT_SIM_WHEEL_RPM);
		p_profile->BPWR_PROFILE_wheel_tick++;
		p_profile->BPWR_PROFILE_wheel_update_event_count++;
	}
#else
	uint32_t revs = sim_revs_advance(&crank_revs, SIM_PERIOD_US, rpm);

	while (revs-- > 0u) {
		p_profile->BPWR_PROFILE_crank_period += sim_period_ticks(rpm);
		p_profile->BPWR_PROFILE_crank_accumulated_torque +=
			sim_torque_ticks(watts, rpm);
		p_profile->BPWR_PROFILE_crank_tick++;
		p_profile->BPWR_PROFILE_crank_update_event_count++;
	}
#endif
}

static void bpwr_evt_handler(ant_bpwr_profile_t *p_profile,
			     ant_bpwr_evt_t event)
{
	switch (event) {
	case ANT_BPWR_PAGE_16_UPDATED:
		bpwr_update_standard(p_profile);
		break;

	case ANT_BPWR_PAGE_17_UPDATED:
	case ANT_BPWR_PAGE_18_UPDATED:
		bpwr_update_torque(p_profile);
		break;

	default:
		/* Pages 1, 80 and 81 are sent by the profile from fields set
		 * once at startup; there is nothing to advance.
		 */
		break;
	}
}

static void bpwr_calib_handler(ant_bpwr_profile_t *p_profile,
			       ant_bpwr_page1_data_t *p_page1)
{
	/* A display that asks a real power meter to calibrate expects an
	 * answer. Answering successfully keeps this looking like a sensor to
	 * anything that pairs with it, and costs one assignment.
	 */
	switch (p_page1->calibration_id) {
	case ANT_BPWR_CALIB_ID_MANUAL:
	case ANT_BPWR_CALIB_ID_AUTO:
		p_profile->BPWR_PROFILE_calibration_id =
			ANT_BPWR_CALIB_ID_MANUAL_SUCCESS;
		p_profile->BPWR_PROFILE_general_calib_data =
			CONFIG_ANT_SIM_CALIBRATION_DATA;
		break;

	default:
		break;
	}
}

static void ant_evt_handler(ant_evt_t *p_ant_evt)
{
	ant_bpwr_sens_evt_handler(p_ant_evt, &bpwr);
}

static int profile_setup(void)
{
	int err = ant_bpwr_sens_init(&bpwr,
				     sim_channel_config(BPWR_SENS_CHANNEL_CONFIG(bpwr)),
				     BPWR_SENS_PROFILE_CONFIG(bpwr));

	if (err) {
		LOG_ERR("ant_bpwr_sens_init failed: %d", err);
		return err;
	}

	bpwr.page_80 = ANT_COMMON_page80(CONFIG_ANT_SIM_HW_VERSION,
					 CONFIG_ANT_SIM_MFG_ID,
					 CONFIG_ANT_SIM_MODEL_NUM);
	bpwr.page_81 = ANT_COMMON_page81(CONFIG_ANT_SIM_SW_VERSION,
					 CONFIG_ANT_SIM_SW_VERSION,
					 SIM_SERIAL_NUM);
	bpwr.BPWR_PROFILE_auto_zero_status = ANT_BPWR_AUTO_ZERO_OFF;
	/* 0xFF is the profile's "not reported" value. Reporting a made-up
	 * balance would be a second signal to be wrong about for no gain.
	 */
	bpwr.BPWR_PROFILE_pedal_power.differentiation = 0x00;

	sim_tx_power_set(bpwr.channel_number);

	err = ant_bpwr_sens_open(&bpwr);
	if (err) {
		LOG_ERR("ant_bpwr_sens_open failed: %d", err);
		return err;
	}

	ant_state_indicator_channel_opened();
	LOG_INF("bicycle power (0x0B) open: device #%d, trans type %d, "
		"torque mode %d, %d W at %d rpm",
		sim_devnum, CONFIG_ANT_SIM_TRANS_TYPE,
		(int)SIM_TORQUE_USE, target_watts, target_rpm);
	dropout_init(bpwr.channel_number);
	return 0;
}

static int indicator_setup(void)
{
	return ant_state_indicator_init(bpwr.channel_number,
					BPWR_SENS_CHANNEL_TYPE);
}

#endif /* CONFIG_ANT_SIM_PROFILE_BSC_COMBINED */

static void button_changed(uint32_t button_state, uint32_t has_changed)
{
	if ((has_changed & BUTTON_INCREASE) && (button_state & BUTTON_INCREASE)) {
		target_adjust(+1);
	}
	if ((has_changed & BUTTON_DECREASE) && (button_state & BUTTON_DECREASE)) {
		target_adjust(-1);
	}
}

static int utils_setup(void)
{
	int err = indicator_setup();

	if (err) {
		LOG_ERR("ant_state_indicator_init failed: %d", err);
		return err;
	}

	err = dk_buttons_init(button_changed);
	if (err) {
		LOG_ERR("dk_buttons_init failed: %d", err);
		return err;
	}

	return 0;
}

static int ant_stack_setup(void)
{
	int err = ant_init();

	if (err) {
		LOG_ERR("ant_init failed: %d", err);
		return err;
	}
	LOG_INF("ANT version %s", ANT_VERSION_STRING);

	err = ant_cb_register(&ant_evt_handler);
	if (err) {
		LOG_ERR("ant_cb_register failed: %d", err);
		return err;
	}

	/* The ANT+ network key, supplied by sdk-ant - not the same thing as
	 * CONFIG_ANT_EVALUATION_KEY (the stack's licence key); conflating the
	 * two produces a build that runs and is never heard.
	 */
	err = ant_plus_key_set(CONFIG_ANT_SIM_NETWORK_NUM);
	if (err) {
		LOG_ERR("ant_plus_key_set failed: %d", err);
	}
	return err;
}

int main(void)
{
	int err;

	LOG_INF("ANT+ sensor simulator starting");

	/* Before profile_setup(), because the device number goes into the
	 * channel config and a channel config is read once. */
	sim_identity_init();

	signals_init();

	err = ant_stack_setup();
	if (err) {
		goto error_exit;
	}

	err = utils_setup();
	if (err) {
		goto error_exit;
	}

	err = profile_setup();
	if (err) {
		goto error_exit;
	}

	/* Everything from here runs out of the ANT event callback: the stack
	 * raises a page-updated event on each transmit, which is the correct
	 * moment to advance the simulated sensor - a k_sleep loop would drift.
	 */
	return 0;

error_exit:
	ant_state_indicator_fatal_error();
	k_oops();

	return 0;
}
```

## src/sim_signal.c
```c
/* SPDX-License-Identifier: Apache-2.0 */

#include "sim_signal.h"

/* 2048 ticks a second, 60 seconds a minute: ticks per revolution at r rpm is
 * 2048 * 60 / r. Same shape for the 1/1024 s event time the combined page
 * uses.
 */
#define PERIOD_TICKS_NUMERATOR      122880u   /* 2048 * 60 */
#define EVENT_TIME_TICKS_NUMERATOR  61440u    /* 1024 * 60 */

/* Torque in 1/32 Nm for one revolution delivering P watts at r rpm:
 *
 *   torque_Nm = P / (2*pi*r/60)   so   torque_32 = 305.5775 * P / r
 *
 * Scaled by 1000 to stay in integers. The receiver recovers
 * P = delta_torque * 2*pi * 64 / delta_period, so an error here shows up
 * directly as a power error.
 */
#define TORQUE_TICKS_NUMERATOR      305577u
#define TORQUE_TICKS_SCALE          1000u

void sim_signal_init(struct sim_signal *sig, int32_t target, int32_t noise,
		     uint32_t seed)
{
	sig->target = target;
	sig->noise = noise;
	/* xorshift32 is dead at zero - it returns zero forever - and seed 0 is
	 * exactly what a Kconfig default or a memset leaves behind.
	 */
	sig->state = (seed != 0u) ? seed : 0x9E3779B9u;
}

static uint32_t xorshift32(uint32_t *state)
{
	uint32_t x = *state;

	x ^= x << 13;
	x ^= x >> 17;
	x ^= x << 5;
	*state = x;
	return x;
}

int32_t sim_signal_next(struct sim_signal *sig)
{
	int32_t value = sig->target;

	if (sig->noise > 0) {
		uint32_t span = (uint32_t)(2 * sig->noise + 1);

		value += (int32_t)(xorshift32(&sig->state) % span) - sig->noise;
	}

	return (value < 0) ? 0 : value;
}

uint32_t sim_revs_advance(struct sim_revs *revs, uint32_t dt_us, uint32_t rpm)
{
	uint32_t completed;

	if (rpm == 0u) {
		return 0u;
	}

	/* rpm * dt_us / 60000000 revolutions, kept in 1/1000000ths so the
	 * remainder carries into the next call instead of being rounded away
	 * every message - at ~4 Hz that would lose most of a revolution a
	 * second, biasing the reconstructed cadence by a constant factor.
	 * rpm is bounded by 255 (a byte on the air) and dt_us by one channel
	 * period, so the product stays inside 32 bits.
	 */
	revs->phase_micro += (rpm * dt_us) / 60u;
	completed = revs->phase_micro / 1000000u;
	revs->phase_micro -= completed * 1000000u;

	return completed;
}

uint16_t sim_period_ticks(uint32_t rpm)
{
	if (rpm == 0u) {
		return 0u;
	}

	return (uint16_t)((PERIOD_TICKS_NUMERATOR + rpm / 2u) / rpm);
}

uint16_t sim_event_time_ticks(uint32_t rpm)
{
	if (rpm == 0u) {
		return 0u;
	}

	return (uint16_t)((EVENT_TIME_TICKS_NUMERATOR + rpm / 2u) / rpm);
}

uint16_t sim_torque_ticks(uint32_t watts, uint32_t rpm)
{
	uint64_t numerator;
	uint64_t denominator;

	if (rpm == 0u) {
		return 0u;
	}

	/* 64-bit on purpose: at 2000 W this overflows 32 bits before the
	 * division, giving a small plausible-looking wrong answer rather
	 * than an obviously broken one.
	 */
	numerator = (uint64_t)watts * TORQUE_TICKS_NUMERATOR;
	denominator = (uint64_t)rpm * TORQUE_TICKS_SCALE;

	return (uint16_t)((numerator + denominator / 2u) / denominator);
}
```
