## CMakeLists.txt
```
# SPDX-License-Identifier: Apache-2.0

cmake_minimum_required(VERSION 3.20.0)

# RadiANT trainer: an FE-C bike trainer simulator with programmable ACK
# behaviour. See src/main.c for what it is, src/trainer_ackfault.h for the
# fault model, and docs/trainer-sim.md for how to drive it.
#
# Built like apps/treadmill - radiant and radiant/src/profiles, no sdk-ant -
# and like the treadmill it defaults to the nrf backend, never to null. See
# apps/treadmill/CMakeLists.txt and cmake/radiant_backend.cmake for why.
include("${CMAKE_CURRENT_SOURCE_DIR}/../../cmake/radiant_backend.cmake")
radiant_select_backend("${CMAKE_CURRENT_SOURCE_DIR}/../../radiant" "nrf" RADIANT_BACKEND_CONF)

set(trainer_backend_conf "${CMAKE_CURRENT_BINARY_DIR}/trainer_backend.conf")
file(WRITE "${trainer_backend_conf}"
"# Generated by apps/trainer/CMakeLists.txt from -DRADIANT_BACKEND. Do not edit.
CONFIG_RADIANT=y
CONFIG_RADIANT_ANTR_API=y
${RADIANT_BACKEND_CONF}
")
list(APPEND EXTRA_CONF_FILE "${trainer_backend_conf}")

find_package(Zephyr REQUIRED HINTS $ENV{ZEPHYR_BASE})
project(radiant_trainer)

# ── No arbiter, by construction ─────────────────────────────────────────────
#
# This image exists to put an acknowledgement on the air at a CHOSEN instant.
# The MPSL gate wraps every transmit in an arbitration request and a
# follow-on reserve, which moves and sometimes refuses exactly that instant -
# so a trainer image with the gate in it would be measuring the gate. BLE is
# the usual way the gate arrives (radiant/Kconfig's nrf arm needs it under
# CONFIG_BT), so both are refused here rather than documented.
if(CONFIG_BT OR CONFIG_RADIANT_BACKEND_NRF_GATE_MPSL)
  message(FATAL_ERROR
    "trainer: CONFIG_BT / CONFIG_RADIANT_BACKEND_NRF_GATE_MPSL is set.\n"
    "  This simulator's whole job is to place an ACK at a chosen instant, and "
    "the MPSL arbiter moves that instant. Build it direct, with no BLE.")
endif()

# The instrument is the point of the image; an image without it is a plain
# trainer that cannot answer a single `ackfault` command.
if(NOT CONFIG_RADIANT_ACK_FAULTS)
  message(FATAL_ERROR
    "trainer: CONFIG_RADIANT_ACK_FAULTS is not set. prj.conf turns it on; "
    "something downstream turned it off.")
endif()

radiant_assert_backend("trainer")

target_sources(app PRIVATE
  src/main.c
  src/trainer_model.c
  src/trainer_ackfault.c
  src/trainer_shell.c
)

# The antr_* adapter, as every radiant application uses it.
include("${CMAKE_CURRENT_SOURCE_DIR}/../common/sources.cmake")

# radiant/src/profiles: what the linker needs for the FE-C master, the same
# list apps/treadmill links. profile_fec.c (the DECODER) is absent there and
# absent here too - the trainer transmits page 25, it does not decode one.
target_sources(app PRIVATE
  ../../radiant/src/profiles/profile_bits.c
  ../../radiant/src/profiles/profile_common.c
  ../../radiant/src/profiles/profile_sched.c
  ../../radiant/src/profiles/profile_schedule.c
  ../../radiant/src/profiles/profile_telemetry.c
  ../../radiant/src/profiles/profile_handoff.c
  ../../radiant/src/profiles/profile_fec_tx.c
)
target_include_directories(app PRIVATE ../../radiant/src/profiles)

target_sources(app PRIVATE
  ../../radiant/src/node/node_ident.c
  ../../radiant/src/node/node_nvm_settings.c
)
target_include_directories(app PRIVATE ../../radiant/src/node)
```

## Kconfig
```
#
# RadiANT trainer - an FE-C bike trainer simulator with programmable ACK
# faults. One prefix, TRAINER_*, for the reason apps/treadmill/Kconfig gives.
#

rsource "../../radiant/src/node/Kconfig"
rsource "../../radiant/src/profiles/Kconfig"
rsource "../common/Kconfig.antr_api"

source "Kconfig.zephyr"

menuconfig TRAINER
	bool "RadiANT FE-C trainer simulator"
	default y
	help
	  A RadiANT node that is an ANT+ FE-C bike trainer (equipment type
	  25): pages 16, 25 and 17, page 54 declaring basic resistance,
	  target power and simulation, and every control page answered with
	  a page 71. The rider is simulated and set from the shell.

	  It is also a TEST INSTRUMENT: with CONFIG_RADIANT_ACK_FAULTS its
	  acknowledgements can be delayed, jittered, dropped or suppressed
	  from the shell, and every command's ground truth is recorded. See
	  docs/trainer-sim.md.

if TRAINER

config TRAINER_DEVICE_NUMBER
	int "the fixture's ANT device number"
	range 1 65535
	default 4244
	help
	  The fixture's number, always: unlike apps/hrm_ble and
	  apps/treadmill this node never takes its number from an identity
	  record, and prj.conf turns first-boot provisioning off (ADR 0020).
	  tools/fec_ack_sweep.py defaults to 4244.

	  4244: not the treadmill's 4243, not apps/hrm_ble's 4242, and not
	  the bench's real trainer (#52233), so a sweep pinned to this number
	  can never be answered by the real machine in the room.

	  Avoid numbers with a long alternating bit run in the on-air address:
	  nRF-based receivers lose up to ~5 % of their frames (ADR 0019). Check
	  one with `tools/ant_identity.py check <number> --device-type 0x11`.
	  The image logs a warning when it opens a channel with such a number.

config TRAINER_MANUFACTURER_ID
	int "manufacturer id for the common pages"
	range 0 65535
	default 255
	help
	  255 is the ANT+ development id.

config TRAINER_ACKFAULT_RING
	int "ground-truth records kept"
	range 16 4096
	default 512
	help
	  One record per acknowledged packet received, oldest overwritten
	  first (and counted, so a dump says when it is incomplete). 512 is
	  over eight minutes of commands at 1 Hz, which is longer than any
	  single sweep point; 28 bytes each.

module = TRAINER
module-str = trainer
source "subsys/logging/Kconfig.template.log_config"

endif # TRAINER
```

## sample.yaml
```
# SPDX-License-Identifier: Apache-2.0
#
# Twister coverage for the trainer simulator. build_only, as apps/treadmill's:
# its behaviour needs a radio and a second board. The checks that matter are
# the .config read-back in .github/workflows/release.yml's build-trainer job
# (CONFIG_RADIANT_ACK_FAULTS=y, the nrf backend, no MPSL gate) and the host-run
# model in tests/model.
common:
  build_only: true
  sysbuild: true
  tags:
    - radiant
    - trainer

tests:
  trainer.ant:
    platform_allow:
      - nrf54l15dk/nrf54l15/cpuapp
    extra_args:
      - RADIANT_BACKEND=nrf

  trainer.ant_nrf52840:
    platform_allow:
      - nrf52840dk/nrf52840
    extra_args:
      - RADIANT_BACKEND=nrf
```

## prj.conf
```kconfig
# RadiANT trainer simulator.
#
# Like apps/treadmill: no USB, no serial bridge. Unlike it: a shell on the
# console, because the shell is how the fault model is driven.

CONFIG_TRAINER=y

# radiant and its antr_* adapter. The backend comes from -DRADIANT_BACKEND via
# the fragment CMakeLists.txt generates.
CONFIG_RADIANT=y
CONFIG_RADIANT_ANTR_API=y

# THE INSTRUMENT. Test images only - radiant/Kconfig's help says so, and CI
# asserts the opposite on every dongle. CMakeLists.txt refuses a build that
# loses it.
CONFIG_RADIANT_ACK_FAULTS=y

# The identity record, as the treadmill has it (node_ident needs RADIANT_SEC).
CONFIG_RADIANT_SEC=y
CONFIG_RADIANT_NODE_IDENT=y
CONFIG_RADIANT_NODE_NVM_SETTINGS=y
# But NOT first-boot provisioning (ADR 0020): this is the bench fixture, and
# tools/fec_ack_sweep.py addresses it by CONFIG_TRAINER_DEVICE_NUMBER. Stated
# here even though no entropy backend is selected (so the symbol is off by
# dependency anyway), so that adding one later does not move the fixture.
CONFIG_RADIANT_NODE_IDENT_SELF_PROVISION=n
CONFIG_SETTINGS=y
CONFIG_SETTINGS_NVS=y

CONFIG_HEAP_MEM_POOL_SIZE=2048

# The physics is single-precision float. FPU on the M33/M4F, so the solver's
# 40 halvings are microseconds on the workqueue.
CONFIG_FPU=y

# The console, the shell and the log share the DK's first VCOM. The log goes
# THROUGH the shell's backend rather than beside it, so a log line can never
# land in the middle of an `ackfault dump` record line.
CONFIG_SERIAL=y
CONFIG_CONSOLE=y
CONFIG_UART_CONSOLE=y
CONFIG_LOG=y
CONFIG_LOG_MODE_DEFERRED=y
CONFIG_LOG_BACKEND_UART=n
CONFIG_SHELL=y
CONFIG_SHELL_BACKEND_SERIAL=y
CONFIG_SHELL_LOG_BACKEND=y
# Plain text for a machine on the other end: no colour escapes, and room for
# an `ackfault set` with every parameter on one line.
CONFIG_SHELL_VT100_COLORS=n
CONFIG_SHELL_CMD_BUFF_SIZE=256
CONFIG_SHELL_BACKEND_SERIAL_RX_RING_BUFFER_SIZE=256
CONFIG_SHELL_STACK_SIZE=3072

# See apps/treadmill/prj.conf: the boot burst overflows a 1024-byte ring and
# the banner is what gets dropped.
CONFIG_LOG_BUFFER_SIZE=4096

CONFIG_RESET_ON_FATAL_ERROR=n
CONFIG_THREAD_NAME=y
```

## boards/nrf52840dk_nrf52840.overlay
```dts
/*
 * nRF52840 DK, as the RadiANT trainer simulator.
 *
 * Here to keep the nRF52 half of the nrf backend's `depends on` compiled for
 * this application, as apps/treadmill's overlay does for that one. BUILD-
 * VERIFIED ONLY: the bench target is the nRF54L15 DK.
 *
 * TIMER4, for the reason apps/treadmill's nRF52840 overlay gives: the backend
 * needs five compare/capture channels, which on nRF52 only TIMER3 and TIMER4
 * have, and TIMER4 is the one every other application here names.
 */

/ {
	chosen {
		radiant,radio-timer = &timer4;
	};
};

&timer4 {
	status = "okay";
};
```

## boards/nrf54l15dk_nrf54l15_cpuapp.overlay
```dts
/*
 * nRF54L15 DK, as the RadiANT trainer simulator - the bench target.
 *
 * The one line radiant's nrf backend cannot start without, and the same
 * answer apps/treadmill's overlay gives: TIMER20, which the backend owns
 * outright (t_sync is hardware-captured into it). See that overlay for the
 * reasoning, including why it is not MPSL's TIMER10 - moot here, since this
 * image refuses MPSL, but kept identical so the two cannot drift.
 *
 * Nothing else. The console and the shell are on the board's own default
 * UART, which the DK's devicetree already provides.
 */

/ {
	chosen {
		radiant,radio-timer = &timer20;
	};
};

&timer20 {
	status = "okay";
};
```

## src/main.c
```c
/*
 * SPDX-License-Identifier: Apache-2.0
 *
 * RadiANT trainer: an ANT+ FE-C bike trainer (equipment type 25) SIMULATOR,
 * with acknowledgement behaviour that can be programmed at runtime.
 *
 * TWO JOBS, ONE IMAGE:
 *
 *   A USABLE EXAMPLE. A spec-conformant controllable trainer: pages 16, 25 and
 *   17 in SS10.1's interleave, page 54 declaring basic resistance, target
 *   power and simulation, and every control page answered with a page 71.
 *   Zwift or any head unit pairs with it like a real one, and the simulated
 *   rider's power and cadence come from the shell.
 *
 *   A TEST INSTRUMENT. Every radiant master acknowledges at exactly data
 *   t_sync + 1560 us, the centre of the dongle's own 1560 +/- 250 us window,
 *   so pairing a dongle with one reproduces only the case that already
 *   passes. This one can be told, from the shell, to acknowledge late, early
 *   or jittered, to apply a command and lose its ACK, to never hear it, to
 *   lose them in bursts, or to go busy after each one - and it records the
 *   ground truth for every command at the far end. See trainer_ackfault.h for
 *   the model and trainer_shell.c for the record.
 *
 * NO BLE, AND THAT IS NOT AN OMISSION. MPSL would add arbitration and a
 * follow-on reserve around exactly the transmit instant under test, so an
 * image with the arbiter in it would measure the arbiter. CMakeLists.txt
 * refuses the combination.
 *
 * It is apps/treadmill's FE-C skeleton - the EVENT_TX-paced page load, the
 * radiant_event-thread -> workqueue hop for control pages, and the rule that
 * every path through apply_control_page() ends in a page 71 - with the
 * treadmill's state and simulator replaced by trainer_model.h. The treadmill
 * itself is untouched.
 */

#include <errno.h>
#include <string.h>

#include <zephyr/kernel.h>
#include <zephyr/logging/log.h>
#include <zephyr/shell/shell.h>
#include <zephyr/sys/atomic.h>

#include "ant_radio.h"
#include "ant_wire.h"
#include "node_ident.h"
#include "profile_common.h"
#include "profile_fec.h"
#include "profile_fec_tx.h"
#include "trainer_model.h"
#include "trainer_node.h"

LOG_MODULE_REGISTER(trainer, CONFIG_TRAINER_LOG_LEVEL);

/* The public ANT+ network key - not a stack licence key. */
static const uint8_t ant_plus_key[8] = {
	0xB9, 0xA5, 0x21, 0xFB, 0xBD, 0x72, 0xC3, 0x45
};

#define ANT_NETWORK    0u
#define ANT_RF_FREQ    57u
#define ANT_TRANS_TYPE 5u

#define FEC_CHANNEL 0u

/* One page 25 update per tick, at the channel rate: 4 Hz. */
#define MODEL_TICK_MS 250u

static struct trainer_model model;
static struct profile_fec_tx fec;

/* The rider, from the shell thread. -1 = no change pending. */
static atomic_t rider_power_req = ATOMIC_INIT(-1);
static atomic_t rider_cadence_req = ATOMIC_INIT(-1);

static void model_tick_fn(struct k_work *w);
static K_WORK_DELAYABLE_DEFINE(model_tick, model_tick_fn);

/* ── Model -> pages ─────────────────────────────────────────────────────── */

static void publish(void)
{
	struct profile_fec_general              g;
	struct profile_fec_settings             s;
	struct profile_fec_trainer              t;
	struct profile_fec_cmd_wind_resistance  w;
	struct profile_fec_cmd_track_resistance tr;

	trainer_model_pages(&model, &g, &s, &t);
	profile_fec_tx_set_general(&fec, &g);
	profile_fec_tx_set_settings(&fec, &s);
	profile_fec_tx_set_trainer(&fec, &t);

	trainer_model_echo(&model, &w, &tr);
	profile_fec_tx_set_wind(&fec, &w);
	profile_fec_tx_set_track(&fec, &tr);
}

/* ── The control path: acknowledged pages in, page 71 out ───────────────── */

/* FE-C control pages carry no sequence number, so page 71's is this FE's own
 * count of commands received - see apps/treadmill/src/main.c. */
static uint8_t fec_sequence;

/*
 * One acknowledged control page, ON THE SYSTEM WORKQUEUE. Every path ends in
 * profile_fec_tx_command_answered(), refusals included: SS8.8 makes page 71
 * an obligation, and silence is what a controller reports as broken.
 *
 * A command the fault model marked MUTE arrives here like any other - MUTE is
 * "applied, ACK lost" - so page 71 still advances for it. A DEAF one never
 * arrives at all. That difference is exactly what a controller can use to
 * tell the two apart from its side.
 */
static void apply_control_page(const uint8_t *body)
{
	uint8_t status = PROFILE_FEC_CMD_STATUS_NOT_SUPPORTED;
	uint8_t page = body[0];

	fec_sequence++;

	switch (page) {
	case PROFILE_FEC_PAGE_BASIC_RESISTANCE: {
		struct profile_fec_cmd_basic_resistance cmd;

		if (profile_fec_decode_basic_resistance(body, &cmd) == 0) {
			trainer_model_basic_resistance(&model,
						       cmd.resistance_half_pct);
			status = PROFILE_FEC_CMD_STATUS_PASS;
		}
		break;
	}

	case PROFILE_FEC_PAGE_TARGET_POWER: {
		struct profile_fec_cmd_target_power cmd;

		if (profile_fec_decode_target_power(body, &cmd) == 0) {
			trainer_model_target_power(&model, cmd.power_quarter_w);
			status = PROFILE_FEC_CMD_STATUS_PASS;
		}
		break;
	}

	case PROFILE_FEC_PAGE_WIND_RESISTANCE: {
		struct profile_fec_cmd_wind_resistance cmd;

		if (profile_fec_decode_wind_resistance(body, &cmd) == 0) {
			trainer_model_wind(&model, &cmd);
			status = PROFILE_FEC_CMD_STATUS_PASS;
		}
		break;
	}

	case PROFILE_FEC_PAGE_TRACK_RESISTANCE: {
		struct profile_fec_cmd_track_resistance cmd;

		if (profile_fec_decode_track_resistance(body, &cmd) == 0) {
			trainer_model_track(&model, &cmd);
			status = PROFILE_FEC_CMD_STATUS_PASS;
			LOG_DBG("page 51: grade %d", (int)cmd.grade_centi_pct);
		}
		break;
	}

	case PROFILE_FEC_PAGE_USER_CONFIG: {
		struct profile_fec_cmd_user_config cmd;

		if (profile_fec_decode_user_config(body, &cmd) == 0) {
			trainer_model_user(&model, &cmd);
			status = PROFILE_FEC_CMD_STATUS_PASS;
		}
		break;
	}

	case PROFILE_FEC_PAGE_REQUEST: {
		struct profile_fec_cmd_request cmd;

		if (profile_fec_decode_request(body, &cmd) == 0 &&
		    profile_fec_tx_request(&fec, cmd.page, cmd.tx_count) == 0) {
			status = PROFILE_FEC_CMD_STATUS_PASS;
		}
		break;
	}

	default:
		status = PROFILE_FEC_CMD_STATUS_NOT_SUPPORTED;
		break;
	}

	/* The road changed, so the echo pages and page 17 change with it now
	 * rather than at the next tick. */
	publish();

	profile_fec_tx_command_answered(&fec, page, fec_sequence, status,
					&body[4]);
}

/*
 * The thread hop, as apps/treadmill's: antr_on_message() runs on radiant's
 * event thread and the model is workqueue-only, so the command is copied into
 * a small ring and the workqueue applies it. Invisible on air - page 71 goes
 * out on the next data slot either way.
 */
#define FEC_CMD_QUEUE_DEPTH 4u

static struct {
	uint8_t body[8];
} fec_cmd_q[FEC_CMD_QUEUE_DEPTH];

static uint8_t fec_cmd_head;
static uint8_t fec_cmd_tail;
static uint8_t fec_cmd_drop_page;
static bool    fec_cmd_dropped;
static struct k_spinlock fec_cmd_lock;

static void fec_cmd_work_fn(struct k_work *w)
{
	ARG_UNUSED(w);

	for (;;) {
		k_spinlock_key_t key;
		uint8_t          body[8];
		uint8_t          drop_page = 0u;
		bool             have = false;
		bool             dropped = false;

		key = k_spin_lock(&fec_cmd_lock);
		if (fec_cmd_tail != fec_cmd_head) {
			memcpy(body, fec_cmd_q[fec_cmd_tail].body, sizeof(body));
			fec_cmd_tail = (uint8_t)((fec_cmd_tail + 1u) %
						 FEC_CMD_QUEUE_DEPTH);
			have = true;
		} else if (fec_cmd_dropped) {
			drop_page = fec_cmd_drop_page;
			fec_cmd_dropped = false;
			dropped = true;
		}
		k_spin_unlock(&fec_cmd_lock, key);

		if (have) {
			apply_control_page(body);
			continue;
		}
		if (dropped) {
			static const uint8_t no_echo[4] = { 0u, 0u, 0u, 0u };

			fec_sequence++;
			LOG_WRN("FE-C page %u dropped: the command queue was "
				"full", drop_page);
			profile_fec_tx_command_answered(
				&fec, drop_page, fec_sequence,
				PROFILE_FEC_CMD_STATUS_FAIL, no_echo);
			continue;
		}
		break;
	}
}

static K_WORK_DEFINE(fec_cmd_work, fec_cmd_work_fn);

static void queue_control_page(const uint8_t *body)
{
	k_spinlock_key_t key;
	uint8_t          next;

	key = k_spin_lock(&fec_cmd_lock);
	next = (uint8_t)((fec_cmd_head + 1u) % FEC_CMD_QUEUE_DEPTH);
	if (next == fec_cmd_tail) {
		fec_cmd_dropped = true;
		fec_cmd_drop_page = body[0];
	} else {
		memcpy(fec_cmd_q[fec_cmd_head].body, body, 8u);
		fec_cmd_head = next;
	}
	k_spin_unlock(&fec_cmd_lock, key);

	(void)k_work_submit(&fec_cmd_work);
}

/* ── The radio ──────────────────────────────────────────────────────────── */

/* Paced by EVENT_TX, as the treadmill's: the next page is staged exactly when
 * the last one went out. The encode is locked against the workqueue's
 * setters; the send is not, because it takes a mutex. */
static void load_fec_page(void)
{
	uint8_t                body[8];
	enum profile_slot_kind kind;

	k_sched_lock();
	kind = profile_fec_tx_next(&fec, body);
	k_sched_unlock();
	if (kind == PROFILE_SLOT_IDLE) {
		return;
	}
	(void)antr_broadcast_message_tx(FEC_CHANNEL, sizeof(body), body);
}

void antr_on_message(const struct antr_msg *msg)
{
	if (msg == NULL || msg->data == NULL) {
		return;
	}

	if (msg->id == ANTW_MESG_RESPONSE_EVENT_ID &&
	    msg->len >= ANTW_MESG_RESPONSE_EVENT_SIZE) {
		if (msg->data[2] == ANTW_EVENT_TX &&
		    msg->data[0] == FEC_CHANNEL) {
			load_fec_page();
		}
		return;
	}

	/* The control pages: acknowledged data into a channel this node is the
	 * MASTER of - FE-C's "C". */
	if ((msg->id == ANTW_MESG_ACKNOWLEDGED_DATA_ID ||
	     msg->id == ANTW_MESG_EXT_ACKNOWLEDGED_DATA_ID) &&
	    msg->len >= 9u && msg->data[0] == FEC_CHANNEL) {
		queue_control_page(&msg->data[1]);
	}
}

static int ant_master_start(uint8_t channel, uint16_t devnum)
{
	antr_err_t rc;

	rc = antr_channel_assign(channel, ANTW_CHANNEL_TYPE_MASTER, ANT_NETWORK,
				 0u);
	if (rc != ANTW_RESPONSE_NO_ERROR) {
		LOG_ERR("ch%u assign: %d", channel, (int)rc);
		return -EIO;
	}
	rc = antr_channel_id_set(channel, devnum, PROFILE_FEC_DEVICE_TYPE,
				 ANT_TRANS_TYPE);
	if (rc != ANTW_RESPONSE_NO_ERROR) {
		LOG_ERR("ch%u channel id: %d", channel, (int)rc);
		return -EIO;
	}
	rc = antr_channel_period_set(channel, PROFILE_FEC_PERIOD);
	if (rc != ANTW_RESPONSE_NO_ERROR) {
		LOG_ERR("ch%u period: %d", channel, (int)rc);
		return -EIO;
	}
	rc = antr_channel_radio_freq_set(channel, ANT_RF_FREQ);
	if (rc != ANTW_RESPONSE_NO_ERROR) {
		LOG_ERR("ch%u rf freq: %d", channel, (int)rc);
		return -EIO;
	}
	/* The fault hook goes on BEFORE the channel opens, so no command is
	 * ever answered half-registered. */
	if (trainer_ackfault_attach(channel) != 0) {
		LOG_ERR("ch%u ack fault hook did not register", channel);
		return -EIO;
	}
	rc = antr_channel_open(channel);
	if (rc != ANTW_RESPONSE_NO_ERROR) {
		LOG_ERR("ch%u open: %d", channel, (int)rc);
		return -EIO;
	}
	return 0;
}

static void model_tick_fn(struct k_work *w)
{
	atomic_val_t power = atomic_set(&rider_power_req, -1);
	atomic_val_t cadence = atomic_set(&rider_cadence_req, -1);

	ARG_UNUSED(w);

	if (power >= 0 || cadence >= 0) {
		trainer_model_set_rider(
			&model,
			(power >= 0) ? (uint16_t)power : model.rider_power_w,
			(cadence >= 0) ? (uint8_t)cadence : model.cadence_rpm);
	}

	trainer_model_tick(&model, MODEL_TICK_MS);
	publish();

	k_work_schedule(&model_tick, K_MSEC(MODEL_TICK_MS));
}

void trainer_node_set_rider(int32_t power_w, int32_t cadence_rpm)
{
	if (power_w >= 0) {
		atomic_set(&rider_power_req, power_w);
	}
	if (cadence_rpm >= 0) {
		atomic_set(&rider_cadence_req, cadence_rpm);
	}
}

void trainer_node_print(const struct shell *sh)
{
	static const char *const modes[] = { "sim", "erg", "basic" };
	struct trainer_model     m;

	/* The workqueue writes the model; a scheduler lock makes this copy a
	 * consistent snapshot without a mutex on the writer's side. */
	k_sched_lock();
	m = model;
	k_sched_unlock();

	shell_print(sh,
		    "mode=%s rider=%uW/%urpm grade=%d.%02d%% crr=%u/5e-5 "
		    "wind=%dkph cw=%u.%02u draft=%u.%02u mass=%u.%02u+%u.%02ukg",
		    modes[m.mode], m.rider_power_w, m.cadence_rpm,
		    (int)(m.grade_centi_pct / 100),
		    (int)((m.grade_centi_pct < 0 ? -m.grade_centi_pct
						 : m.grade_centi_pct) % 100),
		    m.crr_5e5, m.wind_speed_kph, m.wind_coeff_centi / 100u,
		    m.wind_coeff_centi % 100u, m.drafting_centi / 100u,
		    m.drafting_centi % 100u, m.user_weight_10g / 100u,
		    m.user_weight_10g % 100u, (m.bike_weight_50g * 5u) / 100u,
		    (m.bike_weight_50g * 5u) % 100u);
	shell_print(sh,
		    "speed=%u mm/s power=%u W resistance=%d N target=%u qW "
		    "basic=%u half-pct events=%u",
		    (unsigned)m.speed_mm_s, m.power_w, (int)m.resistance_n,
		    m.target_power_qw, m.resistance_half_pct, m.event_count);
}

static void fill_common_id(struct profile_common_id *id, uint16_t devnum)
{
	memset(id, 0, sizeof(*id));
	id->hw_revision = 1u;
	id->manufacturer_id = CONFIG_TRAINER_MANUFACTURER_ID;
	id->model_number = 1u;
	id->sw_revision_main = 1u;
	id->sw_revision_supplemental = PROFILE_COMMON_INVALID_U8;
	id->serial_number = devnum;
}

int main(void)
{
	struct profile_fec_tx_cfg fec_cfg;
	uint16_t                  devnum = CONFIG_TRAINER_DEVICE_NUMBER;
	int                       err;

	LOG_INF("RadiANT trainer: ANT+ 0x11 FE-C, equipment type 25, "
		"programmable ACK faults");

	if (antr_init() != ANTW_RESPONSE_NO_ERROR) {
		LOG_ERR("antr_init failed");
		return 0;
	}

	/*
	 * THE FIXTURE KEEPS ITS FIXED NUMBER, whatever the identity record
	 * says. tools/fec_ack_sweep.py and the bench recipes address this
	 * board as CONFIG_TRAINER_DEVICE_NUMBER (4244), so prj.conf turns
	 * first-boot provisioning off (ADR 0020) - and a record left in
	 * storage by an hrm_ble or treadmill image flashed on the same DK
	 * without an erase is ignored here rather than silently moving the
	 * fixture to a derived number. node_ident_boot() still runs so the
	 * boot counter behaves as on the other nodes.
	 */
	err = node_ident_boot();
	if (err == 0) {
		LOG_INF("device number %u, the fixture's fixed number (an "
			"identity record is present and ignored)", devnum);
	} else {
		LOG_INF("device number %u, the fixture's fixed number (%s)",
			devnum, node_ident_strerror(err));
	}

	trainer_model_init(&model);

	memset(&fec_cfg, 0, sizeof(fec_cfg));
	fill_common_id(&fec_cfg.id, devnum);
	fec_cfg.equipment_type = PROFILE_FEC_TYPE_TRAINER;
	/* All three, because all three are honoured: page 48 drives BASIC,
	 * page 49 ERG, pages 50/51 SIM. Declaring a mode and refusing its
	 * page is the mistake profile_fec_tx.h warns about. */
	fec_cfg.caps.capabilities = PROFILE_FEC_CAP_BASIC_RESISTANCE |
				    PROFILE_FEC_CAP_TARGET_POWER |
				    PROFILE_FEC_CAP_SIMULATION;
	fec_cfg.caps.max_resistance_n = TRAINER_MAX_RESISTANCE_N;
	fec_cfg.caps.max_resistance_valid = true;
	fec_cfg.metabolic = false;

	err = profile_fec_tx_init(&fec, &fec_cfg);
	if (err != 0) {
		LOG_ERR("profile_fec_tx_init: %d", err);
		return 0;
	}

	trainer_model_tick(&model, 0u);
	publish();

	if (antr_network_address_set(ANT_NETWORK, ant_plus_key) !=
	    ANTW_RESPONSE_NO_ERROR) {
		LOG_ERR("network key");
		return 0;
	}

	if (ant_master_start(FEC_CHANNEL, devnum) != 0) {
		return 0;
	}

	k_work_schedule(&model_tick, K_MSEC(MODEL_TICK_MS));
	LOG_INF("transmitting: device #%u", devnum);
	return 0;
}
```

## src/trainer_ackfault.c
```c
/* SPDX-License-Identifier: Apache-2.0 */
/*
 * trainer_ackfault.c - see trainer_ackfault.h. No Zephyr header: the include
 * list is the check that tests/model can compile this file on its own.
 */

#include <stdbool.h>
#include <stdint.h>
#include <stdlib.h>
#include <string.h>

#include "trainer_ackfault.h"

/* The dongle's ACK window half-width, RADIANT_TRANSFER_ACK_GUARD_US. Spelled
 * here rather than included so this file stays free of radiant; `late-edge`
 * is defined as "exactly on the window's late edge", and if the window
 * changes this preset should move with it. */
#define DONGLE_ACK_GUARD_US 250

static uint32_t xorshift32(uint32_t *s)
{
	uint32_t x = *s;

	x ^= x << 13;
	x ^= x >> 17;
	x ^= x << 5;
	*s = x;
	return x;
}

static bool draw_pm(struct trainer_ackfault *af, uint16_t pm)
{
	if (pm == 0u) {
		return false; /* no draw: a zero rate must not move the stream */
	}
	return (xorshift32(&af->rng) % 1000u) < (uint32_t)pm;
}

void trainer_ackfault_params_ideal(struct trainer_ackfault_params *p)
{
	memset(p, 0, sizeof(*p));
	p->bad_action = TRAINER_ACTION_MUTE;
	p->seed = TRAINER_ACKFAULT_SEED_DEFAULT;
}

int trainer_ackfault_preset(const char *name, struct trainer_ackfault_params *p)
{
	struct trainer_ackfault_params q;

	if (name == NULL || p == NULL) {
		return -1;
	}
	trainer_ackfault_params_ideal(&q);

	if (strcmp(name, "ideal") == 0) {
		/* nothing */
	} else if (strcmp(name, "late300") == 0) {
		q.offset_us = 300;
	} else if (strcmp(name, "late-edge") == 0) {
		q.offset_us = DONGLE_ACK_GUARD_US;
	} else if (strcmp(name, "jitter") == 0) {
		q.jitter_us = 200u;
	} else if (strcmp(name, "lossy25") == 0) {
		q.mute_pm = 250u;
	} else if (strcmp(name, "wahoo") == 0) {
		/* PLACEHOLDER. Equal to ideal until the sniffer calibration
		 * (plan Phase 6) measures the real trainer's data->ACK dt and
		 * ACK-presence rate. Anything here before then would be a
		 * guess presented as a model. */
	} else {
		return -1;
	}

	*p = q;
	return 0;
}

void trainer_ackfault_reset(struct trainer_ackfault *af)
{
	struct trainer_ackfault_params p = af->p;

	memset(af, 0, sizeof(*af));
	af->p = p;
	af->rng = (p.seed != 0u) ? p.seed : TRAINER_ACKFAULT_SEED_DEFAULT;
}

void trainer_ackfault_init(struct trainer_ackfault *af,
			   const struct trainer_ackfault_params *p)
{
	af->p = *p;
	trainer_ackfault_reset(af);
}

void trainer_ackfault_decide(struct trainer_ackfault *af, uint64_t t_us,
			     struct trainer_ackfault_decision *out)
{
	const struct trainer_ackfault_params *p = &af->p;
	bool busy = af->busy_valid && t_us < af->busy_until_us;

	out->action = TRAINER_ACTION_ACK;
	out->cause = TRAINER_CAUSE_NONE;
	out->offset_us = 0;

	/* The chain steps on every packet, busy or not, so a busy window does
	 * not freeze a burst in progress. */
	if (p->p_bad_pm != 0u || af->burst_bad) {
		if (af->burst_bad) {
			if (draw_pm(af, p->p_good_pm)) {
				af->burst_bad = false;
			}
		} else if (draw_pm(af, p->p_bad_pm)) {
			af->burst_bad = true;
		}
	}

	if (busy) {
		out->action = TRAINER_ACTION_MUTE;
		out->cause = TRAINER_CAUSE_BUSY;
	} else if (af->burst_bad) {
		out->action = (p->bad_action == TRAINER_ACTION_DEAF)
				      ? TRAINER_ACTION_DEAF
				      : TRAINER_ACTION_MUTE;
		out->cause = TRAINER_CAUSE_BURST;
	} else if (draw_pm(af, p->deaf_pm)) {
		out->action = TRAINER_ACTION_DEAF;
		out->cause = TRAINER_CAUSE_DEAF;
	} else if (draw_pm(af, p->mute_pm)) {
		out->action = TRAINER_ACTION_MUTE;
		out->cause = TRAINER_CAUSE_MUTE;
	} else {
		int32_t j = 0;

		if (p->jitter_us != 0u) {
			uint32_t span = 2u * p->jitter_us + 1u;

			j = (int32_t)(xorshift32(&af->rng) % span) -
			    (int32_t)p->jitter_us;
		}
		out->offset_us = p->offset_us + j;
	}

	/* Applied and not busy: the trainer is now busy for busy_ms. */
	if (p->busy_ms != 0u && !busy && out->action != TRAINER_ACTION_DEAF) {
		af->busy_valid = true;
		af->busy_until_us = t_us + (uint64_t)p->busy_ms * 1000u;
	}

	af->n++;
	af->n_action[out->action]++;
	af->n_cause[out->cause]++;
}

static int parse_i32(const char *s, int32_t lo, int32_t hi, int32_t *out)
{
	char *end = NULL;
	long  v;

	if (s == NULL || *s == '\0') {
		return -1;
	}
	v = strtol(s, &end, 0);
	if (end == NULL || *end != '\0' || v < (long)lo || v > (long)hi) {
		return -1;
	}
	*out = (int32_t)v;
	return 0;
}

int trainer_ackfault_set(struct trainer_ackfault_params *p, const char *key,
			 const char *value)
{
	int32_t v;

	if (p == NULL || key == NULL || value == NULL) {
		return -1;
	}

	if (strcmp(key, "bad_action") == 0) {
		if (strcmp(value, "mute") == 0) {
			p->bad_action = TRAINER_ACTION_MUTE;
		} else if (strcmp(value, "deaf") == 0) {
			p->bad_action = TRAINER_ACTION_DEAF;
		} else {
			return -1;
		}
		return 0;
	}
	if (strcmp(key, "seed") == 0) {
		char         *end = NULL;
		unsigned long s = strtoul(value, &end, 0);

		if (*value == '\0' || end == NULL || *end != '\0') {
			return -1;
		}
		p->seed = (uint32_t)s;
		return 0;
	}

	/* Offsets beyond +-10 ms are not an ACK timing any more, they are a
	 * different slot; per-mille stops at 1000. */
	if (strcmp(key, "offset_us") == 0) {
		if (parse_i32(value, -10000, 10000, &v) != 0) {
			return -1;
		}
		p->offset_us = v;
	} else if (strcmp(key, "jitter_us") == 0) {
		if (parse_i32(value, 0, 10000, &v) != 0) {
			return -1;
		}
		p->jitter_us = (uint32_t)v;
	} else if (strcmp(key, "mute_pm") == 0) {
		if (parse_i32(value, 0, 1000, &v) != 0) {
			return -1;
		}
		p->mute_pm = (uint16_t)v;
	} else if (strcmp(key, "deaf_pm") == 0) {
		if (parse_i32(value, 0, 1000, &v) != 0) {
			return -1;
		}
		p->deaf_pm = (uint16_t)v;
	} else if (strcmp(key, "p_bad") == 0) {
		if (parse_i32(value, 0, 1000, &v) != 0) {
			return -1;
		}
		p->p_bad_pm = (uint16_t)v;
	} else if (strcmp(key, "p_good") == 0) {
		if (parse_i32(value, 0, 1000, &v) != 0) {
			return -1;
		}
		p->p_good_pm = (uint16_t)v;
	} else if (strcmp(key, "busy_ms") == 0) {
		if (parse_i32(value, 0, 600000, &v) != 0) {
			return -1;
		}
		p->busy_ms = (uint32_t)v;
	} else {
		return -1;
	}
	return 0;
}

const char *trainer_ackfault_action_name(uint8_t action)
{
	switch (action) {
	case TRAINER_ACTION_ACK:  return "ack";
	case TRAINER_ACTION_MUTE: return "mute";
	case TRAINER_ACTION_DEAF: return "deaf";
	default:                  return "?";
	}
}

const char *trainer_ackfault_cause_name(uint8_t cause)
{
	switch (cause) {
	case TRAINER_CAUSE_NONE:  return "none";
	case TRAINER_CAUSE_BUSY:  return "busy";
	case TRAINER_CAUSE_BURST: return "burst";
	case TRAINER_CAUSE_DEAF:  return "deaf";
	case TRAINER_CAUSE_MUTE:  return "mute";
	default:                  return "?";
	}
}
```

## src/trainer_ackfault.h
```c
/* SPDX-License-Identifier: Apache-2.0 */
/*
 * trainer_ackfault.h - what the simulated trainer does with each acknowledged
 * command: acknowledge it (late, early, jittered), apply it and lose the ACK
 * (MUTE), or never hear it (DEAF).
 *
 * KERNEL-FREE, like trainer_model.h, so tests/model can draw ten thousand
 * decisions from a fixed seed and check the statistics. The Zephyr half - the
 * radio hook, the ground-truth ring and the shell - is trainer_shell.c.
 *
 * ONE DECISION PER RECEIVED ACKNOWLEDGED PACKET, IN THIS ORDER, and the order
 * is part of the model:
 *
 *   1. BUSY. Within busy_ms of the last command this trainer applied, MUTE.
 *      A busy MUTE does not extend the window - only an applied command
 *      starts one, and a busy one was applied.
 *   2. BURST. A two-state Gilbert chain steps once per packet: GOOD goes BAD
 *      with p_bad, BAD goes GOOD with p_good (both per-mille). In BAD the
 *      packet gets bad_action (MUTE or DEAF). Mean burst length is
 *      1000 / p_good packets.
 *   3. DEAF with deaf_pm per-mille.
 *   4. MUTE with mute_pm per-mille.
 *   5. Otherwise ACK at the normal instant + offset_us + a uniform draw in
 *      [-jitter_us, +jitter_us].
 *
 * A non-busy ACK or MUTE starts the busy window, because both mean the
 * command was applied. DEAF does not.
 *
 * The generator is xorshift32 from `seed`, re-seeded on every
 * trainer_ackfault_init()/_reset(), so a run is reproducible from its
 * parameters alone. Seed 0 is a xorshift fixed point and is replaced.
 */

#ifndef TRAINER_ACKFAULT_H_
#define TRAINER_ACKFAULT_H_

#include <stdbool.h>
#include <stdint.h>

#ifdef __cplusplus
extern "C" {
#endif

/* Values match antr_reply_action, which trainer_shell.c asserts. */
enum trainer_action {
	TRAINER_ACTION_ACK = 0,
	TRAINER_ACTION_MUTE,
	TRAINER_ACTION_DEAF
};

/* Which rule decided, for the ground-truth record. */
enum trainer_cause {
	TRAINER_CAUSE_NONE = 0, /* a plain ACK */
	TRAINER_CAUSE_BUSY,
	TRAINER_CAUSE_BURST,
	TRAINER_CAUSE_DEAF,
	TRAINER_CAUSE_MUTE
};

#define TRAINER_ACKFAULT_SEED_DEFAULT 0x2545F491u

struct trainer_ackfault_params {
	int32_t  offset_us;
	uint32_t jitter_us;
	uint16_t mute_pm;
	uint16_t deaf_pm;
	uint16_t p_bad_pm;
	uint16_t p_good_pm;
	uint8_t  bad_action; /* TRAINER_ACTION_MUTE or _DEAF */
	uint32_t busy_ms;
	uint32_t seed;
};

struct trainer_ackfault {
	struct trainer_ackfault_params p;

	uint32_t rng;
	bool     burst_bad;
	bool     busy_valid;
	uint64_t busy_until_us;

	/* Decisions so far, by action and by cause. */
	uint32_t n;
	uint32_t n_action[3];
	uint32_t n_cause[5];
};

struct trainer_ackfault_decision {
	uint8_t action; /* enum trainer_action */
	uint8_t cause;  /* enum trainer_cause */
	int32_t offset_us;
};

/* The "ideal" parameters: every packet acknowledged on time. */
void trainer_ackfault_params_ideal(struct trainer_ackfault_params *p);

/* Named presets: ideal, late300, late-edge, jitter, lossy25, wahoo. Returns 0,
 * or -1 for an unknown name (and leaves *p untouched). `wahoo` is a
 * placeholder equal to `ideal` until the sniffer calibration fits it. */
int trainer_ackfault_preset(const char *name, struct trainer_ackfault_params *p);

/* Install parameters and reset every piece of state, the generator included. */
void trainer_ackfault_init(struct trainer_ackfault *af,
			   const struct trainer_ackfault_params *p);

/* Same parameters, fresh state - what makes two runs comparable. */
void trainer_ackfault_reset(struct trainer_ackfault *af);

/* One decision for a packet received at `t_us` (any monotonic microsecond
 * clock; the radio's t_sync in the application). */
void trainer_ackfault_decide(struct trainer_ackfault *af, uint64_t t_us,
			     struct trainer_ackfault_decision *out);

/* Set one parameter from its shell spelling: offset_us, jitter_us, mute_pm,
 * deaf_pm, p_bad, p_good, bad_action (mute|deaf), busy_ms, seed. Returns 0,
 * or -1 for an unknown key, an unparsable value or one out of range (*p is
 * then untouched). Does not reset state; the caller decides. */
int trainer_ackfault_set(struct trainer_ackfault_params *p, const char *key,
			 const char *value);

const char *trainer_ackfault_action_name(uint8_t action);
const char *trainer_ackfault_cause_name(uint8_t cause);

#ifdef __cplusplus
}
#endif

#endif /* TRAINER_ACKFAULT_H_ */
```

## src/trainer_model.c
```c
/* SPDX-License-Identifier: Apache-2.0 */
/*
 * trainer_model.c - see trainer_model.h. No Zephyr header, on purpose: the
 * include list is the check that tests/model can compile this on its own.
 */

#include <stdbool.h>
#include <stdint.h>
#include <string.h>

#include "profile_fec.h"
#include "profile_fec_tx.h"
#include "trainer_model.h"

#define G_MS2 9.81f

void trainer_model_init(struct trainer_model *m)
{
	memset(m, 0, sizeof(*m));
	m->rider_power_w = TRAINER_DEFAULT_RIDER_POWER_W;
	m->cadence_rpm = TRAINER_DEFAULT_RIDER_CADENCE_RPM;
	m->mode = TRAINER_MODE_SIM;
	m->wind_coeff_centi = TRAINER_DEFAULT_WIND_COEFF_CENTI;
	m->wind_speed_kph = 0;
	m->drafting_centi = TRAINER_DEFAULT_DRAFTING_CENTI;
	m->grade_centi_pct = 0;
	m->crr_5e5 = TRAINER_DEFAULT_CRR_5E5;
	m->user_weight_10g = TRAINER_DEFAULT_USER_WEIGHT_10G;
	m->bike_weight_50g = TRAINER_DEFAULT_BIKE_WEIGHT_50G;
	m->wheel_diameter_cm = TRAINER_DEFAULT_WHEEL_DIAM_CM;
}

void trainer_model_set_rider(struct trainer_model *m, uint16_t power_w,
			     uint8_t cadence_rpm)
{
	m->rider_power_w = power_w;
	m->cadence_rpm = cadence_rpm;
}

void trainer_model_basic_resistance(struct trainer_model *m,
				    uint8_t resistance_half_pct)
{
	m->mode = TRAINER_MODE_BASIC;
	/* 200 half-percent is 100 %; anything above is not a resistance. */
	m->resistance_half_pct = (resistance_half_pct > 200u)
					 ? 200u
					 : resistance_half_pct;
}

void trainer_model_target_power(struct trainer_model *m,
				uint16_t power_quarter_w)
{
	m->mode = TRAINER_MODE_ERG;
	m->target_power_qw = power_quarter_w;
}

void trainer_model_wind(struct trainer_model *m,
			const struct profile_fec_cmd_wind_resistance *w)
{
	m->mode = TRAINER_MODE_SIM;
	m->wind_coeff_centi = w->coefficient_valid
				      ? w->coefficient_centi
				      : TRAINER_DEFAULT_WIND_COEFF_CENTI;
	m->wind_speed_kph = w->wind_speed_valid ? w->wind_speed_kph : 0;
	m->drafting_centi = w->drafting_valid ? w->drafting_centi
					      : TRAINER_DEFAULT_DRAFTING_CENTI;
}

void trainer_model_track(struct trainer_model *m,
			 const struct profile_fec_cmd_track_resistance *t)
{
	m->mode = TRAINER_MODE_SIM;
	/* The decoder already turned the 0xFFFF sentinel into 0: SS8.8.4.1
	 * says an FE told nothing assumes flat ground. */
	m->grade_centi_pct = t->grade_centi_pct;
	m->crr_5e5 = t->rolling_resistance_valid ? t->rolling_resistance
						 : TRAINER_DEFAULT_CRR_5E5;
}

void trainer_model_user(struct trainer_model *m,
			const struct profile_fec_cmd_user_config *u)
{
	m->user_weight_10g = u->user_weight_valid
				     ? u->user_weight_10g
				     : TRAINER_DEFAULT_USER_WEIGHT_10G;
	m->bike_weight_50g = u->bike_weight_valid
				     ? u->bike_weight_50g
				     : TRAINER_DEFAULT_BIKE_WEIGHT_50G;
	m->wheel_diameter_cm = u->wheel_diameter_valid
				       ? u->wheel_diameter_cm
				       : TRAINER_DEFAULT_WHEEL_DIAM_CM;
}

static float total_mass_kg(const struct trainer_model *m)
{
	return (float)m->user_weight_10g * 0.01f +
	       (float)m->bike_weight_50g * 0.05f;
}

float trainer_model_resistance_n(const struct trainer_model *m, float speed_ms)
{
	float mass = total_mass_kg(m);
	float grade = 0.0f;
	float rel;
	float total;

	/* BASIC is a flat road plus the brake; the grade is the simulation's
	 * and does not apply to it. */
	if (m->mode != TRAINER_MODE_BASIC) {
		grade = (float)m->grade_centi_pct / 10000.0f;
	}

	/* Equation 8-13, gravitational. Negative downhill. */
	total = mass * G_MS2 * grade;
	/* Equation 8-14, rolling. */
	total += mass * G_MS2 * ((float)m->crr_5e5 * 5e-5f);
	/* Equation 8-15, wind. Signed: a tailwind faster than the rider
	 * pushes, which is the one way this term goes negative. */
	rel = speed_ms + (float)m->wind_speed_kph / 3.6f;
	total += 0.5f * ((float)m->wind_coeff_centi * 0.01f) * rel *
		 (rel < 0.0f ? -rel : rel) * ((float)m->drafting_centi * 0.01f);

	if (m->mode == TRAINER_MODE_BASIC) {
		total += (float)TRAINER_MAX_RESISTANCE_N *
			 ((float)m->resistance_half_pct / 200.0f);
	}

	/* A brake cannot push the rider downhill. */
	return (total < 0.0f) ? 0.0f : total;
}

float trainer_model_solve_speed(const struct trainer_model *m, float power_w)
{
	float lo = 0.0f;
	float hi = TRAINER_SPEED_MAX_MS;

	if (power_w <= 0.0f) {
		return 0.0f;
	}
	if (trainer_model_resistance_n(m, hi) * hi < power_w) {
		return hi;
	}

	/* resistance(v) x v rises with v wherever it is positive, which is
	 * what bisection needs; where the clamp holds it at 0 (a steep
	 * descent), the crossing is simply further up. */
	for (uint32_t i = 0; i < TRAINER_SOLVE_ITERATIONS; i++) {
		float mid = 0.5f * (lo + hi);

		if (trainer_model_resistance_n(m, mid) * mid < power_w) {
			lo = mid;
		} else {
			hi = mid;
		}
	}
	return hi;
}

void trainer_model_tick(struct trainer_model *m, uint32_t dt_ms)
{
	float power;
	float speed;

	m->erg_speed_low = false;

	if (m->cadence_rpm == 0u) {
		/* Not pedalling is no power in every mode, and in ERG it is
		 * the textbook "speed too low to reach the target". */
		power = 0.0f;
		m->erg_speed_low = (m->mode == TRAINER_MODE_ERG);
	} else if (m->mode == TRAINER_MODE_ERG) {
		power = (float)m->target_power_qw * 0.25f;
	} else {
		power = (float)m->rider_power_w;
	}

	speed = trainer_model_solve_speed(m, power);
	m->speed_mm_s = (uint32_t)(speed * 1000.0f + 0.5f);
	m->resistance_n = trainer_model_resistance_n(m, speed);
	m->power_w = (uint16_t)(power + 0.5f);

	/* One page 25 update per tick: the event count and the accumulator
	 * advance together, which is what makes the accumulator's delta over
	 * the count's delta an average power. */
	m->event_count++;
	m->acc_power_w = (uint16_t)(m->acc_power_w + m->power_w);
	m->elapsed_ms += dt_ms;
	m->distance_um += (uint64_t)m->speed_mm_s * dt_ms;
}

void trainer_model_pages(const struct trainer_model *m,
			 struct profile_fec_general *g,
			 struct profile_fec_settings *s,
			 struct profile_fec_trainer *t)
{
	uint8_t state = (m->cadence_rpm != 0u) ? PROFILE_FEC_STATE_IN_USE
					       : PROFILE_FEC_STATE_READY;

	memset(g, 0, sizeof(*g));
	g->equipment_type = PROFILE_FEC_TYPE_TRAINER;
	g->elapsed_time_qs = (uint8_t)((m->elapsed_ms / 250u) & 0xFFu);
	g->distance_m = (uint8_t)((m->distance_um / 1000000u) & 0xFFu);
	g->distance_valid = true;
	g->speed_mm_s = (m->speed_mm_s > 0xFFFEu) ? 0xFFFEu
						  : (uint16_t)m->speed_mm_s;
	g->speed_valid = true;
	/* Capabilities bit 3: a real number for an unreal quantity. */
	g->speed_virtual = true;
	g->heart_rate_valid = false;
	g->hr_source = PROFILE_FEC_HR_SRC_INVALID;
	g->state = state;

	memset(s, 0, sizeof(*s));
	s->cycle_length_valid = false;
	/* SS8.8.4.1: the reported incline matches the commanded grade. The
	 * setter clamps it to page 17's +-100 %. */
	s->incline_centi_pct = m->grade_centi_pct;
	s->incline_valid = true;
	if (m->mode == TRAINER_MODE_BASIC) {
		s->resistance_half_pct = m->resistance_half_pct;
	} else {
		float share = m->resistance_n / (float)TRAINER_MAX_RESISTANCE_N;

		s->resistance_half_pct =
			(share >= 1.0f) ? 200u
					: (uint8_t)(share * 200.0f + 0.5f);
	}
	/* SS10.1.2.6: mandatory on a trainer. */
	s->resistance_valid = true;
	s->state = state;

	memset(t, 0, sizeof(*t));
	t->event_count = m->event_count;
	t->cadence_rpm = m->cadence_rpm;
	t->cadence_valid = true;
	t->acc_power_w = m->acc_power_w;
	t->inst_power_w = m->power_w;
	t->power_valid = true;
	/* No calibration and no user configuration required: the defaults
	 * stand in for a page 55 that never came, and SS10.1.2.6 allows the
	 * calibration bits to stay clear. */
	t->trainer_status = 0u;
	t->flags = m->erg_speed_low ? PROFILE_FEC_TARGET_POWER_SPEED_LOW
				    : PROFILE_FEC_TARGET_POWER_OK;
	t->state = state;
}

void trainer_model_echo(const struct trainer_model *m,
			struct profile_fec_cmd_wind_resistance *w,
			struct profile_fec_cmd_track_resistance *t)
{
	memset(w, 0, sizeof(*w));
	w->coefficient_centi = m->wind_coeff_centi;
	w->coefficient_valid = true;
	w->wind_speed_kph = m->wind_speed_kph;
	w->wind_speed_valid = true;
	w->drafting_centi = m->drafting_centi;
	w->drafting_valid = true;

	memset(t, 0, sizeof(*t));
	t->grade_centi_pct = m->grade_centi_pct;
	t->grade_valid = true;
	t->rolling_resistance = m->crr_5e5;
	t->rolling_resistance_valid = true;
}
```

## src/trainer_model.h
```c
/* SPDX-License-Identifier: Apache-2.0 */
/*
 * trainer_model.h - the simulated rider and road behind apps/trainer.
 *
 * KERNEL-FREE ON PURPOSE, exactly as apps/treadmill's treadmill_state.h is: no
 * Zephyr header, no lock, no clock. It is TOLD how much time passed, so
 * tests/model can drive an hour of riding in a counted loop, and everything
 * that touches it in the application runs on the system workqueue.
 *
 * THE PHYSICS IS FE-C SS8.8.4's, NOT A BICYCLE MODEL. Total resistance is the
 * three terms the profile defines (Equations 8-13 to 8-15):
 *
 *   gravitational = (m_user + m_bike) x 9.81 x grade/100
 *   rolling       = (m_user + m_bike) x 9.81 x Crr
 *   wind          = 0.5 x c_wind x (v + v_wind)^2 x drafting
 *
 * where v_wind is positive for a headwind, and the sum is clamped at 0 N: a
 * trainer brake cannot push the rider downhill. The rider's power is fixed
 * (the shell sets it), so the speed reported is the steady state at which
 * resistance x speed equals that power, found by bisection. That speed is
 * VIRTUAL - page 16 says so - because no wheel is turning anywhere.
 *
 * Three modes, one per control page, and the last command received wins:
 *   SIM    pages 50/51/55 set the road; power is the rider's.
 *   ERG    page 49: the trainer holds power at the target, so the REPORTED
 *          power is the target and speed follows it on the current road.
 *   BASIC  page 48: a fraction of page 54's maximum resistance (2000 N) as a
 *          constant brake force on a flat road.
 */

#ifndef TRAINER_MODEL_H_
#define TRAINER_MODEL_H_

#include <stdbool.h>
#include <stdint.h>

#include "profile_fec.h"
#include "profile_fec_tx.h"

#ifdef __cplusplus
extern "C" {
#endif

/* SS8.8.4's defaults, applied whenever a command sends a field's sentinel. */
#define TRAINER_DEFAULT_USER_WEIGHT_10G   7500u /* 75.00 kg */
#define TRAINER_DEFAULT_BIKE_WEIGHT_50G   200u  /* 10.00 kg */
#define TRAINER_DEFAULT_WHEEL_DIAM_CM     70u   /* 0.70 m */
#define TRAINER_DEFAULT_WIND_COEFF_CENTI  51u   /* 0.51 kg/m */
#define TRAINER_DEFAULT_DRAFTING_CENTI    100u  /* 1.00 */
#define TRAINER_DEFAULT_CRR_5E5           80u   /* 0.004 in 5e-5 units */

/* Page 54's declared maximum, and the BASIC mode brake at 100 %. */
#define TRAINER_MAX_RESISTANCE_N          2000u

/* The rider before the shell says otherwise. */
#define TRAINER_DEFAULT_RIDER_POWER_W     200u
#define TRAINER_DEFAULT_RIDER_CADENCE_RPM 90u

/* Bisection bounds and depth. 30 m/s is 108 km/h; 40 halvings of that is far
 * below a millimetre per second, which is the resolution page 16 carries. */
#define TRAINER_SPEED_MAX_MS     30.0f
#define TRAINER_SOLVE_ITERATIONS 40u

enum trainer_mode {
	TRAINER_MODE_SIM = 0,
	TRAINER_MODE_ERG,
	TRAINER_MODE_BASIC
};

struct trainer_model {
	/* The rider. */
	uint16_t rider_power_w;
	uint8_t  cadence_rpm;

	enum trainer_mode mode;
	uint8_t  resistance_half_pct; /* page 48 */
	uint16_t target_power_qw;     /* page 49, 0.25 W */

	/* The road, in the profile's own units, defaults already applied. */
	uint8_t  wind_coeff_centi;
	int16_t  wind_speed_kph; /* positive = headwind */
	uint8_t  drafting_centi;
	int32_t  grade_centi_pct;
	uint8_t  crr_5e5;
	uint16_t user_weight_10g;
	uint16_t bike_weight_50g;
	uint8_t  wheel_diameter_cm;

	/* What the last tick produced. */
	uint32_t speed_mm_s;
	uint16_t power_w;      /* reported, page 25 */
	float    resistance_n; /* total, at speed_mm_s */
	bool     erg_speed_low;

	/* Accumulators, advanced once per tick (one page 25 update). */
	uint8_t  event_count;
	uint16_t acc_power_w;
	uint32_t elapsed_ms;
	uint64_t distance_um;
};

void trainer_model_init(struct trainer_model *m);

void trainer_model_set_rider(struct trainer_model *m, uint16_t power_w,
			     uint8_t cadence_rpm);

/* One per control page. 48 selects BASIC, 49 ERG, and the road pages 50 and
 * 51 select SIM, because sending them is how a controller says it is
 * simulating. Page 55 changes no mode: the rider's mass matters in all three.
 * Fields carrying their sentinel take the default. */
void trainer_model_basic_resistance(struct trainer_model *m,
				    uint8_t resistance_half_pct);
void trainer_model_target_power(struct trainer_model *m,
				uint16_t power_quarter_w);
void trainer_model_wind(struct trainer_model *m,
			const struct profile_fec_cmd_wind_resistance *w);
void trainer_model_track(struct trainer_model *m,
			 const struct profile_fec_cmd_track_resistance *t);
void trainer_model_user(struct trainer_model *m,
			const struct profile_fec_cmd_user_config *u);

/* Total resistance in newtons at `speed_ms` on the current road, clamped at
 * zero. BASIC mode is a flat road plus the brake. */
float trainer_model_resistance_n(const struct trainer_model *m, float speed_ms);

/* The steady speed at which resistance x speed = `power_w`. Returns
 * TRAINER_SPEED_MAX_MS if even that is not enough resistance. */
float trainer_model_solve_speed(const struct trainer_model *m, float power_w);

/* Advance by `dt_ms`: solve the speed, bump the page 25 accumulators once. */
void trainer_model_tick(struct trainer_model *m, uint32_t dt_ms);

/* The pages, from the model. Plain fills; the caller hands them to
 * profile_fec_tx's setters. Equipment type 25, speed flagged virtual, the
 * incline equal to the commanded grade (SS8.8.4.1), the page 17 resistance
 * as a share of page 54's maximum. */
void trainer_model_pages(const struct trainer_model *m,
			 struct profile_fec_general *g,
			 struct profile_fec_settings *s,
			 struct profile_fec_trainer *t);

/* The simulation settings as pages 50/51 echo them. */
void trainer_model_echo(const struct trainer_model *m,
			struct profile_fec_cmd_wind_resistance *w,
			struct profile_fec_cmd_track_resistance *t);

#ifdef __cplusplus
}
#endif

#endif /* TRAINER_MODEL_H_ */
```
