## CMakeLists.txt
```
# SPDX-License-Identifier: Apache-2.0
#
# The smart trainer kernel-free sources against ztest. No radiant module, no
# backend, no BLE stack: the production .c files below include no Zephyr
# header, so they compile beside the tests unmodified.
cmake_minimum_required(VERSION 3.20.0)

find_package(Zephyr REQUIRED HINTS $ENV{ZEPHYR_BASE})
project(smart_trainer_glue_test)

set(R ../../../../radiant)
target_sources(app PRIVATE
  src/main.c
  src/equip.c
  src/sim_glue.c
  src/cmd.c
  src/logic.c
  ../../src/trainer_equip.c
  ../../src/trainer_cmd.c
  ../../src/trainer_logic.c
  ../../src/trainer_inbox.c
  ../../src/trainer_sim_model.c
  # apps/trainer model, reused in place as in the application.
  ../../../trainer/src/trainer_model.c
  ${R}/src/ble/radiant_ble_ftms_core.c
  ${R}/src/ble/radiant_ctrl_arbiter.c
  # The FE-C master, for the decoders and the page-70/71 round trips.
  ${R}/src/profiles/radiant_profile_fec_tx.c
  ${R}/src/profiles/radiant_profile_sched.c
  ${R}/src/profiles/radiant_profile_schedule.c
  ${R}/src/profiles/radiant_profile_telemetry.c
  ${R}/src/profiles/radiant_profile_bits.c
  ${R}/src/profiles/radiant_profile_common.c
  ${R}/src/profiles/radiant_profile_handoff.c
)
target_include_directories(app PRIVATE ../../src ../../../trainer/src ${R}/include)
```

## prj.conf
```kconfig
# SPDX-License-Identifier: Apache-2.0
CONFIG_ZTEST=y
CONFIG_FPU=y
CONFIG_ZTEST_STACK_SIZE=8192
```

## src/main.c
```c
/* SPDX-License-Identifier: Apache-2.0 */
/*
 * The fake source the command tests drive, shared by the suites. Each hook
 * counts its calls, keeps its last argument and returns `fake.rc`.
 */

#include <string.h>

#include "fake.h"

struct fake_state fake;

static int f_power(uint16_t w)
{
	fake.n_power++;
	fake.power_w = w;
	return fake.rc;
}

static int f_resistance(uint16_t pm)
{
	fake.n_resistance++;
	fake.permille = pm;
	return fake.rc;
}

static int f_sim(const struct trainer_sim_params *p)
{
	fake.n_sim++;
	fake.sim = *p;
	return fake.rc;
}

static int f_user(const struct trainer_user *u)
{
	fake.n_user++;
	fake.user = *u;
	return fake.rc;
}

static int f_workout(enum trainer_workout w)
{
	fake.n_workout++;
	fake.workout = w;
	return fake.rc;
}

const struct trainer_source_ops fake_full = {
	.name = "fake",
	.set_target_power = f_power,
	.set_resistance = f_resistance,
	.set_sim = f_sim,
	.set_user = f_user,
	.workout = f_workout,
	.max_resistance_n = 2000u,
};

/* ERG only: no resistance, no simulation, no user, no workout. */
const struct trainer_source_ops fake_erg_only = {
	.name = "fake erg",
	.set_target_power = f_power,
	.max_resistance_n = 0u,
};

void fake_reset(void)
{
	memset(&fake, 0, sizeof(fake));
}
```

## src/cmd.c
```c
/* SPDX-License-Identifier: Apache-2.0 */
/*
 * Every command path: FE-C pages through trainer_cmd_fec(), FTMS procedures
 * through the real core (radiant_ble_ftms_cp_decide/execute) and the
 * trainer's hooks, both against the real arbiter; and the page-70/71 round
 * trips through the real FE-C master.
 */

#include <string.h>

#include <zephyr/ztest.h>

#include <radiant/radiant_ble_ftms.h>
#include <radiant/radiant_ctrl_arbiter.h>
#include <radiant/radiant_profile_fec_tx.h>

#include "fake.h"
#include "trainer_cmd.h"
#include "trainer_equip.h"

static struct trainer_equip equip;
static struct radiant_ble_ftms_caps ftms_caps;

static const struct radiant_ble_ftms_ops ops = {
	.set_target = trainer_cmd_ftms_set_target,
	.workout = trainer_cmd_ftms_workout,
	.reset = trainer_cmd_ftms_reset,
};

static void bind(const struct trainer_source_ops *src, bool arbiter)
{
	struct trainer_cmd_cfg c;

	fake_reset();
	trainer_equip_init(&equip, (src != NULL) ? src->max_resistance_n : 0u);
	memset(&c, 0, sizeof(c));
	c.equip = &equip;
	c.src = src;
	c.allow_erg = true;
	c.allow_resistance = true;
	c.allow_sim = true;
	c.min_power_w = 0u;
	c.max_power_w = 2000u;
	if (arbiter) {
		c.ctrl_owner = radiant_ctrl_owner;
		c.ctrl_claim = radiant_ctrl_claim;
		c.ctrl_gated = radiant_ctrl_fec_page_is_gated;
	}
	trainer_cmd_bind(&c);
	radiant_ctrl_init(30000u, trainer_cmd_ctrl_gates());
	trainer_cmd_ftms_caps(&ftms_caps);
}

static void page(uint8_t *b, uint8_t p)
{
	memset(b, 0xFF, 8);
	b[0] = p;
}

/* One FTMS procedure, as radiant_ble_ftms.c's cp_work runs it, including the
 * glue's token claim on a grant. */
static struct radiant_ble_ftms_cp_outcome cp(const uint8_t *data, uint16_t len,
					     enum radiant_ble_ftms_owner owner,
					     uint32_t rx_epoch)
{
	struct radiant_ble_ftms_cp_request req = { .data = data, .len = len, .epoch = rx_epoch };
	struct radiant_ble_ftms_session s = { .epoch = equip.epoch };
	struct radiant_ble_ftms_auth auth = { .check = NULL }; /* passive */
	struct radiant_ble_ftms_cp_decision d;
	struct radiant_ble_ftms_cp_outcome o;

	s.run = (equip.run == TRAINER_RUN_RUNNING)   ? RADIANT_BLE_FTMS_RUN_RUNNING
		: (equip.run == TRAINER_RUN_PAUSED)  ? RADIANT_BLE_FTMS_RUN_PAUSED
		: (equip.run == TRAINER_RUN_STOPPED) ? RADIANT_BLE_FTMS_RUN_STOPPED
						     : RADIANT_BLE_FTMS_RUN_IDLE;
	d = radiant_ble_ftms_cp_decide(&req, &s, &ftms_caps, owner, &auth);
	o = radiant_ble_ftms_cp_execute(&d, &ops);
	if (o.grant) {
		(void)radiant_ctrl_claim(RADIANT_CTRL_BLE, true, 0u);
	}
	if (o.release) {
		radiant_ctrl_release(RADIANT_CTRL_BLE);
	}
	if (o.reset_view) {
		(void)trainer_equip_ftms_reset(&equip);
	}
	return o;
}

#define SELF RADIANT_BLE_FTMS_OWNER_SELF

/* ── Capabilities ───────────────────────────────────────────────────────── */

ZTEST(trainer_cmd, test_capabilities_follow_the_hooks)
{
	bind(&fake_full, true);
	zassert_equal(trainer_cmd_fec_capabilities(),
		      RADIANT_PROFILE_FEC_CAP_BASIC_RESISTANCE | RADIANT_PROFILE_FEC_CAP_TARGET_POWER |
			      RADIANT_PROFILE_FEC_CAP_SIMULATION);
	zassert_equal(ftms_caps.targets,
		      RADIANT_BLE_FTMS_TSF_POWER | RADIANT_BLE_FTMS_TSF_RESISTANCE |
			      RADIANT_BLE_FTMS_TSF_BIKE_SIM | RADIANT_BLE_FTMS_TSF_WHEEL_CIRC);
	zassert_true(ftms_caps.power.valid && ftms_caps.resistance.valid);
	zassert_equal(ftms_caps.resistance.max, TRAINER_RESISTANCE_LEVEL_MAX_DECI);
	zassert_equal(ftms_caps.power.max, 2000);
	zassert_equal(trainer_cmd_ctrl_gates(), 0x0Fu, "all four control pages gated");
	/* The data fields the record sends, no more. */
	zassert_equal(ftms_caps.features,
		      RADIANT_BLE_FTMS_FMF_CADENCE | RADIANT_BLE_FTMS_FMF_TOTAL_DISTANCE |
			      RADIANT_BLE_FTMS_FMF_RESISTANCE_LEVEL | RADIANT_BLE_FTMS_FMF_POWER |
			      RADIANT_BLE_FTMS_FMF_ELAPSED_TIME);

	bind(&fake_erg_only, true);
	zassert_equal(trainer_cmd_fec_capabilities(), RADIANT_PROFILE_FEC_CAP_TARGET_POWER);
	zassert_equal(ftms_caps.targets, RADIANT_BLE_FTMS_TSF_POWER);
	zassert_equal(trainer_cmd_ctrl_gates(), RADIANT_CTRL_GATE(RADIANT_CTRL_PAGE_TARGET_POWER));

	bind(NULL, true);
	zassert_equal(trainer_cmd_fec_capabilities(), 0u);
	zassert_equal(ftms_caps.targets, 0u);
}

/* ── FE-C ──────────────────────────────────────────────────────────────── */

ZTEST(trainer_cmd, test_fec_48_49_50_51_reach_the_hooks)
{
	uint8_t b[8];
	struct trainer_fec_answer a;

	bind(&fake_full, true);

	page(b, RADIANT_PROFILE_FEC_PAGE_BASIC_RESISTANCE);
	b[7] = 100u; /* 50 % */
	a = trainer_cmd_fec(b, equip.epoch, 0u);
	zassert_true(a.answer);
	zassert_equal(a.status, RADIANT_PROFILE_FEC_CMD_STATUS_PASS);
	zassert_equal(fake.permille, 500u);
	zassert_equal(equip.mode, TRAINER_EQUIP_BASIC);
	zassert_equal(a.ftms_status_len, 2u);
	zassert_equal(a.ftms_status[0], RADIANT_BLE_FTMS_STATUS_TARGET_RESISTANCE);
	zassert_equal(a.ftms_status[1], 100u, "level 10.0");

	page(b, RADIANT_PROFILE_FEC_PAGE_TARGET_POWER);
	b[6] = 0xE8u; /* 1000 x 0.25 W = 250 W */
	b[7] = 0x03u;
	a = trainer_cmd_fec(b, equip.epoch, 0u);
	zassert_equal(a.status, RADIANT_PROFILE_FEC_CMD_STATUS_PASS);
	zassert_equal(fake.power_w, 250u);
	zassert_equal(equip.mode, TRAINER_EQUIP_ERG);
	zassert_equal(a.ftms_status[0], RADIANT_BLE_FTMS_STATUS_TARGET_POWER);
	zassert_equal(a.ftms_status[1] | (a.ftms_status[2] << 8), 250);

	page(b, RADIANT_PROFILE_FEC_PAGE_WIND_RESISTANCE);
	b[5] = 60u;  /* 0.60 kg/m */
	b[6] = 137u; /* +10 km/h */
	b[7] = 90u;
	a = trainer_cmd_fec(b, equip.epoch, 0u);
	zassert_equal(a.status, RADIANT_PROFILE_FEC_CMD_STATUS_PASS);
	zassert_equal(fake.sim.cw_centi, 60u);
	zassert_equal(fake.sim.wind_mm_s, 2778);
	zassert_equal(fake.sim.drafting_centi, 90u);
	zassert_equal(equip.mode, TRAINER_EQUIP_SIM);

	page(b, RADIANT_PROFILE_FEC_PAGE_TRACK_RESISTANCE);
	b[5] = 0x4Cu; /* 20300 -> +3.00 % */
	b[6] = 0x4Fu;
	b[7] = 80u;   /* 0.004 */
	a = trainer_cmd_fec(b, equip.epoch, 0u);
	zassert_equal(a.status, RADIANT_PROFILE_FEC_CMD_STATUS_PASS);
	zassert_equal(fake.sim.grade_centi_pct, 300);
	zassert_equal(fake.sim.crr_e5, 400u);
	zassert_equal(fake.sim.cw_centi, 60u, "page 51 keeps page 50's settings");
	zassert_equal(a.ftms_status[0], RADIANT_BLE_FTMS_STATUS_BIKE_SIM);
	zassert_equal(a.ftms_status_len, 7u);

	/* Grade sentinel = flat; crr sentinel = default. */
	page(b, RADIANT_PROFILE_FEC_PAGE_TRACK_RESISTANCE);
	a = trainer_cmd_fec(b, equip.epoch, 0u);
	zassert_equal(fake.sim.grade_centi_pct, 0);
	zassert_equal(fake.sim.crr_e5, TRAINER_SIM_DEFAULT_CRR_E5);

	/* A hook failure is FAIL and changes nothing. */
	fake.rc = -EIO;
	page(b, RADIANT_PROFILE_FEC_PAGE_TARGET_POWER);
	b[6] = 0x20u;
	b[7] = 0x03u;
	a = trainer_cmd_fec(b, equip.epoch, 0u);
	zassert_true(a.answer);
	zassert_equal(a.status, RADIANT_PROFILE_FEC_CMD_STATUS_FAIL);
	zassert_equal(equip.mode, TRAINER_EQUIP_SIM);
	zassert_equal(a.ftms_status_len, 0u);
}

ZTEST(trainer_cmd, test_fec_power_is_clamped_to_the_range)
{
	uint8_t b[8];

	bind(&fake_full, true);
	page(b, RADIANT_PROFILE_FEC_PAGE_TARGET_POWER);
	b[6] = 0xFFu; /* 16383 W */
	b[7] = 0xFFu;
	(void)trainer_cmd_fec(b, equip.epoch, 0u);
	zassert_equal(fake.power_w, 2000u);
}

ZTEST(trainer_cmd, test_fec_unsupported_page_is_ignored_not_answered)
{
	uint8_t b[8];
	struct trainer_fec_answer a;

	bind(&fake_erg_only, true);
	page(b, RADIANT_PROFILE_FEC_PAGE_TRACK_RESISTANCE);
	a = trainer_cmd_fec(b, equip.epoch, 0u);
	zassert_false(a.answer, "SS8.12.3.1: ignored, no page 71");
	page(b, RADIANT_PROFILE_FEC_PAGE_BASIC_RESISTANCE);
	a = trainer_cmd_fec(b, equip.epoch, 0u);
	zassert_false(a.answer);
	zassert_equal(fake.n_resistance + fake.n_sim, 0);
	page(b, 0x40u);
	zassert_false(trainer_cmd_fec(b, equip.epoch, 0u).answer);
}

ZTEST(trainer_cmd, test_fec_queued_before_a_local_stop_is_rejected)
{
	uint8_t b[8];
	struct trainer_fec_answer a;
	uint32_t rx = equip.epoch;

	bind(&fake_full, true);
	rx = equip.epoch;
	(void)trainer_equip_event(&equip, TRAINER_EVT_CONSOLE_STOP);

	page(b, RADIANT_PROFILE_FEC_PAGE_TARGET_POWER);
	b[6] = 0x20u;
	b[7] = 0x03u;
	a = trainer_cmd_fec(b, rx, 0u);
	zassert_true(a.answer);
	zassert_equal(a.status, RADIANT_PROFILE_FEC_CMD_STATUS_REJECTED);
	zassert_equal(fake.n_power, 0, "never reached the brake");
	zassert_equal(radiant_ctrl_owner(), RADIANT_CTRL_NONE, "and took no token");

	/* After a console reset too. */
	rx = equip.epoch;
	(void)trainer_equip_event(&equip, TRAINER_EVT_CONSOLE_RESET);
	page(b, RADIANT_PROFILE_FEC_PAGE_TRACK_RESISTANCE);
	a = trainer_cmd_fec(b, rx, 0u);
	zassert_equal(a.status, RADIANT_PROFILE_FEC_CMD_STATUS_REJECTED);
	zassert_equal(fake.n_sim, 0);
}

ZTEST(trainer_cmd, test_fec_is_rejected_while_ftms_holds_control)
{
	uint8_t b[8];
	static const uint8_t req_ctrl[] = { RADIANT_BLE_FTMS_OP_REQUEST_CONTROL };
	struct trainer_fec_answer a;

	bind(&fake_full, true);
	/* An FE-C page claims implicitly... */
	page(b, RADIANT_PROFILE_FEC_PAGE_TARGET_POWER);
	b[6] = 0x20u;
	b[7] = 0x03u;
	a = trainer_cmd_fec(b, equip.epoch, 0u);
	zassert_equal(a.status, RADIANT_PROFILE_FEC_CMD_STATUS_PASS);
	zassert_equal(radiant_ctrl_owner(), RADIANT_CTRL_ANT);

	/* ...an FTMS Request Control preempts it (explicit beats implicit)... */
	zassert_equal(cp(req_ctrl, 1u, RADIANT_BLE_FTMS_OWNER_NONE, equip.epoch).result,
		      RADIANT_BLE_FTMS_RESULT_SUCCESS);
	zassert_equal(radiant_ctrl_owner(), RADIANT_CTRL_BLE);

	/* ...and the next FE-C command is REJECTED, without reaching the brake. */
	a = trainer_cmd_fec(b, equip.epoch, 100u);
	zassert_equal(a.status, RADIANT_PROFILE_FEC_CMD_STATUS_REJECTED);
	zassert_equal(fake.n_power, 1);

	/* Page 55 is not gated: still applied. */
	page(b, RADIANT_PROFILE_FEC_PAGE_USER_CONFIG);
	b[1] = 0x58u; /* 7000 = 70.00 kg */
	b[2] = 0x1Bu;
	a = trainer_cmd_fec(b, equip.epoch, 100u);
	zassert_false(a.answer, "page 55 is not a control page");
	zassert_equal(fake.n_user, 1);
	zassert_equal(equip.user.user_weight_10g, 7000u);
}

ZTEST(trainer_cmd, test_fec_55_applies_with_defaults_for_sentinels)
{
	uint8_t b[8];
	struct trainer_fec_answer a;

	bind(&fake_full, true);
	page(b, RADIANT_PROFILE_FEC_PAGE_USER_CONFIG);
	b[1] = 0x40u; /* 0x1F40 = 80.00 kg */
	b[2] = 0x1Fu;
	b[4] = 0x45u; /* offset 5 mm, bike weight LSN 4 */
	b[5] = 0x0Bu; /* bike weight 0x0B4 = 180 x 0.05 = 9 kg */
	b[6] = 66u;   /* 0.66 m + 5 mm = 665 mm */
	b[7] = 0x00u; /* gear ratio invalid */
	a = trainer_cmd_fec(b, equip.epoch, 0u);
	zassert_false(a.answer);
	zassert_equal(fake.user.user_weight_10g, 8000u);
	zassert_equal(fake.user.bike_weight_50g, 180u);
	zassert_equal(fake.user.wheel_circ_deci_mm, 20892u, "665 mm x pi = 2089.2 mm");
	zassert_equal(a.ftms_status[0], RADIANT_BLE_FTMS_STATUS_WHEEL_CIRC);

	page(b, RADIANT_PROFILE_FEC_PAGE_USER_CONFIG);
	b[7] = 0x00u;
	(void)trainer_cmd_fec(b, equip.epoch, 0u);
	zassert_equal(fake.user.user_weight_10g, TRAINER_USER_DEFAULT_WEIGHT_10G);
	zassert_equal(fake.user.bike_weight_50g, TRAINER_USER_DEFAULT_BIKE_50G);
	zassert_equal(fake.user.wheel_circ_deci_mm, TRAINER_USER_DEFAULT_WHEEL_DECI_MM);
}

/* ── FTMS: the CP opcode -> hook -> status table ────────────────────────── */

ZTEST(trainer_cmd, test_ftms_targets_map_to_hooks_and_statuses)
{
	static const uint8_t req_ctrl[] = { RADIANT_BLE_FTMS_OP_REQUEST_CONTROL };
	static const uint8_t power[] = { RADIANT_BLE_FTMS_OP_SET_POWER, 0xFA, 0x00 };
	static const uint8_t resist[] = { RADIANT_BLE_FTMS_OP_SET_RESISTANCE, 40 };
	static const uint8_t sim[] = { RADIANT_BLE_FTMS_OP_SET_BIKE_SIM,
				       0xE8, 0x03, /* wind 1.000 m/s */
				       0x2C, 0x01, /* grade 3.00 % */
				       40,         /* crr 0.0040 */
				       51 };       /* cw 0.51 */
	static const uint8_t wheel[] = { RADIANT_BLE_FTMS_OP_SET_WHEEL_CIRC, 0x3A, 0x52 };
	struct radiant_ble_ftms_cp_outcome o;

	bind(&fake_full, true);
	zassert_equal(cp(req_ctrl, 1u, RADIANT_BLE_FTMS_OWNER_NONE, 0u).result,
		      RADIANT_BLE_FTMS_RESULT_SUCCESS);

	o = cp(power, sizeof(power), SELF, equip.epoch);
	zassert_equal(o.result, RADIANT_BLE_FTMS_RESULT_SUCCESS);
	zassert_equal(fake.power_w, 250u);
	zassert_equal(o.status[0], RADIANT_BLE_FTMS_STATUS_TARGET_POWER);
	zassert_equal(equip.mode, TRAINER_EQUIP_ERG);

	o = cp(resist, sizeof(resist), SELF, equip.epoch);
	zassert_equal(o.result, RADIANT_BLE_FTMS_RESULT_SUCCESS);
	zassert_equal(fake.permille, 200u, "4.0 = 20 %");
	zassert_equal(o.status[0], RADIANT_BLE_FTMS_STATUS_TARGET_RESISTANCE);
	zassert_equal(equip.mode, TRAINER_EQUIP_BASIC);

	o = cp(sim, sizeof(sim), SELF, equip.epoch);
	zassert_equal(o.result, RADIANT_BLE_FTMS_RESULT_SUCCESS);
	zassert_equal(fake.sim.wind_mm_s, 1000);
	zassert_equal(fake.sim.grade_centi_pct, 300);
	zassert_equal(fake.sim.crr_e5, 400u);
	zassert_equal(fake.sim.cw_centi, 51u);
	zassert_equal(o.status[0], RADIANT_BLE_FTMS_STATUS_BIKE_SIM);
	zassert_equal(o.status_len, 7u);
	zassert_equal(equip.mode, TRAINER_EQUIP_SIM);

	o = cp(wheel, sizeof(wheel), SELF, equip.epoch);
	zassert_equal(o.result, RADIANT_BLE_FTMS_RESULT_SUCCESS);
	zassert_equal(fake.user.wheel_circ_deci_mm, 21050u);
	zassert_equal(o.status[0], RADIANT_BLE_FTMS_STATUS_WHEEL_CIRC);
}

ZTEST(trainer_cmd, test_ftms_refusals)
{
	static const uint8_t req_ctrl[] = { RADIANT_BLE_FTMS_OP_REQUEST_CONTROL };
	static const uint8_t too_much[] = { RADIANT_BLE_FTMS_OP_SET_POWER, 0xD1, 0x07 };
	static const uint8_t level_high[] = { RADIANT_BLE_FTMS_OP_SET_RESISTANCE, 201 };
	static const uint8_t power[] = { RADIANT_BLE_FTMS_OP_SET_POWER, 100, 0 };
	static const uint8_t no_wheel[] = { RADIANT_BLE_FTMS_OP_SET_WHEEL_CIRC, 0, 0 };
	static const uint8_t sim[] = { RADIANT_BLE_FTMS_OP_SET_BIKE_SIM, 0, 0, 0, 0, 0, 0 };
	struct radiant_ble_ftms_cp_outcome o;
	uint32_t rx;

	bind(&fake_full, true);
	/* Without control: 0x05. */
	zassert_equal(cp(power, sizeof(power), RADIANT_BLE_FTMS_OWNER_NONE, 0u).result,
		      RADIANT_BLE_FTMS_RESULT_CONTROL_NOT_PERMITTED);
	(void)cp(req_ctrl, 1u, RADIANT_BLE_FTMS_OWNER_NONE, 0u);

	/* Outside the Supported Ranges: 0x03, nothing reaches the brake. */
	zassert_equal(cp(too_much, sizeof(too_much), SELF, equip.epoch).result,
		      RADIANT_BLE_FTMS_RESULT_INVALID_PARAM);
	zassert_equal(cp(level_high, sizeof(level_high), SELF, equip.epoch).result,
		      RADIANT_BLE_FTMS_RESULT_INVALID_PARAM);
	zassert_equal(cp(no_wheel, sizeof(no_wheel), SELF, equip.epoch).result,
		      RADIANT_BLE_FTMS_RESULT_INVALID_PARAM);
	zassert_equal(fake.n_power + fake.n_resistance + fake.n_user, 0);

	/* A hook failure: 0x04 and no status. */
	fake.rc = -EIO;
	o = cp(power, sizeof(power), SELF, equip.epoch);
	zassert_equal(o.result, RADIANT_BLE_FTMS_RESULT_OPERATION_FAILED);
	zassert_equal(o.status_len, 0u);
	fake.rc = 0;

	/* Queued before a local stop: 0x04 without reaching the brake. */
	rx = equip.epoch;
	(void)trainer_equip_event(&equip, TRAINER_EVT_CONSOLE_STOP);
	fake.n_power = 0;
	fake.n_sim = 0;
	zassert_equal(cp(power, sizeof(power), SELF, rx).result,
		      RADIANT_BLE_FTMS_RESULT_OPERATION_FAILED);
	zassert_equal(cp(sim, sizeof(sim), SELF, rx).result,
		      RADIANT_BLE_FTMS_RESULT_OPERATION_FAILED);
	zassert_equal(fake.n_power + fake.n_sim, 0);

	/* An op code the trainer lacks: 0x02. */
	bind(&fake_erg_only, true);
	(void)cp(req_ctrl, 1u, RADIANT_BLE_FTMS_OWNER_NONE, 0u);
	zassert_equal(cp(sim, sizeof(sim), SELF, equip.epoch).result,
		      RADIANT_BLE_FTMS_RESULT_OP_NOT_SUPPORTED);
}

ZTEST(trainer_cmd, test_ftms_workout_and_reset)
{
	static const uint8_t req_ctrl[] = { RADIANT_BLE_FTMS_OP_REQUEST_CONTROL };
	static const uint8_t start[] = { RADIANT_BLE_FTMS_OP_START_RESUME };
	static const uint8_t stop[] = { RADIANT_BLE_FTMS_OP_STOP_PAUSE, RADIANT_BLE_FTMS_PARAM_STOP };
	static const uint8_t pause[] = { RADIANT_BLE_FTMS_OP_STOP_PAUSE, RADIANT_BLE_FTMS_PARAM_PAUSE };
	static const uint8_t reset[] = { RADIANT_BLE_FTMS_OP_RESET };
	static const uint8_t power[] = { RADIANT_BLE_FTMS_OP_SET_POWER, 100, 0 };
	struct radiant_ble_ftms_cp_outcome o;
	uint32_t rx;

	bind(&fake_full, true);
	(void)cp(req_ctrl, 1u, RADIANT_BLE_FTMS_OWNER_NONE, 0u);

	zassert_equal(cp(start, 1u, SELF, equip.epoch).result, RADIANT_BLE_FTMS_RESULT_SUCCESS);
	zassert_equal(fake.workout, TRAINER_WORKOUT_START);
	/* Success means accepted: the session follows the driver's report. */
	zassert_equal(equip.run, TRAINER_RUN_IDLE);
	zassert_equal(cp(pause, 2u, SELF, equip.epoch).result, RADIANT_BLE_FTMS_RESULT_SUCCESS);
	zassert_equal(fake.workout, TRAINER_WORKOUT_PAUSE);

	/* Stop passes even when queued before a local stop. */
	rx = equip.epoch;
	(void)trainer_equip_event(&equip, TRAINER_EVT_CONSOLE_STOP);
	zassert_equal(cp(stop, 2u, SELF, rx).result, RADIANT_BLE_FTMS_RESULT_SUCCESS);
	zassert_equal(fake.workout, TRAINER_WORKOUT_STOP);
	zassert_equal(cp(start, 1u, SELF, rx).result, RADIANT_BLE_FTMS_RESULT_OPERATION_FAILED,
		      "a stale Start is refused");

	/* Reset: targets to default (flat road), view zeroed, control released. */
	(void)cp(power, sizeof(power), SELF, equip.epoch);
	zassert_equal(equip.mode, TRAINER_EQUIP_ERG);
	o = cp(reset, 1u, SELF, equip.epoch);
	zassert_equal(o.result, RADIANT_BLE_FTMS_RESULT_SUCCESS);
	zassert_equal(o.status[0], RADIANT_BLE_FTMS_STATUS_RESET);
	zassert_true(o.release && o.reset_view);
	zassert_equal(equip.mode, TRAINER_EQUIP_FREE);
	zassert_equal(fake.sim.grade_centi_pct, 0);
	zassert_equal(radiant_ctrl_owner(), RADIANT_CTRL_NONE);
	zassert_equal(cp(power, sizeof(power), RADIANT_BLE_FTMS_OWNER_NONE, equip.epoch).result,
		      RADIANT_BLE_FTMS_RESULT_CONTROL_NOT_PERMITTED);

	/* No workout hook: the mandatory op codes answer 0x04, never 0x02. */
	bind(&fake_erg_only, true);
	(void)cp(req_ctrl, 1u, RADIANT_BLE_FTMS_OWNER_NONE, 0u);
	zassert_equal(cp(start, 1u, SELF, equip.epoch).result,
		      RADIANT_BLE_FTMS_RESULT_OPERATION_FAILED);
	zassert_equal(cp(stop, 2u, SELF, equip.epoch).result,
		      RADIANT_BLE_FTMS_RESULT_OPERATION_FAILED);
}

ZTEST(trainer_cmd, test_ftms_hook_needs_the_ble_token)
{
	static const uint8_t power[] = { RADIANT_BLE_FTMS_OP_SET_POWER, 100, 0 };

	bind(&fake_full, true);
	/* A client the core thinks has control, but the arbiter was revoked
	 * underneath it: the hook refuses (0x04), the brake is untouched. */
	(void)radiant_ctrl_claim(RADIANT_CTRL_ANT, false, 0u);
	zassert_equal(cp(power, sizeof(power), SELF, equip.epoch).result,
		      RADIANT_BLE_FTMS_RESULT_OPERATION_FAILED);
	zassert_equal(fake.n_power, 0);

	/* Without an arbiter (ANT+-only build), no token check. */
	bind(&fake_full, false);
	zassert_equal(cp(power, sizeof(power), SELF, equip.epoch).result,
		      RADIANT_BLE_FTMS_RESULT_SUCCESS);
}

/* ── Reset: the brake release chosen from the declared capabilities (R5) ── */

static int reset_via_ftms(void)
{
	static const uint8_t req_ctrl[] = { RADIANT_BLE_FTMS_OP_REQUEST_CONTROL };
	static const uint8_t reset[] = { RADIANT_BLE_FTMS_OP_RESET };

	(void)cp(req_ctrl, 1u, RADIANT_BLE_FTMS_OWNER_NONE, 0u);
	return cp(reset, 1u, SELF, equip.epoch).result;
}

static int f2_power(uint16_t w)
{
	fake.n_power++;
	fake.power_w = w;
	return fake.rc;
}

static int f2_resistance(uint16_t pm)
{
	fake.n_resistance++;
	fake.permille = pm;
	return fake.rc;
}

static int f2_sim(const struct trainer_sim_params *p)
{
	fake.n_sim++;
	fake.sim = *p;
	return fake.rc;
}

ZTEST(trainer_cmd, test_reset_on_each_source_shape)
{
	static const struct trainer_source_ops resist_erg = {
		.set_target_power = f2_power, .set_resistance = f2_resistance,
	};
	static const struct trainer_source_ops sim_hook = {
		.set_target_power = f2_power, .set_sim = f2_sim,
	};
	struct trainer_cmd_cfg c;

	/* Full: simulation declared -> flat road, free ride. */
	bind(&fake_full, true);
	equip.mode = TRAINER_EQUIP_ERG;
	zassert_equal(reset_via_ftms(), RADIANT_BLE_FTMS_RESULT_SUCCESS);
	zassert_equal(fake.n_sim, 1);
	zassert_equal(fake.sim.grade_centi_pct, 0);
	zassert_equal(fake.n_resistance + fake.n_power, 0);
	zassert_equal(equip.mode, TRAINER_EQUIP_FREE);

	/* Resistance + ERG: resistance 0. */
	bind(&resist_erg, true);
	equip.mode = TRAINER_EQUIP_ERG;
	zassert_equal(reset_via_ftms(), RADIANT_BLE_FTMS_RESULT_SUCCESS);
	zassert_equal(fake.n_resistance, 1);
	zassert_equal(fake.permille, 0u);
	zassert_equal(fake.n_power, 0);
	zassert_equal(equip.mode, TRAINER_EQUIP_FREE);

	/* ERG only: the minimum target, and the state says ERG at it. */
	bind(&fake_erg_only, true);
	equip.mode = TRAINER_EQUIP_ERG;
	equip.target_power_w = 250u;
	zassert_equal(reset_via_ftms(), RADIANT_BLE_FTMS_RESULT_SUCCESS);
	zassert_equal(fake.n_power, 1);
	zassert_equal(fake.power_w, 0u);
	zassert_equal(equip.mode, TRAINER_EQUIP_ERG);
	zassert_equal(equip.target_power_w, 0u);

	/* A set_sim hook with simulation NOT declared (CAP_SIM=n): never used;
	 * ERG at the minimum instead. */
	fake_reset();
	trainer_equip_init(&equip, 0u);
	memset(&c, 0, sizeof(c));
	c.equip = &equip;
	c.src = &sim_hook;
	c.allow_erg = true;
	c.allow_resistance = true;
	c.allow_sim = false;
	c.min_power_w = 50u;
	c.max_power_w = 2000u;
	c.ctrl_owner = radiant_ctrl_owner;
	c.ctrl_claim = radiant_ctrl_claim;
	c.ctrl_gated = radiant_ctrl_fec_page_is_gated;
	trainer_cmd_bind(&c);
	radiant_ctrl_init(30000u, trainer_cmd_ctrl_gates());
	trainer_cmd_ftms_caps(&ftms_caps);
	zassert_equal(reset_via_ftms(), RADIANT_BLE_FTMS_RESULT_SUCCESS);
	zassert_equal(fake.n_sim, 0, "an undeclared mode is never entered");
	zassert_equal(fake.power_w, 50u);

	/* Nothing declared can release the brake: 0x04, mode kept. */
	bind(NULL, true);
	equip.mode = TRAINER_EQUIP_BASIC;
	zassert_equal(reset_via_ftms(), RADIANT_BLE_FTMS_RESULT_OPERATION_FAILED);
	zassert_equal(equip.mode, TRAINER_EQUIP_BASIC);

	/* A release the brake refuses: 0x04, mode kept. */
	bind(&fake_full, true);
	equip.mode = TRAINER_EQUIP_ERG;
	fake.rc = -EIO;
	zassert_equal(reset_via_ftms(), RADIANT_BLE_FTMS_RESULT_OPERATION_FAILED);
	zassert_equal(equip.mode, TRAINER_EQUIP_ERG);
}

ZTEST(trainer_cmd, test_bike_sim_status_carries_the_clamped_grade)
{
	static const uint8_t req_ctrl[] = { RADIANT_BLE_FTMS_OP_REQUEST_CONTROL };
	/* grade +300.00 % (0x7530), beyond FE-C's +200.00 % */
	static const uint8_t sim[] = { RADIANT_BLE_FTMS_OP_SET_BIKE_SIM, 0, 0, 0x30, 0x75, 40, 51 };
	struct radiant_ble_ftms_cp_outcome o;

	bind(&fake_full, true);
	(void)cp(req_ctrl, 1u, RADIANT_BLE_FTMS_OWNER_NONE, 0u);
	o = cp(sim, sizeof(sim), SELF, equip.epoch);
	zassert_equal(o.result, RADIANT_BLE_FTMS_RESULT_SUCCESS);
	zassert_equal(fake.sim.grade_centi_pct, 20000);
	zassert_equal((int16_t)(o.status[3] | (o.status[4] << 8)), 20000,
		      "0x12 reports the applied grade, not the requested one");
}

ZTEST(trainer_cmd, test_start_while_pedalling_is_a_no_op)
{
	static const uint8_t req_ctrl[] = { RADIANT_BLE_FTMS_OP_REQUEST_CONTROL };
	static const uint8_t start[] = { RADIANT_BLE_FTMS_OP_START_RESUME };
	struct trainer_report r;

	bind(&fake_full, true);
	zassert_true(ftms_caps.passive);
	memset(&r, 0, sizeof(r));
	r.pedalling = true;
	(void)trainer_equip_report(&equip, &r);
	zassert_equal(equip.run, TRAINER_RUN_RUNNING);
	(void)cp(req_ctrl, 1u, RADIANT_BLE_FTMS_OWNER_NONE, 0u);
	zassert_equal(cp(start, 1u, SELF, equip.epoch).result, RADIANT_BLE_FTMS_RESULT_SUCCESS);
	zassert_equal(fake.n_workout, 0, "already running: no hook");
}

ZTEST_SUITE(trainer_cmd, NULL, NULL, NULL, NULL, NULL);
```

## src/equip.c
```c
/* SPDX-License-Identifier: Apache-2.0 */
/*
 * trainer_equip: the session, the accumulators, the FE-C pages and echoes,
 * and the FTMS Indoor Bike Data record with its Reset baseline.
 */

#include <string.h>

#include <zephyr/ztest.h>

#include "trainer_equip.h"

static struct trainer_report riding(uint16_t w, uint8_t rpm, uint32_t mm_s)
{
	struct trainer_report r;

	memset(&r, 0, sizeof(r));
	r.power_w = w;
	r.power_valid = true;
	r.cadence_rpm = rpm;
	r.cadence_valid = true;
	r.speed_mm_s = mm_s;
	r.speed_valid = true;
	r.speed_virtual = true;
	r.resistance_n = 500u;
	r.resistance_valid = true;
	r.pedalling = (rpm != 0u);
	return r;
}

ZTEST(trainer_equip, test_pedalling_starts_a_session_from_idle_only)
{
	struct trainer_equip e;
	struct trainer_report r = riding(200u, 90u, 9000u);
	struct trainer_report still = riding(0u, 0u, 0u);

	trainer_equip_init(&e, 2000u);
	zassert_equal(e.run, TRAINER_RUN_IDLE);
	zassert_equal(trainer_equip_report(&e, &still), TRAINER_RUN_IDLE);
	zassert_equal(e.run, TRAINER_RUN_IDLE, "no pedalling, no session");
	zassert_equal(trainer_equip_report(&e, &r), TRAINER_RUN_IDLE);
	zassert_equal(e.run, TRAINER_RUN_RUNNING);

	/* PAUSED and STOPPED are left only by an explicit start or a console
	 * action, never by pedalling (the treadmill's rule). */
	(void)trainer_equip_event(&e, TRAINER_EVT_PAUSED);
	zassert_equal(e.run, TRAINER_RUN_PAUSED);
	(void)trainer_equip_report(&e, &r);
	zassert_equal(e.run, TRAINER_RUN_PAUSED, "pedalling does not resume a Pause");
	(void)trainer_equip_event(&e, TRAINER_EVT_STARTED);
	zassert_equal(e.run, TRAINER_RUN_RUNNING);

	/* STOPPED: legs still turning through the Stop do not restart it... */
	(void)trainer_equip_event(&e, TRAINER_EVT_STOPPED);
	zassert_equal(e.run, TRAINER_RUN_STOPPED);
	(void)trainer_equip_report(&e, &r);
	(void)trainer_equip_report(&e, &r);
	zassert_equal(e.run, TRAINER_RUN_STOPPED, "no fresh start yet");
	/* ...but a fresh start does: seen still, then pedalling again. */
	(void)trainer_equip_report(&e, &still);
	zassert_equal(e.run, TRAINER_RUN_STOPPED);
	zassert_equal(trainer_equip_report(&e, &r), TRAINER_RUN_STOPPED);
	zassert_equal(e.run, TRAINER_RUN_RUNNING, "a new ride after a Stop");

	/* The first report after the Stop being still counts as the edge. */
	(void)trainer_equip_event(&e, TRAINER_EVT_CONSOLE_STOP);
	(void)trainer_equip_report(&e, &still);
	(void)trainer_equip_report(&e, &r);
	zassert_equal(e.run, TRAINER_RUN_RUNNING);

	/* A stillness seen before the Stop does not count. */
	(void)trainer_equip_report(&e, &still);
	(void)trainer_equip_event(&e, TRAINER_EVT_STOPPED);
	(void)trainer_equip_report(&e, &r);
	zassert_equal(e.run, TRAINER_RUN_STOPPED);
	(void)trainer_equip_event(&e, TRAINER_EVT_STARTED);
	zassert_equal(e.run, TRAINER_RUN_RUNNING);

	/* A console reset returns to IDLE, from which pedalling starts. */
	(void)trainer_equip_event(&e, TRAINER_EVT_CONSOLE_STOP);
	zassert_equal(e.run, TRAINER_RUN_STOPPED);
	(void)trainer_equip_event(&e, TRAINER_EVT_CONSOLE_RESET);
	zassert_equal(e.run, TRAINER_RUN_IDLE);
	(void)trainer_equip_report(&e, &still);
	zassert_equal(e.run, TRAINER_RUN_IDLE);
	(void)trainer_equip_report(&e, &r);
	zassert_equal(e.run, TRAINER_RUN_RUNNING);
}

ZTEST(trainer_equip, test_only_local_stop_and_reset_move_the_epoch)
{
	struct trainer_equip e;
	struct trainer_report r = riding(200u, 90u, 9000u);
	uint32_t epoch;

	trainer_equip_init(&e, 2000u);
	(void)trainer_equip_report(&e, &r);
	epoch = e.epoch;

	(void)trainer_equip_event(&e, TRAINER_EVT_PAUSED);
	(void)trainer_equip_event(&e, TRAINER_EVT_STARTED);
	(void)trainer_equip_event(&e, TRAINER_EVT_STOPPED);
	zassert_equal(e.epoch, epoch, "state reports are not local stops");

	(void)trainer_equip_event(&e, TRAINER_EVT_STARTED);
	(void)trainer_equip_event(&e, TRAINER_EVT_CONSOLE_STOP);
	zassert_equal(e.epoch, epoch + 1u);
	zassert_equal(e.run, TRAINER_RUN_STOPPED);

	/* The equipment state's half of a console reset: the targets are the
	 * brake release's to change (trainer_cmd_release_brake()). */
	e.mode = TRAINER_EQUIP_ERG;
	e.target_power_w = 250u;
	(void)trainer_equip_event(&e, TRAINER_EVT_CONSOLE_RESET);
	zassert_equal(e.epoch, epoch + 2u);
	zassert_equal(e.run, TRAINER_RUN_IDLE);
	zassert_equal(e.mode, TRAINER_EQUIP_ERG, "not changed until the brake is released");

	/* FTMS Reset moves the epoch too (the treadmill's REMOTE_RESET). */
	(void)trainer_equip_report(&e, &r);
	zassert_equal(trainer_equip_ftms_reset(&e), TRAINER_RUN_RUNNING);
	zassert_equal(e.epoch, epoch + 3u);
	zassert_equal(e.run, TRAINER_RUN_IDLE);
}

ZTEST(trainer_equip, test_tick_accumulates_only_while_running)
{
	struct trainer_equip e;
	struct trainer_report r = riding(200u, 90u, 10000u); /* 10 m/s */

	trainer_equip_init(&e, 2000u);
	e.rep = r; /* a report, but the session is still IDLE */
	trainer_equip_tick(&e, 250u);
	zassert_equal(e.elapsed_ms, 0u);
	zassert_equal(e.distance_um, 0u);
	zassert_equal(e.event_count, 1u, "page 25 events count regardless");
	zassert_equal(e.acc_power_w, 200u);

	(void)trainer_equip_report(&e, &r);
	for (int i = 0; i < 40; i++) {
		trainer_equip_tick(&e, 250u);
	}
	zassert_equal(e.elapsed_ms, 10000u);
	zassert_equal(e.distance_um, 100000000ull, "100 m in 10 s at 10 m/s");
	zassert_equal(e.event_count, 41u);
	zassert_equal(e.acc_power_w, (uint16_t)(41u * 200u));
}

ZTEST(trainer_equip, test_pages_16_17_25_from_the_state)
{
	struct trainer_equip e;
	struct trainer_report r = riding(321u, 85u, 8333u);
	struct radiant_profile_fec_general g;
	struct radiant_profile_fec_settings s;
	struct radiant_profile_fec_trainer t;

	trainer_equip_init(&e, 2000u);
	(void)trainer_equip_report(&e, &r);
	e.sim.grade_centi_pct = 450;
	trainer_equip_tick(&e, 250u);
	trainer_equip_pages(&e, &g, &s, &t);

	zassert_equal(g.equipment_type, RADIANT_PROFILE_FEC_TYPE_TRAINER);
	zassert_equal(g.speed_mm_s, 8333u);
	zassert_true(g.speed_valid && g.speed_virtual && g.distance_valid);
	zassert_equal(g.elapsed_time_qs, 1u);
	zassert_equal(g.state, RADIANT_PROFILE_FEC_STATE_IN_USE);

	zassert_equal(s.incline_centi_pct, 450, "SS8.8.4.1: incline = grade");
	zassert_true(s.resistance_valid);
	zassert_equal(s.resistance_half_pct, 50u, "500 N of 2000 N = 25 % = 50");

	zassert_equal(t.inst_power_w, 321u);
	zassert_equal(t.cadence_rpm, 85u);
	zassert_equal(t.event_count, 1u);
	zassert_equal(t.flags, RADIANT_PROFILE_FEC_TARGET_POWER_OK);

	/* BASIC reports the commanded share; ERG reports the speed flag. */
	e.mode = TRAINER_EQUIP_BASIC;
	e.resistance_permille = 375u;
	e.rep.erg_speed_low = true;
	trainer_equip_pages(&e, &g, &s, &t);
	zassert_equal(s.resistance_half_pct, 75u);
	zassert_equal(t.flags, RADIANT_PROFILE_FEC_TARGET_POWER_OK, "flag is ERG-only");
	e.mode = TRAINER_EQUIP_ERG;
	trainer_equip_pages(&e, &g, &s, &t);
	zassert_equal(t.flags, RADIANT_PROFILE_FEC_TARGET_POWER_SPEED_LOW);

	/* No force and no maximum: page 17's resistance is invalid. */
	e.mode = TRAINER_EQUIP_FREE;
	e.max_resistance_n = 0u;
	trainer_equip_pages(&e, &g, &s, &t);
	zassert_false(s.resistance_valid);

	(void)trainer_equip_event(&e, TRAINER_EVT_PAUSED);
	trainer_equip_pages(&e, &g, &s, &t);
	zassert_equal(g.state, RADIANT_PROFILE_FEC_STATE_FINISHED);
}

ZTEST(trainer_equip, test_echo_pages_carry_the_settings_in_use)
{
	struct trainer_equip e;
	struct radiant_profile_fec_cmd_wind_resistance w;
	struct radiant_profile_fec_cmd_track_resistance tr;
	struct radiant_profile_fec_cmd_user_config u;

	trainer_equip_init(&e, 2000u);
	e.sim.cw_centi = 60u;
	e.sim.wind_mm_s = -2778; /* -10 km/h */
	e.sim.drafting_centi = 80u;
	e.sim.grade_centi_pct = -250;
	e.sim.crr_e5 = 500u; /* 0.005 */
	e.user.user_weight_10g = 8000u;
	e.user.bike_weight_50g = 180u;
	e.user.wheel_circ_deci_mm = 21991u; /* 700 mm diameter */
	trainer_equip_echo(&e, &w, &tr, &u);

	zassert_equal(w.coefficient_centi, 60u);
	zassert_equal(w.wind_speed_kph, -10);
	zassert_equal(w.drafting_centi, 80u);
	zassert_equal(tr.grade_centi_pct, -250);
	zassert_equal(tr.rolling_resistance, 100u, "0.005 in 5e-5 units");
	zassert_equal(u.user_weight_10g, 8000u);
	zassert_equal(u.bike_weight_50g, 180u);
	zassert_equal(u.wheel_diameter_cm, 70u);
	zassert_equal(u.wheel_offset_mm, 0u);
	zassert_false(u.gear_ratio_valid);
}

/* Parse an Indoor Bike Data record the way a client does: by the flags. */
ZTEST(trainer_equip, test_indoor_bike_data_layout_and_reset_baseline)
{
	struct trainer_equip e;
	struct trainer_report r = riding(250u, 92u, 10000u);
	uint8_t b[TRAINER_IBD_LEN];
	uint16_t flags;
	uint32_t dist;

	trainer_equip_init(&e, 2000u);
	(void)trainer_equip_report(&e, &r);
	for (int i = 0; i < 80; i++) {
		trainer_equip_tick(&e, 250u); /* 20 s, 200 m */
	}
	e.mode = TRAINER_EQUIP_BASIC;
	e.resistance_permille = 500u;

	zassert_equal(trainer_equip_ibd_encode(&e, b, sizeof(b)), (int)TRAINER_IBD_LEN);
	flags = (uint16_t)(b[0] | (b[1] << 8));
	zassert_equal(flags, 0x0874u, "speed, cadence, distance, resistance, power, elapsed");
	zassert_equal(b[2] | (b[3] << 8), 3600, "10 m/s = 36.00 km/h");
	zassert_equal(b[4] | (b[5] << 8), 184, "92 rpm in 0.5 units");
	dist = (uint32_t)(b[6] | (b[7] << 8) | (b[8] << 16));
	zassert_equal(dist, 200u);
	zassert_equal((int16_t)(b[9] | (b[10] << 8)), 10, "50 % = level 10.0, resolution 1");
	zassert_equal((int16_t)(b[11] | (b[12] << 8)), 250);
	zassert_equal(b[13] | (b[14] << 8), 20);

	/* FTMS Reset zeros the FTMS view only. */
	zassert_equal(trainer_equip_ftms_reset(&e), TRAINER_RUN_RUNNING);
	zassert_equal(e.run, TRAINER_RUN_IDLE);
	zassert_equal(trainer_equip_ibd_encode(&e, b, sizeof(b)), (int)TRAINER_IBD_LEN);
	zassert_equal(b[6] | (b[7] << 8) | (b[8] << 16), 0);
	zassert_equal(b[13] | (b[14] << 8), 0);
	zassert_equal(e.elapsed_ms, 20000u, "the ANT+ accumulators do not move");

	(void)trainer_equip_report(&e, &r);
	for (int i = 0; i < 8; i++) {
		trainer_equip_tick(&e, 250u);
	}
	zassert_equal(trainer_equip_ibd_encode(&e, b, sizeof(b)), (int)TRAINER_IBD_LEN);
	zassert_equal(b[13] | (b[14] << 8), 2);
	zassert_equal(b[6] | (b[7] << 8) | (b[8] << 16), 20);

	zassert_equal(trainer_equip_ibd_encode(&e, b, 10u), -ENOSPC);
	zassert_equal(trainer_equip_ibd_encode(NULL, b, sizeof(b)), -EINVAL);
}

ZTEST_SUITE(trainer_equip, NULL, NULL, NULL, NULL, NULL);
```

## src/fake.h
```c
/* SPDX-License-Identifier: Apache-2.0 */
#ifndef SMART_TRAINER_TEST_FAKE_H_
#define SMART_TRAINER_TEST_FAKE_H_

#include "trainer_source.h"

struct fake_state {
	int rc;
	int n_power, n_resistance, n_sim, n_user, n_workout;
	uint16_t power_w;
	uint16_t permille;
	struct trainer_sim_params sim;
	struct trainer_user user;
	enum trainer_workout workout;
};

extern struct fake_state fake;
extern const struct trainer_source_ops fake_full;
extern const struct trainer_source_ops fake_erg_only;

void fake_reset(void);

#endif
```

## src/logic.c
```c
/* SPDX-License-Identifier: Apache-2.0 */
/*
 * trainer_logic (main.c's decisions, now kernel-free) against the real FE-C
 * master, and trainer_inbox's ordering rule.
 */

#include <string.h>

#include <zephyr/ztest.h>

#include <radiant/radiant_ble_ftms.h>
#include <radiant/radiant_ctrl_arbiter.h>
#include <radiant/radiant_profile_fec_tx.h>

#include "fake.h"
#include "trainer_cmd.h"
#include "trainer_equip.h"
#include "trainer_inbox.h"
#include "trainer_ble_svc.h"
#include "trainer_logic.h"

static struct trainer_equip equip;
static struct radiant_profile_fec_tx fec;

static int session_calls;
static int session_notified;
static enum trainer_run last_prev, last_next;
static int status_calls;
static uint8_t last_status[RADIANT_BLE_FTMS_STATUS_MAX];

static void on_session(enum trainer_run prev, enum trainer_run next, bool notify, void *ctx)
{
	ARG_UNUSED(ctx);
	session_calls++;
	if (notify && prev != next) {
		session_notified++;
	}
	last_prev = prev;
	last_next = next;
}

static void on_status(const uint8_t *msg, size_t len, void *ctx)
{
	ARG_UNUSED(ctx);
	status_calls++;
	memcpy(last_status, msg, MIN(len, sizeof(last_status)));
}

/* What main.c's publish() does each tick for the echo pages. */
static void publish(void)
{
	struct radiant_profile_fec_cmd_wind_resistance w;
	struct radiant_profile_fec_cmd_track_resistance tr;
	struct radiant_profile_fec_cmd_user_config u;

	trainer_equip_echo(&equip, &w, &tr, &u);
	radiant_profile_fec_tx_set_wind(&fec, &w);
	radiant_profile_fec_tx_set_track(&fec, &tr);
	radiant_profile_fec_tx_set_user(&fec, &u);
}

static void setup(const struct trainer_source_ops *src)
{
	struct trainer_cmd_cfg c;
	struct radiant_profile_fec_tx_cfg fc;
	struct trainer_logic_cfg lc;

	fake_reset();
	session_calls = session_notified = status_calls = 0;
	trainer_equip_init(&equip, (src != NULL) ? src->max_resistance_n : 0u);
	memset(&c, 0, sizeof(c));
	c.equip = &equip;
	c.src = src;
	c.allow_erg = c.allow_resistance = c.allow_sim = true;
	c.max_power_w = 2000u;
	c.ctrl_owner = radiant_ctrl_owner;
	c.ctrl_claim = radiant_ctrl_claim;
	c.ctrl_gated = radiant_ctrl_fec_page_is_gated;
	trainer_cmd_bind(&c);
	radiant_ctrl_init(30000u, trainer_cmd_ctrl_gates());

	memset(&fc, 0, sizeof(fc));
	fc.id.manufacturer_id = 255u;
	fc.id.serial_number = RADIANT_PROFILE_COMMON_INVALID_U32;
	fc.id.sw_revision_supplemental = RADIANT_PROFILE_COMMON_INVALID_U8;
	fc.equipment_type = RADIANT_PROFILE_FEC_TYPE_TRAINER;
	fc.caps.capabilities = trainer_cmd_fec_capabilities();
	fc.caps.max_resistance_n = equip.max_resistance_n;
	fc.caps.max_resistance_valid = true;
	zassert_equal(radiant_profile_fec_tx_init(&fec, &fc), 0);

	memset(&lc, 0, sizeof(lc));
	lc.equip = &equip;
	lc.fec = &fec;
	lc.session_changed = on_session;
	lc.ftms_status = on_status;
	trainer_logic_init(&lc);
	publish();
}

static void page(uint8_t *b, uint8_t p)
{
	memset(b, 0xFF, 8);
	b[0] = p;
}

static void power_page(uint8_t *b)
{
	page(b, RADIANT_PROFILE_FEC_PAGE_TARGET_POWER);
	b[6] = 0x20u; /* 0x0320 x 0.25 W = 200 W */
	b[7] = 0x03u;
}

static void request(uint8_t *b, uint8_t p)
{
	page(b, RADIANT_PROFILE_FEC_PAGE_REQUEST);
	b[5] = 1u;
	b[6] = p;
	b[7] = RADIANT_PROFILE_FEC_REQUEST_CMD_DATA_PAGE;
}

static bool find_page(uint8_t want, uint8_t *got)
{
	for (int i = 0; i < 40; i++) {
		uint8_t b[8];

		(void)radiant_profile_fec_tx_next(&fec, b);
		if (b[0] == want) {
			memcpy(got, b, 8);
			return true;
		}
	}
	return false;
}

/* ── Page 70 -> 54/55/71 round trips ─────────────────────────────────────── */

ZTEST(trainer_logic, test_page_70_round_trips_report_the_trainer)
{
	uint8_t b[8];
	uint8_t got[8];

	setup(&fake_full);

	request(b, RADIANT_PROFILE_FEC_PAGE_CAPABILITIES);
	trainer_logic_fec_page(b, equip.epoch, 0u);
	zassert_equal(trainer_logic_sequence(), RADIANT_PROFILE_FEC_CMD_NO_SEQ,
		      "a request is not a command");
	zassert_true(find_page(RADIANT_PROFILE_FEC_PAGE_CAPABILITIES, got));
	zassert_equal(got[7], 0x07u);
	zassert_equal(got[5] | (got[6] << 8), 2000);

	/* A page 49; then 71 on request reports 49, not the request. */
	power_page(b);
	trainer_logic_fec_page(b, equip.epoch, 0u);
	zassert_equal(trainer_logic_sequence(), 0u, "255 -> 0 at the first command");
	zassert_equal(status_calls, 1, "FTMS subscribers hear the new target");
	zassert_equal(last_status[0], RADIANT_BLE_FTMS_STATUS_TARGET_POWER);
	zassert_true(find_page(RADIANT_PROFILE_FEC_PAGE_CMD_STATUS, got));
	request(b, RADIANT_PROFILE_FEC_PAGE_CMD_STATUS);
	trainer_logic_fec_page(b, equip.epoch, 0u);
	zassert_true(find_page(RADIANT_PROFILE_FEC_PAGE_CMD_STATUS, got));
	zassert_equal(got[1], RADIANT_PROFILE_FEC_PAGE_TARGET_POWER);
	zassert_equal(got[2], 0u);
	zassert_equal(got[3], RADIANT_PROFILE_FEC_CMD_STATUS_PASS);
	zassert_equal(got[6], 0x20u, "Table 8-49: target power LSB echoed");
	zassert_equal(got[7], 0x03u);

	/* 55 after an FE-C page 55: not a command (no sequence), echoed. */
	page(b, RADIANT_PROFILE_FEC_PAGE_USER_CONFIG);
	b[1] = 0x40u; /* 80.00 kg */
	b[2] = 0x1Fu;
	b[4] = 0x40u;
	b[5] = 0x0Bu; /* bike 9.00 kg */
	b[6] = 70u;
	b[7] = 0x00u;
	trainer_logic_fec_page(b, equip.epoch, 0u);
	zassert_equal(trainer_logic_sequence(), 0u);
	publish();
	request(b, RADIANT_PROFILE_FEC_PAGE_USER_CONFIG);
	trainer_logic_fec_page(b, equip.epoch, 0u);
	zassert_true(find_page(RADIANT_PROFILE_FEC_PAGE_USER_CONFIG, got));
	zassert_equal(got[1] | (got[2] << 8), 8000);
	zassert_equal(got[6], 70u);
	zassert_equal((got[4] >> 4) | (got[5] << 4), 180);
}

/* ── Sequence and the drop path (R10) ───────────────────────────────────── */

ZTEST(trainer_logic, test_sequence_counts_supported_commands_only)
{
	uint8_t b[8];

	setup(&fake_erg_only);
	page(b, RADIANT_PROFILE_FEC_PAGE_TRACK_RESISTANCE);
	trainer_logic_fec_page(b, equip.epoch, 0u);
	zassert_equal(trainer_logic_sequence(), RADIANT_PROFILE_FEC_CMD_NO_SEQ,
		      "an unsupported page is ignored, not counted");
	power_page(b);
	for (int i = 0; i < 256; i++) {
		trainer_logic_fec_page(b, equip.epoch, (uint32_t)i);
	}
	zassert_equal(trainer_logic_sequence(), 0u, "0..254 then back to 0, never 255");
}

ZTEST(trainer_logic, test_dropped_page_answered_only_when_supported)
{
	uint8_t got[8];

	setup(&fake_erg_only);
	trainer_logic_fec_dropped(RADIANT_PROFILE_FEC_PAGE_TRACK_RESISTANCE);
	trainer_logic_fec_dropped(RADIANT_PROFILE_FEC_PAGE_USER_CONFIG);
	trainer_logic_fec_dropped(RADIANT_PROFILE_FEC_PAGE_REQUEST);
	zassert_equal(trainer_logic_sequence(), RADIANT_PROFILE_FEC_CMD_NO_SEQ);
	zassert_false(find_page(RADIANT_PROFILE_FEC_PAGE_CMD_STATUS, got));

	trainer_logic_fec_dropped(RADIANT_PROFILE_FEC_PAGE_TARGET_POWER);
	zassert_equal(trainer_logic_sequence(), 0u);
	zassert_true(find_page(RADIANT_PROFILE_FEC_PAGE_CMD_STATUS, got));
	zassert_equal(got[1], RADIANT_PROFILE_FEC_PAGE_TARGET_POWER);
	zassert_equal(got[3], RADIANT_PROFILE_FEC_CMD_STATUS_FAIL);
}

/* ── Resets ─────────────────────────────────────────────────────────────── */

ZTEST(trainer_logic, test_console_reset_releases_the_brake)
{
	uint8_t b[8];

	setup(&fake_full);
	power_page(b);
	trainer_logic_fec_page(b, equip.epoch, 0u);
	zassert_equal(equip.mode, TRAINER_EQUIP_ERG);

	zassert_equal(trainer_logic_event(TRAINER_EVT_CONSOLE_RESET), 0);
	zassert_equal(fake.n_sim, 1, "commanded through the hooks");
	zassert_equal(fake.sim.grade_centi_pct, 0);
	zassert_equal(equip.mode, TRAINER_EQUIP_FREE);
	zassert_equal(equip.run, TRAINER_RUN_IDLE);

	/* A brake that refuses: the error comes back, the mode is kept. */
	trainer_logic_fec_page(b, equip.epoch, 0u);
	fake.rc = -EIO;
	zassert_equal(trainer_logic_event(TRAINER_EVT_CONSOLE_RESET), -EIO);
	zassert_equal(equip.mode, TRAINER_EQUIP_ERG);
}

ZTEST(trainer_logic, test_ftms_reset_is_quiet_and_moves_the_epoch)
{
	uint8_t b[8];
	struct trainer_report r;
	uint32_t rx;

	setup(&fake_full);
	memset(&r, 0, sizeof(r));
	r.pedalling = true;
	trainer_logic_report(&r);
	zassert_equal(session_notified, 1, "IDLE -> RUNNING is notified");

	/* A page 49 received before the Reset, applied after it. */
	rx = equip.epoch;
	trainer_logic_ftms_reset_done();
	zassert_equal(equip.run, TRAINER_RUN_IDLE);
	zassert_equal(last_next, TRAINER_RUN_IDLE);
	zassert_equal(session_notified, 1,
		      "no Stopped/Idle from here: the core sends Reset (0x01) and Idle");
	zassert_equal(equip.epoch, rx + 1u);

	power_page(b);
	trainer_logic_fec_page(b, rx, 0u);
	zassert_equal(fake.n_power, 0, "the queued page does not re-apply a target");
	zassert_equal(trainer_logic_sequence(), 0u, "but it is answered (REJECTED)");
}

/* ── The inbox (R2) ─────────────────────────────────────────────────────── */

ZTEST(trainer_logic, test_an_event_drops_the_report_from_before_it)
{
	struct trainer_inbox ib;
	struct trainer_report r;
	struct trainer_report out;
	enum trainer_source_event evt;

	trainer_inbox_init(&ib);
	memset(&r, 0, sizeof(r));
	r.pedalling = true;
	r.power_w = 111u;
	trainer_inbox_report(&ib, &r);
	zassert_equal(trainer_inbox_event(&ib, TRAINER_EVT_PAUSED), 0);
	zassert_equal(trainer_inbox_pop(&ib, &out, &evt), TRAINER_INBOX_EVENT);
	zassert_equal(evt, TRAINER_EVT_PAUSED);
	zassert_equal(trainer_inbox_pop(&ib, &out, &evt), TRAINER_INBOX_EMPTY,
		      "the pedalling report from before the Pause is gone");

	/* A report after the event is kept, and comes after it. */
	(void)trainer_inbox_event(&ib, TRAINER_EVT_STOPPED);
	r.power_w = 222u;
	trainer_inbox_report(&ib, &r);
	zassert_equal(trainer_inbox_pop(&ib, &out, &evt), TRAINER_INBOX_EVENT);
	zassert_equal(trainer_inbox_pop(&ib, &out, &evt), TRAINER_INBOX_REPORT);
	zassert_equal(out.power_w, 222u);

	/* Through the logic: the Pause holds. */
	setup(&fake_full);
	trainer_logic_report(&r);
	zassert_equal(equip.run, TRAINER_RUN_RUNNING);
	(void)trainer_logic_event(TRAINER_EVT_PAUSED);
	trainer_logic_report(&r); /* even a late pedalling report */
	zassert_equal(equip.run, TRAINER_RUN_PAUSED);

	/* A full queue refuses the event and keeps the report. */
	trainer_inbox_init(&ib);
	trainer_inbox_report(&ib, &r);
	for (unsigned int i = 0; i < TRAINER_INBOX_EVENTS - 1u; i++) {
		zassert_equal(trainer_inbox_event(&ib, TRAINER_EVT_STARTED), 0);
	}
	trainer_inbox_report(&ib, &r);
	zassert_equal(trainer_inbox_event(&ib, TRAINER_EVT_STOPPED), -ENOMEM);
	zassert_true(ib.have_rep);
}

/* ── Advertising Service Data (B1) ──────────────────────────────────────── */

ZTEST(trainer_logic, test_indoor_bike_service_data_bytes)
{
	/* The very initialiser trainer_ble.c advertises. */
	static const uint8_t advertised[RADIANT_BLE_FTMS_SVC_DATA_LEN] =
		TRAINER_FTMS_SVC_DATA_INIT;
	static const uint8_t on_air[RADIANT_BLE_FTMS_SVC_DATA_LEN] = { 0x26, 0x18, 0x01, 0x20, 0x00 };
	uint8_t core[RADIANT_BLE_FTMS_SVC_DATA_LEN];

	zassert_equal(radiant_ble_ftms_service_data(core, sizeof(core), true,
						    RADIANT_BLE_FTMS_TYPE_INDOOR_BIKE),
		      sizeof(core));
	zassert_mem_equal(advertised, core, sizeof(core),
			  "trainer_ble_svc.h must equal the core's bytes");
	zassert_mem_equal(advertised, on_air, sizeof(on_air), "0x1826, available, bit 5");
}

ZTEST_SUITE(trainer_logic, NULL, NULL, NULL, NULL, NULL);
```
