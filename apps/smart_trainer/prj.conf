## CMakeLists.txt
```
# SPDX-License-Identifier: Apache-2.0

cmake_minimum_required(VERSION 3.20.0)

# RadiANT smart trainer: the mixed ANT+ FE-C / BLE FTMS reference design for a
# controllable bike trainer. See src/main.c for what it is, src/trainer_source.h
# for the one seam a manufacturer implements, and
# docs/smart-trainer-reference-design.md for the porting guide.
#
# Built like apps/treadmill: radiant and radiant/src/profiles, no sdk-ant, the
# nrf backend by default (never null - see cmake/radiant_backend.cmake).
#
# NOT apps/trainer. That image is an ACK-fault instrument and refuses BLE by
# construction; this one is a product and carries BLE through the MPSL gate.
# It shares exactly one file with it: apps/trainer/src/trainer_model.c, the
# FE-C SS8.8.4 physics behind the simulated source, compiled from there below
# rather than copied.
include("${CMAKE_CURRENT_SOURCE_DIR}/../../cmake/radiant_backend.cmake")
radiant_select_backend("${CMAKE_CURRENT_SOURCE_DIR}/../../radiant" "nrf" RADIANT_BACKEND_CONF)

set(smart_trainer_backend_conf "${CMAKE_CURRENT_BINARY_DIR}/smart_trainer_backend.conf")
file(WRITE "${smart_trainer_backend_conf}"
"# Generated by apps/smart_trainer/CMakeLists.txt from -DRADIANT_BACKEND. Do not edit.
CONFIG_RADIANT=y
CONFIG_RADIANT_ANT_API=y
${RADIANT_BACKEND_CONF}
")
list(APPEND EXTRA_CONF_FILE "${smart_trainer_backend_conf}")

find_package(Zephyr REQUIRED HINTS $ENV{ZEPHYR_BASE})
project(radiant_smart_trainer)

# The BLE interlock from the other side, as apps/treadmill's: CONFIG_BT without
# SMART_TRAINER_BLE (which selects the MPSL gate) makes radiant's nrf arm
# unselectable, and Kconfig silently falls back to the null backend.
if(CONFIG_BT AND NOT CONFIG_SMART_TRAINER_BLE)
  message(FATAL_ERROR
    "smart_trainer: CONFIG_BT is set but CONFIG_SMART_TRAINER_BLE is not.\n"
    "  Without the MPSL gate the nrf backend is unselectable and Kconfig "
    "falls back to the null backend - a node that puts nothing on the air.\n"
    "  Turn BLE on through this application's own symbol:\n"
    "    west build ... -- -Dsmart_trainer_EXTRA_CONF_FILE=ble.conf\n"
    "  THE PREFIX IS THE BASENAME OF THIS DIRECTORY (sysbuild names the image "
    "after it); a wrong prefix is accepted in silence.")
endif()

radiant_assert_backend("smart_trainer")

target_include_directories(app PRIVATE src ../trainer/src)

target_sources(app PRIVATE
  src/main.c
  src/trainer_source.c
  # Kernel-free: tests/glue compiles all of these.
  src/trainer_equip.c
  src/trainer_cmd.c
  src/trainer_logic.c
  src/trainer_inbox.c
  src/trainer_sim_model.c
  # apps/trainer's FE-C SS8.8.4 model, reused in place (trainer_sim_model.c
  # wraps it).
  ../trainer/src/trainer_model.c
)

if(CONFIG_SMART_TRAINER_SOURCE_SIMULATED)
  target_sources(app PRIVATE src/trainer_sim.c)
else()
  target_sources(app PRIVATE src/trainer_source_custom.c)
endif()

if(CONFIG_SMART_TRAINER_BLE)
  target_sources(app PRIVATE src/trainer_ble.c)
endif()

include("${CMAKE_CURRENT_SOURCE_DIR}/../common/sources.cmake")

# radiant/src/profiles: the FE-C master and what the slot engine needs - the
# same list apps/treadmill and apps/trainer link.
target_sources(app PRIVATE
  ../../radiant/src/profiles/radiant_profile_bits.c
  ../../radiant/src/profiles/radiant_profile_common.c
  ../../radiant/src/profiles/radiant_profile_sched.c
  ../../radiant/src/profiles/radiant_profile_schedule.c
  ../../radiant/src/profiles/radiant_profile_telemetry.c
  ../../radiant/src/profiles/radiant_profile_handoff.c
  ../../radiant/src/profiles/radiant_profile_fec_tx.c
)

target_sources(app PRIVATE
  ../../radiant/src/node/radiant_node_ident.c
  ../../radiant/src/node/radiant_node_nvm_settings.c
)
```

## Kconfig
```
# SPDX-License-Identifier: Apache-2.0
#
# RadiANT smart trainer. See src/main.c and docs/smart-trainer-reference-design.md.

rsource "../../radiant/src/node/Kconfig"
rsource "../../radiant/src/profiles/Kconfig"
rsource "../common/Kconfig.ant_api"

# Redeclared defaults go BEFORE Kconfig.zephyr, or they are silently dead.
config MPSL_TIMESLOT_SESSION_COUNT
	default 2 if SMART_TRAINER_BLE && RADIANT_GATE_MPSL_D2
	default 1 if SMART_TRAINER_BLE

config BT_PERIPHERAL_PREF_MIN_INT
	default SMART_TRAINER_BLE_MIN_CONN_INTERVAL_UNITS if SMART_TRAINER_BLE

config BT_PERIPHERAL_PREF_MAX_INT
	default SMART_TRAINER_BLE_MIN_CONN_INTERVAL_UNITS if SMART_TRAINER_BLE

config BT_PERIPHERAL_PREF_LATENCY
	default 0 if SMART_TRAINER_BLE

config BT_PERIPHERAL_PREF_TIMEOUT
	default 400 if SMART_TRAINER_BLE

config RADIANT_BLE_CONN_MIN_INTERVAL_UNITS
	default SMART_TRAINER_BLE_MIN_CONN_INTERVAL_UNITS if SMART_TRAINER_BLE

source "Kconfig.zephyr"

menuconfig SMART_TRAINER
	bool "RadiANT smart trainer"
	default y
	select RADIANT_PRODUCT
	select RADIANT_PRODUCT_APP_UNIT_BOOT
	help
	  A controllable bike trainer: ANT+ FE-C (0x11, equipment type 25)
	  with FTMS Indoor Bike over BLE beside it on one radio, one
	  equipment state behind both, and the shared FE-C/FTMS control
	  arbiter between them. See docs/smart-trainer-reference-design.md.

if SMART_TRAINER

config SMART_TRAINER_DEVICE_NUMBER
	int "ANT device number used only when identity boot fails"
	range 1 65535
	default 4245
	help
	  Used only when radiant_node_ident_boot() fails, and then logged as an
	  error: every trainer built from one image would share it. A strict
	  build (dual.conf) never uses it - it stays off the air and retries.
	  4245 so the reference designs on one bench are distinct devices
	  (hrm_ble 4242, treadmill 4243, the trainer simulator 4244).

choice SMART_TRAINER_SOURCE
	prompt "trainer source"
	default SMART_TRAINER_SOURCE_SIMULATED
	help
	  Which implementation of src/trainer_source.h's seam is compiled in.

config SMART_TRAINER_SOURCE_SIMULATED
	bool "simulated - a synthetic rider on apps/trainer's physics model"
	help
	  src/trainer_sim.c: a 200 W / 90 rpm rider on the FE-C SS8.8.4 model
	  of apps/trainer/src/trainer_model.c (compiled from there, not
	  copied). It honours every control mode, so both radios' command
	  paths reach a brake that answers.

config SMART_TRAINER_SOURCE_CUSTOM
	bool "custom - your driver, registered at boot"
	help
	  Nothing in this tree implements the seam under this option. Your
	  driver calls trainer_source_register() from a SYS_INIT. Without
	  one, the trainer transmits with every measurement invalid and no
	  control mode declared - never a simulated rider on a real machine.

endchoice

config SMART_TRAINER_SIM_BUTTONS
	bool "simulator: the DK's four buttons are the console"
	depends on SMART_TRAINER_SOURCE_SIMULATED
	depends on GPIO
	depends on $(dt_alias_enabled,sw0) && $(dt_alias_enabled,sw1)
	depends on $(dt_alias_enabled,sw2) && $(dt_alias_enabled,sw3)
	default y
	help
	  sw0 opens the BLE pairing window (hold 5 s to forget every bond),
	  sw1 stops/resumes the simulated rider, sw2 is a console stop and
	  sw3 a console reset (both bump the session epoch).

# ── Advertised capabilities ──────────────────────────────────────────────────
#
# Each can only TAKE AWAY a capability the source has: a mode is declared (FE-C
# page 54, FTMS Target Setting) exactly when its hook exists AND this is on,
# and a declared mode is always honoured.

config SMART_TRAINER_CAP_ERG
	bool "advertise target power (ERG) if the source can"
	default y
	help
	  FE-C page 54 Target Power mode with page 49, FTMS Power Target
	  Setting with op code 0x05. FE-C SS10.1.3.1: a controllable FE shall
	  support at least target power mode, so turn this off only with
	  care.

config SMART_TRAINER_CAP_RESISTANCE
	bool "advertise basic resistance if the source can"
	default y
	help
	  FE-C page 54 Basic Resistance mode with page 48, FTMS Resistance
	  Target Setting with op code 0x04.

config SMART_TRAINER_CAP_SIM
	bool "advertise simulation if the source can"
	default y
	help
	  FE-C page 54 Simulation mode with pages 50/51 (and 55 applied),
	  FTMS Indoor Bike Simulation Parameters with op code 0x11.

config SMART_TRAINER_MIN_POWER_W
	int "minimum target power, W"
	range 0 1000
	default 0
	help
	  The FTMS Supported Power Range minimum, and the floor an FE-C page
	  49 is clamped to. A source that states its own range overrides.

config SMART_TRAINER_MAX_POWER_W
	int "maximum target power, W"
	range 100 4000
	default 2000
	help
	  The FTMS Supported Power Range maximum, and the ceiling an FE-C
	  page 49 is clamped to. A source that states its own range overrides.

# ── BLE ──────────────────────────────────────────────────────────────────────

config SMART_TRAINER_BLE
	bool "also advertise FTMS (Indoor Bike) over BLE"
	depends on BT && BT_PERIPHERAL
	select BT_SMP
	select RADIANT_BLE
	select RADIANT_BLE_FTMS
	select RADIANT_BLE_FTMS_INDOOR_BIKE
	select RADIANT_BACKEND_NRF_GATE_MPSL
	select BT_LL_SOFTDEVICE
	select RADIANT_CTRL_ARBITER
	help
	  FTMS 0x1826 as an Indoor Bike, through the shared core
	  radiant_ble_ftms, beside the ANT+ FE-C master on one radio.
	  BT_SMP is required: the Control Point needs encryption (FTMS
	  Table 4.1).

	  THE ARBITER IS NOT A SUPPRESSION RULE. FE-C pages and FTMS
	  notifications always go to every listener; the token decides only
	  whose setpoint the brake obeys (radiant_ctrl_arbiter.h).

config SMART_TRAINER_BLE_ADV_INTERVAL_MS
	int "BLE advertising interval, milliseconds"
	depends on SMART_TRAINER_BLE
	range 100 10000
	default 1000
	help
	  Policy, not power tuning: MPSL ranks the Bluetooth controller above
	  radiant, so a shorter interval takes air from the ANT+ master.

config SMART_TRAINER_BLE_MIN_CONN_INTERVAL_UNITS
	int "shortest connection interval to accept, 1.25 ms units"
	depends on SMART_TRAINER_BLE
	range 6 3200
	default 800
	help
	  800 units is 1 s, the same policy as apps/treadmill and
	  apps/hrm_ble; enforced by radiant_ble_conn.c.

config SMART_TRAINER_BLE_NOTIFY_INTERVAL_MS
	int "Indoor Bike Data notification interval, milliseconds"
	depends on SMART_TRAINER_BLE
	range 200 5000
	default 1000
	help
	  FTMS: "at a regular interval, typically once per second", not
	  client-configurable.

config SMART_TRAINER_PAIRING_WINDOW_S
	int "pairing window opened at the trainer, seconds"
	depends on SMART_TRAINER_BLE && RADIANT_BLE_PAIRING_WINDOW
	range 10 600
	default 120
	help
	  How long radiant_ble_pairing_window_open() runs when the source
	  reports TRAINER_EVT_PAIRING_WINDOW (the simulator: sw0).

config SMART_TRAINER_CTRL_ANT_TIMEOUT_MS
	int "release an idle ANT+ control claim after, milliseconds"
	depends on SMART_TRAINER_BLE
	range 1000 600000
	default 30000
	help
	  ANT+ is connectionless, so this is the only release an FE-C
	  controller's implicit claim has.

module = SMART_TRAINER
module-str = smart_trainer
source "subsys/logging/Kconfig.template.log_config"

endif # SMART_TRAINER
```

## sample.yaml
```
sample:
  name: RadiANT smart trainer
  description: >
    Controllable bike trainer reference design: ANT+ FE-C with FTMS Indoor
    Bike over BLE, one equipment state, the shared FE-C/FTMS control arbiter.

common:
  build_only: true
  sysbuild: true
  tags:
    - radiant
    - smart_trainer

tests:
  smart_trainer.ant:
    platform_allow:
      - nrf54l15dk/nrf54l15/cpuapp
    extra_args:
      - RADIANT_BACKEND=nrf

  smart_trainer.ant_nrf52840:
    platform_allow:
      - nrf52840dk/nrf52840
    extra_args:
      - RADIANT_BACKEND=nrf

  smart_trainer.ble:
    platform_allow:
      - nrf54l15dk/nrf54l15/cpuapp
    extra_args:
      - RADIANT_BACKEND=nrf
      - smart_trainer_EXTRA_CONF_FILE=ble.conf

  smart_trainer.dual:
    platform_allow:
      - nrf54l15dk/nrf54l15/cpuapp
      - nrf52840dk/nrf52840
    extra_args:
      - RADIANT_BACKEND=nrf
      - smart_trainer_EXTRA_CONF_FILE="dual.conf;../../tests/product_test.conf"
```

## prj.conf
```kconfig
# RadiANT smart trainer: ANT+ FE-C node. ble.conf adds FTMS; dual.conf is the
# shipping preset (BLE + strict identity). Copied from apps/treadmill/prj.conf,
# which explains each line at length.

CONFIG_SMART_TRAINER=y

CONFIG_RADIANT=y
CONFIG_RADIANT_ANT_API=y

# Per-unit identity (ADR 0009/0020): every trainer flashed from one image
# derives its own device number and serial on first boot.
CONFIG_RADIANT_SEC=y
CONFIG_RADIANT_NODE_IDENT=y
CONFIG_RADIANT_NODE_NVM_SETTINGS=y
CONFIG_SETTINGS=y
CONFIG_SETTINGS_NVS=y
CONFIG_RADIANT_SEC_RNG_ENTROPY=y

CONFIG_HEAP_MEM_POOL_SIZE=2048

# The simulated source uses float for the model's bisection.
CONFIG_FPU=y

CONFIG_GPIO=y

CONFIG_LOG=y
CONFIG_LOG_MODE_DEFERRED=y
CONFIG_SERIAL=y
CONFIG_CONSOLE=y
CONFIG_UART_CONSOLE=y
CONFIG_LOG_BACKEND_UART=y
# See apps/treadmill/prj.conf: a 1 KB ring drops the boot banner.
CONFIG_LOG_BUFFER_SIZE=4096

CONFIG_RESET_ON_FATAL_ERROR=n
CONFIG_THREAD_NAME=y
```

## ble.conf
```kconfig
# FTMS Indoor Bike over BLE on top of the ANT+ FE-C node (development variant,
# no strict identity). Passed IMAGE-SCOPED:
#
#   -Dsmart_trainer_EXTRA_CONF_FILE=ble.conf
#
# THE PREFIX IS THE BASENAME OF THIS DIRECTORY; a wrong one is accepted in
# silence and builds with no BLE (see apps/treadmill/ble.conf).
#
# SMART_TRAINER_BLE selects SMP (the Control Point needs encryption), the
# shared BLE layer and DIS, the FTMS core (Indoor Bike), the arbiter and the
# MPSL gate; the session count default rides on it too.

CONFIG_SMART_TRAINER_BLE=y
CONFIG_BT=y
CONFIG_BT_PERIPHERAL=y
CONFIG_BT_SETTINGS=y
CONFIG_BT_MAX_PAIRED=4

# In the scan response, at most 29 characters. No trademarked default.
CONFIG_BT_DEVICE_NAME="RadiANT Trainer"
```

## dual.conf
```kconfig
# SPDX-License-Identifier: Apache-2.0
#
# The named dual-radio preset: ANT+ FE-C with FTMS Indoor Bike over BLE, and
# strict product identity. The build a manufacturer ships, once a product
# .conf supplies the identity:
#
#   west build -b <board> apps/smart_trainer -- \
#     -Dsmart_trainer_EXTRA_CONF_FILE="dual.conf;product.conf"
#
# (product.conf is your copy of product.conf.example.)
#
# ON ITS OWN THIS PRESET FAILS TO CONFIGURE, ON PURPOSE: strict identity
# refuses the placeholder identity, and at run time a trainer whose identity
# fails to boot stays off the air rather than sharing one device number with
# every unit of the image. scripts/build_all.ps1 trainer_dual_fail asserts the
# refusal; trainer_dual* rows build it with tests/product_test.conf.

CONFIG_SMART_TRAINER_BLE=y
CONFIG_BT=y
CONFIG_BT_PERIPHERAL=y
CONFIG_BT_SETTINGS=y
# 5 key slots = 4 phones: the pairing window keeps one slot spare
# (radiant_ble_pairing.h).
CONFIG_BT_MAX_PAIRED=5
CONFIG_RADIANT_PRODUCT_STRICT=y

# Equipment bonding: new phones only inside a pairing window opened at the
# trainer (TRAINER_EVT_PAIRING_WINDOW; the simulator: sw0), LRU eviction when
# full. The power-on window is the fallback for a trainer with no such
# control: power-cycle it to pair. Drop it once yours has one.
CONFIG_RADIANT_BLE_PAIRING_WINDOW=y
CONFIG_RADIANT_BLE_PAIRING_WINDOW_AT_BOOT_S=120
```

## source_custom.conf
```kconfig
# The custom-source arm: nothing registered. Must configure and link; the
# trainer then transmits with every measurement invalid and no control mode.
CONFIG_SMART_TRAINER_SOURCE_CUSTOM=y
```

## boards/nrf52840dk_nrf52840.conf
```kconfig
# nRF52840 DK, as a RadiANT smart trainer.
#
# The other half of the overlay's `zephyr,entropy = &rng`, for the reason
# apps/hrm_ble/boards/nrf52840dk_nrf52840.conf gives: without this the
# CryptoCell entropy driver is still built for the enabled cryptocell node and
# links CryptoCell's platform library for a driver nothing calls (~6.7 KB of
# flash and ~1.9 KB of RAM, measured on hrm_ble).
CONFIG_ENTROPY_CC3XX=n
```

## boards/nrf52840dk_nrf52840.overlay
```dts
/*
 * nRF52840 DK, as a RadiANT smart trainer (copied from apps/treadmill).
 *
 * THE POINT OF THIS BOARD IS THAT IT IS NOT AN nRF54L. radiant's nrf backend
 * has `depends on SOC_COMPATIBLE_NRF52X || SOC_COMPATIBLE_NRF54LX`, and this
 * row is what keeps the nRF52 half of that compiled - on the family most
 * existing ANT+ silicon actually is.
 *
 * BUILD-VERIFIED ONLY. Nothing here has been on a bench. Unlike apps/treadmill,
 * the BLE arm IS built on this part (scripts/build_all.ps1 trainer_dual_52840:
 * dual.conf, FTMS Indoor Bike, SDC + MPSL + the gate, 2026-11-28: 276.9 kB flash,
 * 84.0 kB RAM) - one ANT+ master and one GATT service is lighter than the
 * treadmill. Built is not measured: there is no nRF52 bench slot for this
 * application yet.
 *
 * radiant/Kconfig's own help records that this part's on-air behaviour is
 * predicted from the nRF54L15 measurements rather than confirmed. Do not read a
 * green build here as a working machine.
 */

/ {
	chosen {
		/*
		 * The TIMER radiant's nrf backend owns outright. It runs at
		 * 1 MHz forever and is what t_sync is hardware-captured into
		 * from RADIO's ADDRESS event, so it cannot be shared: naming it
		 * here rather than in the source is what makes a second user a
		 * devicetree conflict instead of two drivers reprogramming
		 * each other's prescaler.
		 *
		 * TIMER4, and the choice is constrained from both ends. The
		 * backend needs FIVE compare/capture channels - t_sync capture,
		 * RX start, window close, software now-capture, TX start - and
		 * on nRF52 only TIMER3 and TIMER4 have more than four, which is
		 * a compile-time #error in radiant_radio_nrf.c rather than
		 * something to discover on the air.
		 *
		 * TIMER4 rather than TIMER3 to match apps/dongle's and
		 * apps/hrm_ble's overlays, so that the nRF52 answer is one
		 * number across this repository rather than three. MPSL on
		 * nRF52 reserves TIMER0 (mpsl_hwres.h), not these.
		 */
		radiant,radio-timer = &timer4;

		/*
		 * The entropy source K_dev is drawn from on first boot (ADR
		 * 0020), for the reason apps/hrm_ble's overlay gives: the RNG
		 * peripheral, not the SoC default &cryptocell, whose driver
		 * links CryptoCell's platform library for one 16-byte draw.
		 */
		zephyr,entropy = &rng;
	};
};

&timer4 {
	status = "okay";
};
```

## boards/nrf54l15dk_nrf54l15_cpuapp.overlay
```dts
/*
 * nRF54L15 DK, as a RadiANT smart trainer (copied from apps/treadmill).
 *
 * THE TARGET PART FOR THIS APPLICATION, and the only one it has been sized
 * against. docs/radiant-bridge.md section 11 rates the nRF52840 as "very
 * tight" for a full build; this application adds two hand-written GATT
 * services, SMP and a bonding store on top of the BLE second stack that
 * the radiant/spike/mpsl_arb spike measured at +78.7 kB flash / +16.0 kB RAM,
 * and phase 5 adds a third ANT+ channel. Watch RAM specifically - the Matter
 * flash spike already established for this project that flash is not the wall,
 * RAM is.
 *
 * Deliberately NOT a copy of the dongle's overlay. That one's whole subject is
 * the ANT serial transport on the second VCOM; a trainer has no transport at
 * all. It is fitness equipment: the only thing leaving the board over a wire is
 * the log on the console UART, which the board's own devicetree already
 * provides.
 *
 * What IS shared is the one line radiant's nrf backend cannot start without.
 */

/ {
	chosen {
		/*
		 * The TIMER the backend owns outright. It runs at 1 MHz forever
		 * and is what t_sync is hardware-captured into from RADIO's
		 * ADDRESS event, so it cannot be shared - naming it here rather
		 * than in the source is what makes a second user a devicetree
		 * conflict instead of two drivers reprogramming each other's
		 * prescaler.
		 *
		 * timer20 is free on this board, and is `status = "disabled"`
		 * by default like every TIMER on this SoC. An unclocked
		 * peripheral is not addressable, which the backend found once
		 * by taking a bus fault on its first register write.
		 *
		 * IT IS ALSO WHAT P0's TIMER AUDIT WAS ABOUT. mpsl.rst lists
		 * MPSL as owning TIMER10 *and* TIMER20 on nRF54L, while
		 * mpsl_hwres.h reserves only TIMER10. Measured: TIMER20 does not
		 * collide, and TIMER22 behaves identically. If a future MPSL
		 * revision does claim it, this is the line that moves.
		 */
		radiant,radio-timer = &timer20;
	};
};

&timer20 {
	status = "okay";
};
```

## src/main.c
```c
/*
 * SPDX-License-Identifier: Apache-2.0
 *
 * RadiANT smart trainer: the mixed ANT+ / BLE reference design for a
 * controllable bike trainer.
 *
 *   ANT+ FE-C (0x11, equipment type 25): pages 16, 25 and 17 in SS10.1's
 *   interleave, 80/81 from the product record, 54/55/50/51/71 on request,
 *   control pages 48/49/50/51 answered with page 71, page 55 applied.
 *
 *   BLE FTMS Indoor Bike (CONFIG_SMART_TRAINER_BLE): Indoor Bike Data, the
 *   Supported Power and Resistance ranges, the Control Point (Request
 *   Control, Reset, Set Target Resistance/Power, Start/Stop, Indoor Bike
 *   Simulation, Wheel Circumference), DIS, bonding behind a pairing window.
 *
 * ONE EQUIPMENT STATE (trainer_equip.h) behind both radios, ONE command layer
 * (trainer_cmd.h) for both control paths, and the shared FE-C/FTMS arbiter
 * (radiant_ctrl_arbiter.h) between them: an FTMS Request Control is explicit
 * and beats an FE-C controller's implicit claim, which is then answered
 * REJECTED. Nothing is ever suppressed: FE-C pages and FTMS notifications run
 * for every listener whoever holds control.
 *
 * ONE SEAM (trainer_source.h) for the manufacturer's brake. The reference
 * driver is a simulated rider on apps/trainer's physics model.
 *
 * apps/trainer, the ACK-fault instrument, is a different image: this one has
 * none of its fault machinery and is built to carry BLE.
 */

#include <errno.h>
#include <string.h>

#include <zephyr/kernel.h>
#include <zephyr/logging/log.h>
#include <zephyr/sys/atomic.h>

#include <radiant/radiant_ant.h>
#include <radiant/radiant_wire.h>
#include <radiant/radiant_product.h>
#include <radiant/radiant_profile_common.h>
#include <radiant/radiant_profile_fec.h>
#include <radiant/radiant_profile_fec_tx.h>
#if defined(CONFIG_RADIANT_CTRL_ARBITER)
#include <radiant/radiant_ctrl_arbiter.h>
#endif
#if defined(CONFIG_RADIANT_BLE_PAIRING_WINDOW)
#include <radiant/radiant_ble_pairing.h>
#endif

#include "trainer_cmd.h"
#include "trainer_equip.h"
#include "trainer_logic.h"
#include "trainer_node.h"
#include "trainer_source.h"
#if defined(CONFIG_SMART_TRAINER_BLE)
#include "trainer_ble.h"
#endif

LOG_MODULE_REGISTER(smart_trainer, CONFIG_SMART_TRAINER_LOG_LEVEL);

/* The public ANT+ network key - not a stack licence key. */
static const uint8_t ant_plus_key[8] = {
	0xB9, 0xA5, 0x21, 0xFB, 0xBD, 0x72, 0xC3, 0x45
};

#define ANT_NETWORK    0u
#define ANT_RF_FREQ    57u
#define ANT_TRANS_TYPE 5u
#define FEC_CHANNEL    0u

/* One page 25 update per tick, at the channel rate: 4 Hz. */
#define NODE_TICK_MS 250u

#if defined(CONFIG_RADIANT_CTRL_ARBITER)
_Static_assert(RADIANT_CTRL_PAGE_BASIC_RESISTANCE == RADIANT_PROFILE_FEC_PAGE_BASIC_RESISTANCE &&
		       RADIANT_CTRL_PAGE_TARGET_POWER == RADIANT_PROFILE_FEC_PAGE_TARGET_POWER &&
		       RADIANT_CTRL_PAGE_WIND_RESISTANCE == RADIANT_PROFILE_FEC_PAGE_WIND_RESISTANCE &&
		       RADIANT_CTRL_PAGE_TRACK_RESISTANCE == RADIANT_PROFILE_FEC_PAGE_TRACK_RESISTANCE,
	       "radiant_ctrl_arbiter.h's FE-C page numbers have drifted");
#endif

static struct trainer_equip equip;
static struct radiant_profile_fec_tx fec;
static atomic_t session_epoch;

static void node_tick_fn(struct k_work *w);
static K_WORK_DELAYABLE_DEFINE(node_tick, node_tick_fn);

/* ── Equipment state -> FE-C pages ──────────────────────────────────────── */

static void publish(void)
{
	struct radiant_profile_fec_general              g;
	struct radiant_profile_fec_settings             s;
	struct radiant_profile_fec_trainer              t;
	struct radiant_profile_fec_cmd_wind_resistance  w;
	struct radiant_profile_fec_cmd_track_resistance tr;
	struct radiant_profile_fec_cmd_user_config      u;

	trainer_equip_pages(&equip, &g, &s, &t);
	trainer_equip_echo(&equip, &w, &tr, &u);

	/* The encode runs on the radio callback; the workqueue can preempt
	 * nothing there, but this copy must not be torn by it either. */
	k_sched_lock();
	radiant_profile_fec_tx_set_general(&fec, &g);
	radiant_profile_fec_tx_set_settings(&fec, &s);
	radiant_profile_fec_tx_set_trainer(&fec, &t);
	radiant_profile_fec_tx_set_wind(&fec, &w);
	radiant_profile_fec_tx_set_track(&fec, &tr);
	radiant_profile_fec_tx_set_user(&fec, &u);
	k_sched_unlock();
}

/* ── The node, as trainer_source.c and trainer_ble.c see it ─────────────── */

struct trainer_equip *trainer_node_equip(void)
{
	return &equip;
}

uint32_t trainer_node_epoch(void)
{
	return (uint32_t)atomic_get(&session_epoch);
}

#if defined(CONFIG_SMART_TRAINER_BLE)
/* Set once trainer_ble_start() has brought the controller up. */
static atomic_t ble_up;
#endif

/* trainer_logic's session callback: the epoch mirror for the BT RX thread,
 * and the FTMS notification unless the logic says the core sends its own. */
static void node_session(enum trainer_run prev, enum trainer_run next, bool notify, void *ctx)
{
	ARG_UNUSED(ctx);
	atomic_set(&session_epoch, (atomic_val_t)equip.epoch);
	if (prev == next) {
		return;
	}
	LOG_INF("session %d -> %d (epoch %u)", (int)prev, (int)next, (unsigned)equip.epoch);
#if defined(CONFIG_SMART_TRAINER_BLE)
	if (notify && atomic_get(&ble_up) != 0) {
		trainer_ble_session_changed(prev, next);
	}
#else
	ARG_UNUSED(notify);
#endif
}

static void node_ftms_status(const uint8_t *msg, size_t len, void *ctx)
{
	ARG_UNUSED(ctx);
#if defined(CONFIG_SMART_TRAINER_BLE)
	/* FTMS subscribers hear a target set over ANT+ too. */
	if (atomic_get(&ble_up) != 0) {
		trainer_ble_notify_status(msg, len);
	}
#else
	ARG_UNUSED(msg);
	ARG_UNUSED(len);
#endif
}

void trainer_node_report(const struct trainer_report *r)
{
	trainer_logic_report(r);
}

void trainer_node_event(enum trainer_source_event evt)
{
	switch (evt) {
	case TRAINER_EVT_PAIRING_WINDOW:
#if defined(CONFIG_RADIANT_BLE_PAIRING_WINDOW)
		/* New phones only inside a window opened at the trainer
		 * (radiant_ble_pairing.h): physical presence authorises. Not
		 * before the controller is up. */
		if (atomic_get(&ble_up) == 0) {
			LOG_WRN("pairing window not opened: BLE is not up yet");
			return;
		}
		(void)radiant_ble_pairing_window_open(CONFIG_SMART_TRAINER_PAIRING_WINDOW_S);
		LOG_INF("pairing window open for %u s",
			(unsigned)CONFIG_SMART_TRAINER_PAIRING_WINDOW_S);
#endif
		return;
	case TRAINER_EVT_FORGET_BONDS:
#if defined(CONFIG_RADIANT_BLE_PAIRING_WINDOW)
		if (atomic_get(&ble_up) == 0) {
			LOG_WRN("bonds not forgotten: BLE is not up yet");
			return;
		}
		LOG_WRN("forgetting every bond: %d", radiant_ble_bonds_forget_all());
#endif
		return;
	default: {
		static bool release_warned;
		int rc = trainer_logic_event(evt);

		/* Once: a driver that cannot release would otherwise log at
		 * every console reset. */
		if (rc != 0 && !release_warned) {
			release_warned = true;
			LOG_WRN("console reset: the brake was not released (%d); "
				"further failures are not logged", rc);
		}
		publish();
		return;
	}
	}
}

/* FTMS Reset succeeded (trainer_ble.c's reset_done). Workqueue. */
void trainer_node_ftms_reset_done(void)
{
	trainer_logic_ftms_reset_done();
	publish();
}

/* ── FE-C: acknowledged control pages in, page 71 out ───────────────────── */

static void apply_control_page(const uint8_t *body, uint32_t rx_epoch)
{
	trainer_logic_fec_page(body, rx_epoch, (uint32_t)k_uptime_get_32());
	publish();
}

/*
 * The thread hop, as apps/treadmill's: radiant_ant_on_message() runs on
 * radiant's event thread and the equipment state is workqueue-only, so a
 * control page is copied into a small ring WITH THE EPOCH AT RECEIPT, and the
 * workqueue applies it. A page that waited out a local stop is refused.
 */
#define FEC_CMD_QUEUE_DEPTH 4u

static struct {
	uint8_t  body[8];
	uint32_t epoch;
} fec_cmd_q[FEC_CMD_QUEUE_DEPTH];

static uint8_t fec_cmd_head;
static uint8_t fec_cmd_tail;
static uint8_t fec_cmd_drop_page;
static bool    fec_cmd_dropped;
static struct k_spinlock fec_cmd_lock;

static void fec_cmd_work_fn(struct k_work *w)
{
	ARG_UNUSED(w);

	for (;;) {
		k_spinlock_key_t key;
		uint8_t          body[8];
		uint32_t         epoch = 0u;
		uint8_t          drop_page = 0u;
		bool             have = false;
		bool             dropped = false;

		key = k_spin_lock(&fec_cmd_lock);
		if (fec_cmd_tail != fec_cmd_head) {
			memcpy(body, fec_cmd_q[fec_cmd_tail].body, sizeof(body));
			epoch = fec_cmd_q[fec_cmd_tail].epoch;
			fec_cmd_tail = (uint8_t)((fec_cmd_tail + 1u) % FEC_CMD_QUEUE_DEPTH);
			have = true;
		} else if (fec_cmd_dropped) {
			drop_page = fec_cmd_drop_page;
			fec_cmd_dropped = false;
			dropped = true;
		}
		k_spin_unlock(&fec_cmd_lock, key);

		if (have) {
			apply_control_page(body, epoch);
			continue;
		}
		if (dropped) {
			LOG_WRN("FE-C page %u dropped: the command queue was full", drop_page);
			trainer_logic_fec_dropped(drop_page);
			continue;
		}
		break;
	}
}

static K_WORK_DEFINE(fec_cmd_work, fec_cmd_work_fn);

static void queue_control_page(const uint8_t *body)
{
	k_spinlock_key_t key;
	uint8_t          next;

	key = k_spin_lock(&fec_cmd_lock);
	next = (uint8_t)((fec_cmd_head + 1u) % FEC_CMD_QUEUE_DEPTH);
	if (next == fec_cmd_tail) {
		fec_cmd_dropped = true;
		fec_cmd_drop_page = body[0];
	} else {
		memcpy(fec_cmd_q[fec_cmd_head].body, body, 8u);
		fec_cmd_q[fec_cmd_head].epoch = (uint32_t)atomic_get(&session_epoch);
		fec_cmd_head = next;
	}
	k_spin_unlock(&fec_cmd_lock, key);

	(void)k_work_submit(&fec_cmd_work);
}

/* ── The radio ──────────────────────────────────────────────────────────── */

/* Paced by EVENT_TX: the next page is staged when the last one went out. */
static void load_fec_page(void)
{
	uint8_t                        body[8];
	enum radiant_profile_slot_kind kind;

	k_sched_lock();
	kind = radiant_profile_fec_tx_next(&fec, body);
	k_sched_unlock();
	if (kind == RADIANT_PROFILE_SLOT_IDLE) {
		return;
	}
	(void)radiant_ant_broadcast_message_tx(FEC_CHANNEL, sizeof(body), body);
}

void radiant_ant_on_message(const struct radiant_ant_msg *msg)
{
	if (msg == NULL || msg->data == NULL) {
		return;
	}

	if (msg->id == RADIANT_WIRE_MESG_RESPONSE_EVENT_ID &&
	    msg->len >= RADIANT_WIRE_MESG_RESPONSE_EVENT_SIZE) {
		if (msg->data[2] == RADIANT_WIRE_EVENT_TX && msg->data[0] == FEC_CHANNEL) {
			load_fec_page();
		}
		return;
	}

	/* Control pages: acknowledged data into the channel this node is the
	 * master of. */
	if ((msg->id == RADIANT_WIRE_MESG_ACKNOWLEDGED_DATA_ID ||
	     msg->id == RADIANT_WIRE_MESG_EXT_ACKNOWLEDGED_DATA_ID) &&
	    msg->len >= 9u && msg->data[0] == FEC_CHANNEL) {
		queue_control_page(&msg->data[1]);
	}
}

static int ant_master_start(uint8_t channel, uint16_t devnum)
{
	radiant_ant_err_t rc;

	rc = radiant_ant_channel_assign(channel, RADIANT_WIRE_CHANNEL_TYPE_MASTER, ANT_NETWORK,
					0u);
	if (rc != RADIANT_WIRE_RESPONSE_NO_ERROR) {
		LOG_ERR("ch%u assign: %d", channel, (int)rc);
		return -EIO;
	}
	rc = radiant_ant_channel_id_set(channel, devnum, RADIANT_PROFILE_FEC_DEVICE_TYPE,
					ANT_TRANS_TYPE);
	if (rc != RADIANT_WIRE_RESPONSE_NO_ERROR) {
		LOG_ERR("ch%u channel id: %d", channel, (int)rc);
		return -EIO;
	}
	rc = radiant_ant_channel_period_set(channel, RADIANT_PROFILE_FEC_PERIOD);
	if (rc != RADIANT_WIRE_RESPONSE_NO_ERROR) {
		LOG_ERR("ch%u period: %d", channel, (int)rc);
		return -EIO;
	}
	rc = radiant_ant_channel_radio_freq_set(channel, ANT_RF_FREQ);
	if (rc != RADIANT_WIRE_RESPONSE_NO_ERROR) {
		LOG_ERR("ch%u rf freq: %d", channel, (int)rc);
		return -EIO;
	}
	rc = radiant_ant_channel_open(channel);
	if (rc != RADIANT_WIRE_RESPONSE_NO_ERROR) {
		LOG_ERR("ch%u open: %d", channel, (int)rc);
		return -EIO;
	}
	load_fec_page();
	return 0;
}

static void node_tick_fn(struct k_work *w)
{
	ARG_UNUSED(w);

	trainer_equip_tick(&equip, NODE_TICK_MS);
#if defined(CONFIG_RADIANT_CTRL_ARBITER)
	/* ANT+ is connectionless: an idle FE-C claim lapses only here. */
	radiant_ctrl_tick((uint32_t)k_uptime_get_32());
#endif
#if defined(CONFIG_SMART_TRAINER_BLE)
	trainer_ble_tick();
#endif
	publish();
	k_work_schedule(&node_tick, K_MSEC(NODE_TICK_MS));
}

int main(void)
{
	const struct trainer_source_ops *src = trainer_source_get();
	const struct radiant_product    *product = radiant_product_get();
	struct radiant_profile_fec_tx_cfg fec_cfg;
	struct radiant_product_unit       unit;
	struct trainer_cmd_cfg            cmd_cfg;
	int                               err;

	LOG_INF("RadiANT smart trainer: ANT+ 0x11 FE-C (type 25)%s",
		IS_ENABLED(CONFIG_SMART_TRAINER_BLE) ? " + BLE FTMS Indoor Bike" : "");

	if (radiant_ant_init() != RADIANT_WIRE_RESPONSE_NO_ERROR) {
		LOG_ERR("radiant_ant_init failed");
		return 0;
	}

	/* Per-unit device number and serial from the identity record (ADR
	 * 0009/0020). A strict build does not return until it boots; a
	 * development build falls back to the Kconfig number, logged. */
	(void)radiant_product_unit_boot(CONFIG_SMART_TRAINER_DEVICE_NUMBER, &unit);

	if (src == NULL) {
		LOG_ERR("no trainer source registered: FE-C goes out with every "
			"measurement invalid and no control mode declared. See "
			"src/trainer_source.h.");
	}

	trainer_equip_init(&equip, (src != NULL) ? src->max_resistance_n : 0u);
	atomic_set(&session_epoch, (atomic_val_t)equip.epoch);

	memset(&cmd_cfg, 0, sizeof(cmd_cfg));
	cmd_cfg.equip = &equip;
	cmd_cfg.src = src;
	cmd_cfg.allow_erg = IS_ENABLED(CONFIG_SMART_TRAINER_CAP_ERG);
	cmd_cfg.allow_resistance = IS_ENABLED(CONFIG_SMART_TRAINER_CAP_RESISTANCE);
	cmd_cfg.allow_sim = IS_ENABLED(CONFIG_SMART_TRAINER_CAP_SIM);
	cmd_cfg.min_power_w = CONFIG_SMART_TRAINER_MIN_POWER_W;
	cmd_cfg.max_power_w = CONFIG_SMART_TRAINER_MAX_POWER_W;
	if (src != NULL && src->max_power_w != 0u) {
		cmd_cfg.min_power_w = src->min_power_w;
		cmd_cfg.max_power_w = src->max_power_w;
	}
#if defined(CONFIG_RADIANT_CTRL_ARBITER)
	cmd_cfg.ctrl_owner = radiant_ctrl_owner;
	cmd_cfg.ctrl_claim = radiant_ctrl_claim;
	cmd_cfg.ctrl_gated = radiant_ctrl_fec_page_is_gated;
#endif
	trainer_cmd_bind(&cmd_cfg);
	{
		const struct trainer_logic_cfg lcfg = {
			.equip = &equip,
			.fec = &fec,
			.session_changed = node_session,
			.ftms_status = node_ftms_status,
		};

		trainer_logic_init(&lcfg);
	}
#if defined(CONFIG_RADIANT_CTRL_ARBITER)
	/* Every control page this trainer implements needs the token. */
	radiant_ctrl_init(CONFIG_SMART_TRAINER_CTRL_ANT_TIMEOUT_MS, trainer_cmd_ctrl_gates());
#endif

	memset(&fec_cfg, 0, sizeof(fec_cfg));
	(void)radiant_product_fill_common_id(product, unit.serial, &fec_cfg.id);
	fec_cfg.equipment_type = RADIANT_PROFILE_FEC_TYPE_TRAINER;
	/* Declared exactly when honoured (trainer_cmd.c): a declared mode
	 * whose page is refused, or the reverse, is a broken trainer to every
	 * controller. */
	fec_cfg.caps.capabilities = trainer_cmd_fec_capabilities();
	fec_cfg.caps.max_resistance_n = equip.max_resistance_n;
	fec_cfg.caps.max_resistance_valid = (equip.max_resistance_n != 0u);
	fec_cfg.metabolic = false;
	err = radiant_profile_fec_tx_init(&fec, &fec_cfg);
	if (err != 0) {
		LOG_ERR("radiant_profile_fec_tx_init: %d", err);
		return 0;
	}

	/* Deliver what the driver (or a button) pushed before now only once
	 * the equipment state exists AND the driver has started: a console
	 * reset queued at boot drives set_* hooks, which a driver that has not
	 * started cannot take. A driver that fails to start never gets them. */
	err = 0;
	if (src != NULL) {
		LOG_INF("trainer source: %s", src->name);
		if (src->start != NULL && (err = src->start()) != 0) {
			LOG_ERR("trainer source did not start: %d", err);
		}
	}
	if (err == 0) {
		trainer_source_ready();
	}
	publish();

	if (radiant_ant_network_address_set(ANT_NETWORK, ant_plus_key) !=
	    RADIANT_WIRE_RESPONSE_NO_ERROR) {
		LOG_ERR("network key");
		return 0;
	}
	if (ant_master_start(FEC_CHANNEL, unit.devnum) != 0) {
		return 0;
	}
	k_work_schedule(&node_tick, K_MSEC(NODE_TICK_MS));
	LOG_INF("transmitting: device #%u, FE-C caps 0x%02x", unit.devnum,
		fec_cfg.caps.capabilities);

#if defined(CONFIG_SMART_TRAINER_BLE)
	/* Last, so a failure to advertise is never mistaken for a failure to
	 * transmit. */
	{
		struct radiant_ble_ftms_caps caps;

		trainer_cmd_ftms_caps(&caps);
		err = trainer_ble_start(unit.devnum, unit.serial, &caps);
		atomic_set(&ble_up, (err == 0) ? 1 : 0);
		if (err != 0) {
			LOG_ERR("BLE did not start: %d. The ANT+ master is unaffected "
				"and this node is now ANT+ only.", err);
		}
	}
#endif
	return 0;
}
```

## src/trainer_ble.c
```c
/* SPDX-License-Identifier: Apache-2.0 */
/*
 * trainer_ble.c - FTMS Indoor Bike (0x1826 / 0x2AD2) beside the ANT+ FE-C
 * master, through the shared core radiant/src/ble/radiant_ble_ftms.c.
 *
 * This file is the trainer plugged into that core: the capabilities and
 * ranges (trainer_cmd.c), the Indoor Bike Data record and its Reset baseline
 * (trainer_equip.c), the actuators (trainer_cmd.c's FTMS hooks), the session
 * and epoch (main.c), DIS and advertising through radiant_ble_adv with the
 * FTMS Service Data element (machine type Indoor Bike).
 *
 * The advertising payload is flags 3 + a one-UUID16 list 4 + the FTMS Service
 * Data element 7 = 14 bytes. The name goes in the scan response, as in
 * apps/treadmill, so it may be 29 characters.
 */

#include <errno.h>
#include <string.h>

#include <zephyr/bluetooth/bluetooth.h>
#include <zephyr/bluetooth/conn.h>
#include <zephyr/bluetooth/uuid.h>
#include <zephyr/kernel.h>
#include <zephyr/logging/log.h>
#include <zephyr/settings/settings.h>

#include <radiant/radiant_ble_adv.h>
#include <radiant/radiant_ble_dis.h>
#include <radiant/radiant_ble_ftms.h>

#include "trainer_ble.h"
#include "trainer_ble_svc.h"
#include "trainer_cmd.h"
#include "trainer_equip.h"
#include "trainer_node.h"

LOG_MODULE_DECLARE(smart_trainer, CONFIG_SMART_TRAINER_LOG_LEVEL);

#define ADV_UNITS(ms) ((uint32_t)(((uint32_t)(ms) * 1000u) / 625u))

BUILD_ASSERT(TRAINER_IBD_LEN <= 20u,
	     "the Indoor Bike Data record must fit a default 23-byte ATT_MTU");

static atomic_t connections;
static uint32_t last_notify_ms;

static enum radiant_ble_ftms_run ftms_run(enum trainer_run run)
{
	switch (run) {
	case TRAINER_RUN_RUNNING:
		return RADIANT_BLE_FTMS_RUN_RUNNING;
	case TRAINER_RUN_PAUSED:
		return RADIANT_BLE_FTMS_RUN_PAUSED;
	case TRAINER_RUN_STOPPED:
		return RADIANT_BLE_FTMS_RUN_STOPPED;
	default:
		return RADIANT_BLE_FTMS_RUN_IDLE;
	}
}

static void machine_session(struct radiant_ble_ftms_session *out, void *ctx)
{
	const struct trainer_equip *e = trainer_node_equip();

	ARG_UNUSED(ctx);
	out->run = ftms_run(e->run);
	out->epoch = e->epoch;
}

static uint32_t machine_epoch(void *ctx)
{
	ARG_UNUSED(ctx);
	return trainer_node_epoch(); /* atomic: the BT RX thread calls this */
}

static int machine_encode(uint8_t *buf, size_t cap, void *ctx)
{
	ARG_UNUSED(ctx);
	return trainer_equip_ibd_encode(trainer_node_equip(), buf, cap);
}

static void machine_reset_done(void *ctx)
{
	ARG_UNUSED(ctx);
	/* SS4.16.2: the FTMS view's elapsed time and distance to zero (ANT+
	 * untouched), the session to Idle, the epoch moved - QUIETLY: the core
	 * sends Reset (0x01) and Idle itself (trainer_logic.h). */
	trainer_node_ftms_reset_done();
}

static struct radiant_ble_ftms_machine ftms_machine = {
	.machine_type = RADIANT_BLE_FTMS_TYPE_INDOOR_BIKE,
	.ops = {
		.set_target = trainer_cmd_ftms_set_target,
		.workout = trainer_cmd_ftms_workout,
		.reset = trainer_cmd_ftms_reset,
	},
	/* A trainer is passive: no motion rule. A NULL check makes a stale
	 * request STALE (0x04) and permits everything else. */
	.auth = { .check = NULL },
	.encode_data = machine_encode,
	.session = machine_session,
	.epoch = machine_epoch,
	.reset_done = machine_reset_done,
};

void trainer_ble_session_changed(enum trainer_run prev, enum trainer_run next)
{
	radiant_ble_ftms_session_changed(ftms_run(prev), ftms_run(next));
}

void trainer_ble_notify_status(const uint8_t *msg, size_t len)
{
	radiant_ble_ftms_notify_status(msg, len);
}

void trainer_ble_tick(void)
{
	uint32_t now;

	radiant_ble_adv_watchdog();
	if (atomic_get(&connections) == 0) {
		return;
	}
	/* FTMS: "typically once per second". Every notification is radio time
	 * against the ANT+ master through the MPSL gate. */
	now = (uint32_t)k_uptime_get_32();
	if ((now - last_notify_ms) < CONFIG_SMART_TRAINER_BLE_NOTIFY_INTERVAL_MS) {
		return;
	}
	last_notify_ms = now;
	radiant_ble_ftms_notify_data();
}

static void on_connected(struct bt_conn *conn, uint8_t err)
{
	ARG_UNUSED(conn);
	if (err != 0u) {
		LOG_WRN("BLE connect failed (0x%02x)", err);
		return;
	}
	atomic_inc(&connections);
	LOG_INF("BLE connected");
}

static void on_disconnected(struct bt_conn *conn, uint8_t reason)
{
	ARG_UNUSED(conn);
	atomic_dec(&connections);
	LOG_INF("BLE disconnected (0x%02x)", reason);
	/* radiant_ble_adv restarts advertising from `recycled`. */
}

BT_CONN_CB_DEFINE(trainer_ble_conn_cb) = {
	.connected = on_connected,
	.disconnected = on_disconnected,
};

/* Table 3.1's Service Data, initialised from trainer_ble_svc.h (which the
 * glue suite checks). trainer_ble_start() compares it with the core's bytes
 * before advertising and, should they ever differ, advertises the core's. */
static uint8_t ftms_svc_data[RADIANT_BLE_FTMS_SVC_DATA_LEN] = TRAINER_FTMS_SVC_DATA_INIT;

static struct bt_data ad[] = {
	BT_DATA_BYTES(BT_DATA_FLAGS, (BT_LE_AD_GENERAL | BT_LE_AD_NO_BREDR)),
	BT_DATA_BYTES(BT_DATA_UUID16_ALL, BT_UUID_16_ENCODE(BT_UUID_FMS_VAL)),
	/* FTMP's Service Data: Available + machine type Indoor Bike. It is how
	 * FTMS clients filter. */
	BT_DATA(BT_DATA_SVC_DATA16, ftms_svc_data, sizeof(ftms_svc_data)),
};

#define NAME_SUFFIX_BUDGET \
	(IS_ENABLED(CONFIG_RADIANT_BLE_NAME_DEVNUM_SUFFIX) ? RADIANT_BLE_NAME_SUFFIX_MAX : 0u)

BUILD_ASSERT(sizeof(CONFIG_BT_DEVICE_NAME) - 1u + NAME_SUFFIX_BUDGET <= 29u,
	     "CONFIG_BT_DEVICE_NAME (plus the devnum suffix when on) does not fit "
	     "the 31-byte scan response: 29 characters at most");
BUILD_ASSERT((3u + 4u + 7u) <= 31u, "the advertising payload no longer fits");

#if defined(CONFIG_RADIANT_BLE_NAME_DEVNUM_SUFFIX)
BUILD_ASSERT(sizeof(CONFIG_BT_DEVICE_NAME) - 1u + RADIANT_BLE_NAME_SUFFIX_MAX <=
	     CONFIG_BT_DEVICE_NAME_MAX,
	     "CONFIG_BT_DEVICE_NAME plus the devnum suffix exceeds CONFIG_BT_DEVICE_NAME_MAX");
#endif

static char adv_name[sizeof(CONFIG_BT_DEVICE_NAME) + RADIANT_BLE_NAME_SUFFIX_MAX] =
	CONFIG_BT_DEVICE_NAME;

static struct bt_data sd[] = {
	BT_DATA(BT_DATA_NAME_COMPLETE, adv_name, sizeof(CONFIG_BT_DEVICE_NAME) - 1u),
};

static struct bt_le_adv_param adv_param;

int trainer_ble_start(uint16_t devnum, uint32_t serial,
		      const struct radiant_ble_ftms_caps *caps)
{
	int err;

	ftms_machine.caps = *caps;
	err = radiant_ble_ftms_register(&ftms_machine);
	if (err != 0) {
		LOG_ERR("radiant_ble_ftms_register: %d", err);
		return err;
	}
	{
		uint8_t want[RADIANT_BLE_FTMS_SVC_DATA_LEN];

		if (radiant_ble_ftms_service_data(want, sizeof(want), true,
						  RADIANT_BLE_FTMS_TYPE_INDOOR_BIKE) == sizeof(want) &&
		    memcmp(want, ftms_svc_data, sizeof(want)) != 0) {
			LOG_ERR("FTMS Service Data constant disagrees with the core; "
				"advertising the core's bytes");
			memcpy(ftms_svc_data, want, sizeof(want));
		}
	}

	err = bt_enable(NULL);
	if (err != 0) {
		LOG_ERR("bt_enable: %d", err);
		return err;
	}

	if (IS_ENABLED(CONFIG_SETTINGS)) {
		/* Bonds, and (with BT_SETTINGS) the identity address that
		 * bt_enable() defers to the settings commit. Not fatal; see
		 * apps/treadmill/src/treadmill_ble.c for the full reasoning. */
		err = settings_load();
		if (err != 0) {
			LOG_ERR("settings_load: %d - bonds will not persist", err);
		}
	}

	/* DIS from radiant_product and the unit's serial, after settings_load()
	 * (which would otherwise replace them with stored values). */
	(void)radiant_ble_dis_apply(serial);

#if defined(CONFIG_RADIANT_BLE_NAME_DEVNUM_SUFFIX)
	{
		int n = radiant_ble_name_with_devnum(adv_name, sizeof(adv_name),
						     CONFIG_BT_DEVICE_NAME, devnum);

		if (n > 0) {
			sd[0].data_len = (uint8_t)n;
			err = bt_set_name(adv_name);
			if (err != 0) {
				LOG_WRN("bt_set_name(%s): %d", adv_name, err);
			}
		}
	}
#else
	ARG_UNUSED(devnum);
#endif

	adv_param = *BT_LE_ADV_CONN_FAST_1;
	adv_param.interval_min = ADV_UNITS(CONFIG_SMART_TRAINER_BLE_ADV_INTERVAL_MS);
	adv_param.interval_max = ADV_UNITS(CONFIG_SMART_TRAINER_BLE_ADV_INTERVAL_MS) + 16u;

	err = radiant_ble_adv_init(&adv_param, ad, ARRAY_SIZE(ad), sd, ARRAY_SIZE(sd));
	if (err != 0) {
		LOG_ERR("radiant_ble_adv_init: %d", err);
		return err;
	}
	err = radiant_ble_adv_ensure();
	if (err != 0) {
		LOG_WRN("BLE advertising not started yet (%d); retrying in the background",
			err);
		return 0;
	}

	LOG_INF("BLE: FTMS Indoor Bike (targets 0x%08x) advertising every %u ms as '%s'",
		(unsigned)caps->targets, (unsigned)CONFIG_SMART_TRAINER_BLE_ADV_INTERVAL_MS,
		adv_name);
	return 0;
}
```

## src/trainer_ble.h
```c
/* SPDX-License-Identifier: Apache-2.0 */
/*
 * trainer_ble.h - FTMS (Indoor Bike) over BLE beside the ANT+ FE-C master.
 * The service itself is radiant_ble_ftms (shared with apps/treadmill); this is
 * the trainer plugged into it. All calls on the system workqueue.
 */
#ifndef TRAINER_BLE_H_
#define TRAINER_BLE_H_

#include <stddef.h>
#include <stdint.h>

#include <radiant/radiant_ble_ftms.h>

#include "trainer_equip.h"

/* Register the machine, bring up the controller, DIS and advertising. 0, or
 * the errno of a fatal step (the node is then ANT+ only). */
int trainer_ble_start(uint16_t devnum, uint32_t serial,
		      const struct radiant_ble_ftms_caps *caps);

/* Called every node tick: paces the Indoor Bike Data notification and runs
 * the advertising watchdog. */
void trainer_ble_tick(void);

/* The session moved: Training Status and the machine status. */
void trainer_ble_session_changed(enum trainer_run prev, enum trainer_run next);

/* A target changed through FE-C: tell FTMS subscribers (0x07/0x08/0x12/0x13). */
void trainer_ble_notify_status(const uint8_t *msg, size_t len);

#endif /* TRAINER_BLE_H_ */
```

## src/trainer_ble_svc.h
```c
/* SPDX-License-Identifier: Apache-2.0 */
/*
 * trainer_ble_svc.h - the FTMS advertising Service Data the trainer puts in
 * every advertisement (FTMP Table 3.1): UUID 0x1826, Flags = Fitness Machine
 * Available, Fitness Machine Type = Indoor Bike (bit 5).
 *
 * In a header, not inline in trainer_ble.c, so tests/glue checks THIS
 * initialiser against radiant_ble_ftms_service_data() rather than a copy of
 * it. trainer_ble.c also checks it at boot and advertises the core's bytes if
 * the two ever disagree.
 */
#ifndef TRAINER_BLE_SVC_H_
#define TRAINER_BLE_SVC_H_

#include <stdint.h>

#include <radiant/radiant_ble_ftms.h>

#define TRAINER_FTMS_SVC_DATA_INIT                                          \
	{                                                                   \
		0x26u, 0x18u, RADIANT_BLE_FTMS_SD_FLAG_AVAILABLE,           \
		(uint8_t)(RADIANT_BLE_FTMS_TYPE_INDOOR_BIKE & 0xFFu),       \
		(uint8_t)(RADIANT_BLE_FTMS_TYPE_INDOOR_BIKE >> 8),          \
	}

#endif /* TRAINER_BLE_SVC_H_ */
```

## src/trainer_inbox.c
```c
/* SPDX-License-Identifier: Apache-2.0 */
/*
 * trainer_inbox.c - see trainer_inbox.h. No Zephyr header.
 */

#include <errno.h>
#include <string.h>

#include "trainer_inbox.h"

void trainer_inbox_init(struct trainer_inbox *ib)
{
	memset(ib, 0, sizeof(*ib));
}

void trainer_inbox_report(struct trainer_inbox *ib, const struct trainer_report *r)
{
	ib->rep = *r;
	ib->have_rep = true;
}

int trainer_inbox_event(struct trainer_inbox *ib, enum trainer_source_event evt)
{
	uint8_t next = (uint8_t)((ib->head + 1u) % TRAINER_INBOX_EVENTS);

	if (next == ib->tail) {
		return -ENOMEM;
	}
	ib->q[ib->head] = (uint8_t)evt;
	ib->head = next;
	/* The pending report predates the event: applied after it, it would
	 * undo it. */
	ib->have_rep = false;
	return 0;
}

enum trainer_inbox_item trainer_inbox_pop(struct trainer_inbox *ib, struct trainer_report *rep,
					  enum trainer_source_event *evt)
{
	if (ib->tail != ib->head) {
		*evt = (enum trainer_source_event)ib->q[ib->tail];
		ib->tail = (uint8_t)((ib->tail + 1u) % TRAINER_INBOX_EVENTS);
		return TRAINER_INBOX_EVENT;
	}
	if (ib->have_rep) {
		*rep = ib->rep;
		ib->have_rep = false;
		return TRAINER_INBOX_REPORT;
	}
	return TRAINER_INBOX_EMPTY;
}
```

## src/trainer_inbox.h
```c
/* SPDX-License-Identifier: Apache-2.0 */
/*
 * trainer_inbox.h - what a driver pushed (trainer_source_report() and
 * trainer_source_report_event()) waiting for the workqueue. Kernel-free; the
 * caller (trainer_source.c) holds a spinlock around every call.
 *
 * THE ORDERING RULE. Reports coalesce (the latest wins); events queue in
 * order. An event DROPS a report still pending from before it: that report
 * describes the trainer before the event, and applied after it, it would
 * undo it - a pedalling report taken just before an FTMS Pause would restart
 * the session the Pause just ended. A report pushed after the event is kept
 * and is applied after it.
 */
#ifndef TRAINER_INBOX_H_
#define TRAINER_INBOX_H_

#include <stdbool.h>
#include <stdint.h>

#include "trainer_source.h"

#ifdef __cplusplus
extern "C" {
#endif

#define TRAINER_INBOX_EVENTS 8u

struct trainer_inbox {
	struct trainer_report rep;
	bool    have_rep;
	uint8_t q[TRAINER_INBOX_EVENTS];
	uint8_t head;
	uint8_t tail;
};

enum trainer_inbox_item {
	TRAINER_INBOX_EMPTY = 0,
	TRAINER_INBOX_EVENT,
	TRAINER_INBOX_REPORT,
};

void trainer_inbox_init(struct trainer_inbox *ib);

/* Store a report (replacing a pending one). */
void trainer_inbox_report(struct trainer_inbox *ib, const struct trainer_report *r);

/* Queue an event and drop any report pending from before it. 0, or -ENOMEM
 * when the queue is full (the event is lost and the report kept). */
int trainer_inbox_event(struct trainer_inbox *ib, enum trainer_source_event evt);

/* The next item: events first, in order, then the report. */
enum trainer_inbox_item trainer_inbox_pop(struct trainer_inbox *ib, struct trainer_report *rep,
					  enum trainer_source_event *evt);

#ifdef __cplusplus
}
#endif

#endif /* TRAINER_INBOX_H_ */
```
