## apps/common/Kconfig.health
```kconfig
# SPDX-License-Identifier: Apache-2.0
#
# The 0xF6 health counters' own symbol, rsourced by the applications that have
# a host to answer - the same arrangement as Kconfig.antr_api and
# Kconfig.dongle_main beside it. apps/hrm_ble does not source it: a node has no
# serial host to request 0xF6 from, so the counters would have no way out.

config ANT_DONGLE_HEALTH_COUNTERS
	bool "Count what the dongle threw away, readable as MESG_RADIANT_HEALTH (0xF6)"
	help
	  Counts silent, dongle-side loss - USB TX queue drops, event-queue
	  overflows, RX backpressure, refused network keys, scheduler misses
	  and denials, burst back-pressure stalls, and the two halves of the
	  sweep's declined-to-post reason - and answers them to a host that
	  sends MESG_REQUEST (0x4D) for 0xF6. See apps/common/ant_health.h.

	  WHY IT MATTERS MORE THAN THE COUNTERS THEMSELVES.
	  tools/ab_gates.toml's `unexplained_loss.max = 0` is a *sitting
	  invalidator*: a hole in the accumulator with no RX_FAIL means the
	  loss happened on the host or inside the dongle, and
	  loss_accounting() cannot tell those two apart. This splits that
	  bucket with a firmware-side witness. The check has already caught
	  0.4 pp of imaginary loss once.

	  It is also the only record that survives on the board most people
	  flash: a Feather has no debugger, so the LOG_WRN that reports a
	  dropped event today goes nowhere at all.

	  OFF BY DEFAULT, and the reason is mechanical rather than cautious.
	  The `zero-cost` CI job asserts identical section sizes and symbol
	  sets against the merge base, and counters on the common path fire
	  it. With this off every note() compiles to nothing - a macro, not an
	  empty function, so nothing evaluates its arguments either - and the
	  shipping image is byte-identical. That keeps `zero-cost` a real
	  check rather than one that had to be weakened to admit this.

	  Turning it on does NOT change what the dongle does, only what it can
	  be asked. Nothing is ever emitted unsolicited, so the conformance
	  transcripts tools/ab_gates.toml pins byte-for-byte are unaffected.

	  It is NOT a request to deepen a queue. See ANT_TX_QUEUE_DEPTH in
	  apps/common/usb_ant_class.c: at 3103 msg/s depth 32 is about 10 ms
	  of buffer, and a deeper one converts a drop into latency, which is
	  the wrong trade for a protocol whose value is a 0.345 ms p50.
```

## apps/common/Kconfig.rgb_led
```kconfig
# SPDX-License-Identifier: Apache-2.0
#
# The activity-rate RGB indicator's own symbols, rsourced only by apps/dongle -
# the same arrangement as Kconfig.health and Kconfig.dongle_main beside it.
#
# apps/dongle_thread does not source it, and that is a scope decision rather
# than an oversight. The no-cost-to-the-radio argument in ant_rgb_led.c rests on
# the nRF52840 radio ISR being an ordinary maskable interrupt at priority 0;
# under MPSL the timeslot signal handler is a ZERO-LATENCY IRQ and the whole
# analysis has to be redone from scratch. apps/dongle_thread also does not build
# for the Feather at all, so there is nothing to indicate on yet.
#
# apps/hrm_ble and apps/treadmill do not source it either: neither is a receiver,
# so "how much traffic is being heard" is not a question they can answer.

config ANT_DONGLE_RGB_LED
	bool "Rotate a smart LED's hue at a speed set by ANT+ receive activity"
	select LED_STRIP
	select ANT_DONGLE_ACTIVITY_COUNT
	select ANT_DONGLE_ACTIVITY_CLAIMED
	help
	  Drives a WS2812-style RGB LED (the on-board NeoPixel on an Adafruit
	  Feather nRF52840, or any equivalent on another board) as a continuously
	  rotating hue whose SPEED encodes how much sensor traffic the dongle is
	  receiving - roughly 20 s per rotation with nothing on the air, down to
	  0.75 s with ten or so sensors active. Colour itself carries no
	  meaning, so there is nothing to memorise.

	  WHAT IT IS FOR. The Feather has no debugger and this image has no
	  console, so the led0 heartbeat in apps/common/ant_heartbeat_led.c is
	  the whole local diagnostic surface. This says the same thing in colour
	  and at a glance: full hue, across the room, with no host attached.

	  IT IS NO LONGER THE ONLY WAY TO SEE ACTIVITY. The heartbeat has its own
	  activity mode now (CONFIG_ANT_DONGLE_HEARTBEAT_LED_ACTIVITY, on by
	  default), reading the same counter and the same curve, and encoding the
	  rate as how often the mono LED flashes. That answers "is it hearing
	  anything" on every board rather than only the ones with a smart LED.
	  This remains the richer signal and the one that reads at distance.

	  THE TWO CANNOT BOTH READ THE COUNTER, and on this board this one wins:
	  ANT_DONGLE_HEARTBEAT_LED_ACTIVITY depends on this symbol being off, so
	  enabling the NeoPixel drops the mono LED back to its fixed flash. The
	  counter is drained with atomic_clear(), so two readers would each see
	  about half the traffic and both would report a quiet room - which is
	  a Kconfig dependency rather than a warning precisely because it is the
	  shipping Feather row, not a hypothetical.

	  IT COSTS THE RADIO NOTHING, AND THAT IS A DESIGN CONSTRAINT RATHER THAN
	  A HOPE. The transport is ws2812_spi: one 24-byte SPIM EasyDMA transfer
	  per update with the calling thread asleep on a semaphore, no irq_lock()
	  anywhere in the path, a completion interrupt at priority 1 where the
	  radio at priority 0 preempts it, and no share of the TIMER or (D)PPI
	  channels the radiant backend owns. The counting hook is one atomic
	  increment on the event thread, never in a radio callback.

	  Do NOT switch this to ws2812_gpio to save a pin. That driver holds
	  irq_lock() across the entire frame - about 30 us per pixel - and the
	  nRF52840 radio ISR is maskable, so every LED update would be a 30 us
	  blackout imposed on the radio.

	  OFF BY DEFAULT, mechanically rather than cautiously. The `zero-cost` CI
	  job asserts identical section sizes and symbol sets against the merge
	  base, and with this symbol off the render thread and the strip driver
	  are absent entirely.

	  What that job used to also prove - that the counting HOOK costs nothing
	  when the feature is off - is now a claim about
	  CONFIG_ANT_DONGLE_ACTIVITY_COUNT rather than about this symbol, and it
	  still holds: ant_activity_note_msg() is a macro expanding to nothing
	  with the counter off. It is on in the default image, because the mono
	  heartbeat's activity mode is.

	  ENABLING IT ON ANOTHER BOARD IS AN OVERLAY, NOT A CODE CHANGE. The
	  module finds its LED through the `rgb-led0` devicetree alias. Any board
	  with a smart LED needs apps/dongle/rgb_<board>.overlay declaring the
	  node and that alias, plus one build row; nothing in C or Kconfig moves.
	  The node must NOT go in a boards/<board>.overlay file - those apply to
	  every build for that board, and merely enabling a ws2812 compatible
	  flips CONFIG_WS2812_STRIP_SPI to y and pulls the driver into the stock
	  image, which is what `zero-cost` would then fail on.

if ANT_DONGLE_RGB_LED

config ANT_DONGLE_RGB_LED_BRIGHTNESS
	int "Peak channel brightness, 0-255"
	default 17
	range 1 255
	help
	  The value the brightest channel is held at; one channel sits here, one
	  ramps between 0 and here, the third is off. 17 is about 7 %, set from
	  looking at the first build on a Feather at 24 (about 10 %) and finding
	  it brighter than a desk needs; it also keeps a bus-powered dongle's LED
	  well clear of the current budget. Raise it if the dongle lives inside a
	  case or across a room.

config ANT_DONGLE_RGB_LED_TICK_MS
	int "Render period in milliseconds"
	default 25
	range 5 200
	help
	  How often the hue advances and the LED is rewritten. 25 ms (40 Hz) is
	  smooth to the eye and amounts to about 0.1 % DMA duty for a single
	  pixel. This is also the window instantaneous packet rate is measured
	  over before smoothing, so shortening it makes the raw signal spikier
	  rather than more responsive.

config ANT_DONGLE_RGB_LED_PRIO
	int "Render thread priority"
	default 10
	range 7 15
	help
	  Must stay numerically ABOVE both the serial bridge thread
	  (ANTR_HOST_THREAD_PRIORITY, 5) and the radiant API event thread (6), so
	  a preemptible LED update can never delay ANT work. The range starts at
	  7 to make that structural rather than a comment.

config ANT_DONGLE_RGB_LED_STACK_SIZE
	int "Render thread stack size"
	default 1024
	range 512 4096
	help
	  The loop itself is integer arithmetic over a handful of locals; the
	  stack is sized for the SPI driver call underneath it.

endif # ANT_DONGLE_RGB_LED
```
