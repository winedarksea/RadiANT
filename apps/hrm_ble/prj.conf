## CMakeLists.txt
```
# SPDX-License-Identifier: Apache-2.0

cmake_minimum_required(VERSION 3.20.0)

# RadiANT heart-rate node: a node, not a dongle, and the manufacturer reference
# design. See src/main.c for why it exists, src/hrm_sensor.h for the one seam a
# manufacturer implements, Kconfig for what it is allowed to do, and
# docs/hrm-reference-design.md for the porting guide.
#
# UNLIKE sim/, THIS NEEDS NO sdk-ant AT ALL. sim/ is built entirely out of
# sdk-ant's profile libraries and its radio, and says so in a FATAL_ERROR;
# this one is built out of radiant and radiant/src/profiles/, both
# of which are in this repository. That is the whole point of it: it is the
# first image where
# the clean-room stack transmits as a master with a real ANT+ profile on top,
# and a dependency on the proven stack would defeat the demonstration.
#
# radiant is appended unconditionally and its backend chosen with
# -DRADIANT_BACKEND, exactly as apps/dongle's CMakeLists.txt does - both now
# through the shared cmake/radiant_backend.cmake, included below. The
# duplication of *calling* it (rather than sharing one CMakeLists.txt) is
# deliberate and matches apps/sim's note: `west build apps/hrm_ble` must not
# depend on the dongle's build files existing or being current.
#
# THE DEFAULT IS nrf AND NOT null. Every application in this repository now
# defaults to a backend its silicon can really use, so this is no longer the
# odd one out - see cmake/radiant_backend.cmake for why the old `null` default
# was withdrawn everywhere. A null-radio strap boots, logs "transmitting", and
# puts nothing on the air - indistinguishable from a dead antenna, and it has
# cost this project a Feather flash and a whole session once already.
#
# radiant's own Kconfig default follows the SoC as well, and is null only where
# no real backend could resolve - tests/import_smoke on native_sim.
include("${CMAKE_CURRENT_SOURCE_DIR}/../../cmake/radiant_backend.cmake")
radiant_select_backend("${CMAKE_CURRENT_SOURCE_DIR}/../../radiant" "nrf" RADIANT_BACKEND_CONF)

set(hrm_backend_conf "${CMAKE_CURRENT_BINARY_DIR}/hrm_backend.conf")
file(WRITE "${hrm_backend_conf}"
"# Generated by apps/hrm_ble/CMakeLists.txt from -DRADIANT_BACKEND. Do not edit.
CONFIG_RADIANT=y
CONFIG_RADIANT_ANTR_API=y
${RADIANT_BACKEND_CONF}
")
list(APPEND EXTRA_CONF_FILE "${hrm_backend_conf}")

find_package(Zephyr REQUIRED HINTS $ENV{ZEPHYR_BASE})
project(radiant_hrm_ble)

# ── The BLE interlock, from the other side ──────────────────────────────────
#
# HRM_BLE_HRS `select`s RADIANT_BACKEND_NRF_GATE_MPSL, which covers the route
# through this application's own Kconfig. This covers the other route: any conf
# fragment, board file or -DCONFIG_ that turns CONFIG_BT on WITHOUT going
# through HRM_BLE_HRS.
#
# That combination is not merely unsupported, it is silent.
# radiant/Kconfig's nrf arm carries `depends on !BT || ..._GATE_MPSL`, so
# CONFIG_BT=y with no gate makes the arm unselectable and Kconfig falls back to
# the choice default - the NULL backend. The resulting node boots, logs
# "transmitting", and puts nothing on the air.
#
# BEFORE radiant_assert_backend(), NOT AFTER, and the ordering was measured
# rather than assumed. A build of this application with CONFIG_BT=y and no gate
# does already fail - but at the generic assert, whose message is about a CMake
# cache variable and lists three unrelated `depends on` symbols to go and check.
# The specific message has to come first to be the one anybody reads. (Verified
# by building exactly that configuration: with the two blocks the other way
# round, the output was radiant_assert_backend()'s "Kconfig chose
# CONFIG_RADIANT_BACKEND_NULL instead" and this text never appeared.)
#
# It also catches a case the assert structurally cannot see: a build that asked
# for `null` on purpose and then enabled BT.
if(CONFIG_BT AND NOT CONFIG_HRM_BLE_HRS)
  message(FATAL_ERROR
    "hrm_ble: CONFIG_BT is set but CONFIG_HRM_BLE_HRS is not.\n"
    "  radiant/Kconfig's nrf backend has `depends on !BT || "
    "RADIANT_BACKEND_NRF_GATE_MPSL`, so BT without the gate makes the nrf arm "
    "unselectable and Kconfig silently falls back to the null backend - a node "
    "that boots, logs 'transmitting' and puts nothing on the air.\n"
    "  Turn BLE on through this application's own symbol, which selects the "
    "gate for you:\n"
    "    west build ... -- -Dhrm_ble_EXTRA_CONF_FILE=ble.conf\n"
    "  THE PREFIX IS THE BASENAME OF THIS DIRECTORY. Sysbuild names an image "
    "after the basename of APP_DIR, so a stale `-Dstrap_EXTRA_CONF_FILE=` "
    "names an image that does not exist and is accepted in silence.")
endif()

# The backend actually compiled is the backend that was asked for.
#
# radiant_assert_backend(), shared with apps/dongle's CMakeLists.txt - see
# cmake/radiant_backend.cmake for the full rationale. What it guards against
# is a Kconfig `depends on` going silently unmet, falling back to the null
# backend: a null-radio node boots, logs "transmitting", and puts nothing on
# the air. It has happened twice on the Nordic side, and is more likely on TI,
# where the cc26xx arm has to depend on SOC_SERIES_CC13X2_CC26X2 because no
# SOC_COMPATIBLE_* symbol exists for the part.
radiant_assert_backend("hrm_ble")

target_sources(app PRIVATE
  src/main.c
  src/hrm_sensor.c
)

# ── The heart-rate source ───────────────────────────────────────────────────
#
# A Kconfig `choice`, so exactly one of these is ever compiled and exactly one
# hrm_sensor_register() call is ever linked. CONFIG_HRM_SENSOR_CUSTOM compiles
# none of them on purpose: see that symbol's help for why there is deliberately
# no fallback to the simulator.
#
# hrm_sim_sched.c is listed under the simulator with hrm_sim.c, but it is also
# compiled on its own by apps/hrm_ble/tests/sim_sched - it is a pure function
# with no kernel dependencies precisely so that it can be.
if(CONFIG_HRM_SENSOR_SIMULATED)
  target_sources(app PRIVATE src/hrm_sim.c src/hrm_sim_sched.c)
elseif(CONFIG_HRM_SENSOR_EXAMPLE)
  target_sources(app PRIVATE src/hrm_sensor_example.c)
endif()

# ── The antr_* adapter ──────────────────────────────────────────────────────
#
# radiant/src/antr/ant_radio_radiant.c (radiant_api.c, before it moved out of
# radiant) is what actually implements antr_init() and the rest of
# radiant/include/radiant/ant_radio.h on top of radiant's modules -
# CONFIG_RADIANT=y alone no longer pulls it in, since it is application-side
# now (see apps/common/Kconfig.antr_api). hrm_backend_conf above forces
# CONFIG_RADIANT_ANTR_API=y unconditionally, so this is never conditional in
# practice, but apps/common/sources.cmake's _ifdef-gated sources are shared
# with apps/dongle verbatim anyway, so nothing here fails silently if that
# ever changes.
include("${CMAKE_CURRENT_SOURCE_DIR}/../common/sources.cmake")

# ── radiant/src/profiles ───────────────────────────────────────────────
#
# THE FIRST NON-TEST CONSUMER OF THESE FILES. Until this application they were
# compiled only by radiant/tests/CMakeLists.txt, so every profile in the
# project had only ever run inside a unit test. Nothing in them needed changing
# to run for real, which is the claim this build makes and the reason it is
# worth making.
#
# WHAT THE LINKER SAYS IS NEEDED, WHICH IS MORE THAN THE PAGE NEEDS.
#
# The first four are the heart-rate page itself. The other two are pulled in by
# the seam rather than by the profile: profile_sched.c's slot rotation calls
# into profile_schedule.c to encode the descriptor, and profile_hr_next() calls
# profile_compat_next() unconditionally - the compat client is a *seam*, and
# whether it emits anything is a run-time question of whether a compat context
# was attached, not a compile-time one. This application attaches none, so
# profile_hr_set_compat() is never called and the strap stays a plain ANT+ 0x78
# sensor on the air.
#
# That distinction matters for P8b specifically. A strap being used to measure
# BLE coexistence must broadcast exactly what a commercial strap broadcasts;
# adding RadiANT beacon and attestation pages would change the airtime being
# measured, which is the one thing the phase is for. So the compat layer is
# LINKED and INERT, and the enrolment, private-mode, adaptive-frequency and
# command layers are not linked at all - they join when there is a reason.
target_sources(app PRIVATE
  ../../radiant/src/profiles/profile_bits.c
  ../../radiant/src/profiles/profile_common.c
  ../../radiant/src/profiles/profile_sched.c
  ../../radiant/src/profiles/profile_hr.c
  ../../radiant/src/profiles/profile_schedule.c
  ../../radiant/src/profiles/profile_compat.c
  ../../radiant/src/profiles/profile_telemetry.c
  ../../radiant/src/profiles/profile_handoff.c
)
target_include_directories(app PRIVATE ../../radiant/src/profiles)

# ── radiant/src/node ───────────────────────────────────────────────────
#
# A LIBRARY, NOT AN APPLICATION - the plan's words, and the reason it can be
# linked here at all. The identity record decides the device number under
# ADR 0009, and the settings-backed NVM implementation is the one the dongle
# already uses.
target_sources(app PRIVATE
  ../../radiant/src/node/node_ident.c
  ../../radiant/src/node/node_nvm_settings.c
)
target_include_directories(app PRIVATE ../../radiant/src/node)

if(CONFIG_HRM_BLE_HRS)
  target_sources(app PRIVATE src/hrm_ble.c)
endif()
```

## Kconfig
```
#
# RadiANT heart-rate node - the manufacturer reference design.
#
# One prefix for the whole application, HRM_*, the same way the dongle uses
# ANT_DONGLE_* and the simulator uses ANT_SIM_*. The three never build together,
# but a shared prefix would make "which application does this symbol belong to"
# ambiguous, and the answer to that question is how the CI assertions stay
# honest.
#
# The prefix was STRAP_* until Phase 3.2. It was renamed because "strap" named
# the bench instrument this started as, and this is now the design a
# manufacturer copies. The rename landed AFTER .github/workflows/release.yml's
# build-node job and scripts/build_all.ps1's node row, deliberately: until those
# existed nothing in the repository compiled this application at all, so a
# rename that broke the build would have stayed invisible until somebody next
# needed the board.
#

rsource "../../radiant/src/node/Kconfig"
rsource "../../radiant/src/profiles/Kconfig"
rsource "../common/Kconfig.antr_api"

# ── Defaults this application imposes on symbols it does not own ────────────
#
# BEFORE `source "Kconfig.zephyr"`, and that placement is the whole mechanism.
# Kconfig collects every `default` of a symbol in the order the definitions are
# parsed and takes the FIRST whose condition holds. nrfxlib's own definition of
# MPSL_TIMESLOT_SESSION_COUNT carries `default 0`; if this block were parsed
# after it, ours would be dead and the .config would read 0 with no error
# anywhere.
#
# WHY THE SYMBOL MATTERS HERE. Every timeslot session_open() fails when the
# count is 0, while the image still runs - so the arbitrated build's failure
# mode is a node that refuses every arm rather than a build error, and on a
# bench that is indistinguishable from a dead antenna. radiant/Kconfig's own
# help text for RADIANT_BACKEND_NRF_GATE_MPSL says so at length. It used to be
# set by hand in ble.conf, which worked only for as long as somebody remembered
# to pass that fragment.
config MPSL_TIMESLOT_SESSION_COUNT
	default 1 if HRM_BLE_HRS

# BT_PERIPHERAL_PREF_* is the PPCP characteristic
# (BT_GAP_PERIPHERAL_PREF_PARAMS, default y - GAP publishes it whether this
# file says anything or not) AND, via BT_GAP_AUTO_UPDATE_CONN_PARAMS (kept
# =y - see ble.conf/prj.conf), the parameters this node itself REQUESTS 5 s
# into every connection. Zephyr's own defaults are 24/40/0/42 - a 30-50 ms
# interval with almost no supervision margin - which is exactly the fast,
# high-priority-to-the-controller event rate finding 1 says ANT+ can never
# outrank. Before this block nothing tied that number to
# HRM_BLE_MIN_CONN_INTERVAL_UNITS, the number `on_param_req()` in
# src/hrm_ble.c actually enforces on an incoming request: the advertised
# policy and the enforced policy were two different numbers, and
# BT_GAP_AUTO_UPDATE_CONN_PARAMS was self-requesting the wrong one.
#
# SAME PLACEMENT RULE AS MPSL_TIMESLOT_SESSION_COUNT ABOVE, and it matters
# here too: Kconfig takes the FIRST `default` whose condition holds, in
# parse order, and Kconfig.zephyr pulls in subsys/bluetooth's Kconfig.gatt
# with its own `default 24`/`40`/`0`/`42`. Parsed after that, these would be
# dead and .config would read Zephyr's numbers with no error anywhere - the
# same silent-zero failure mode the comment above describes for the MPSL
# symbol.
#
# MIN == MAX == HRM_BLE_MIN_CONN_INTERVAL_UNITS (800, i.e. 1 s - see that
# symbol's help for why): there is no range to negotiate within, only the
# one interval finding 1 shapes BLE's demand to.
#
# LATENCY 0: any peripheral latency scales the timeout bound below by
# (1+latency), and buys nothing here - the 1 s interval is already what
# suppresses the controller's event rate; skipping connection events on top
# of that would only slow this node's own detection of a dropped link.
#
# TIMEOUT 400 (4 s, 10 ms units - PPCP's own units). Zephyr's connection
# parameter validity check (bt_le_conn_params_valid(), hci_core.c) is
# `timeout*4 > (1+latency)*interval_max`, both sides in their native raw
# units (10 ms, 1.25 ms). At interval_max=800, latency=0 that bound is
# timeout > 200 (> 2 s). 400 is 2x that floor: it tolerates roughly 3
# back-to-back missed 1 s connection events before the controller itself
# declares the link lost, which keeps a phone's brief walk out of range from
# flipping HRM_SUPPRESS_ANT_WHEN_CONNECTED off and on. NOT LARGER THAN
# THAT: a longer timeout is exactly what pins a stale "connected" state (and
# the ANT+ suppression it drives) after the phone is actually gone, which is
# the failure this knob exists to bound in the first place.
config BT_PERIPHERAL_PREF_MIN_INT
	default HRM_BLE_MIN_CONN_INTERVAL_UNITS if HRM_BLE_HRS

config BT_PERIPHERAL_PREF_MAX_INT
	default HRM_BLE_MIN_CONN_INTERVAL_UNITS if HRM_BLE_HRS

config BT_PERIPHERAL_PREF_LATENCY
	default 0 if HRM_BLE_HRS

config BT_PERIPHERAL_PREF_TIMEOUT
	default 400 if HRM_BLE_HRS

source "Kconfig.zephyr"

menuconfig HRM
	bool "RadiANT heart-rate node"
	default y
	help
	  A RadiANT NODE: radiant driving a master channel with
	  radiant/src/profiles/profile_hr.c on top, broadcasting ANT+ heart rate
	  (device type 0x78). No USB and no serial bridge - this is not a
	  dongle, and the only host interface is the log.

	  It exists twice over. It was P8 of the multiprotocol plan - the BLE
	  coexistence work needs a node whose ANT+ side is a master, because a
	  master owns its slot phase and a slave does not, and what happens to a
	  transmit schedule under an arbiter is the whole question. It is now
	  also the reference design a manufacturer starts from; see
	  docs/hrm-reference-design.md for what that means and what it does not.

if HRM

config HRM_DEVICE_NUMBER
	int "ANT device number used only when identity boot fails"
	range 1 65535
	default 4242
	help
	  Used only when node_ident_boot() fails - no entropy backend to make
	  K_dev from, a storage error, an exhausted boot counter - and the boot
	  log then says so at error level. Normally the node generates K_dev on
	  its first boot (ADR 0020) and takes its device number from the
	  identity record, which is what ADR 0009 requires: the number is a
	  property of the node's identity, not of the image.

	  A SHIPPED PRODUCT MUST NOT RUN ON THE FALLBACK: every unit built from
	  one image shares it. See docs/hrm-reference-design.md's production
	  checklist, items 3 and 4.

	  Avoid numbers with a long alternating bit run in the on-air address:
	  nRF-based receivers lose up to ~5 % of their frames (ADR 0019). Check
	  one with `tools/ant_identity.py check <number> --device-type 0x78`.
	  The image logs a warning when it opens a channel with such a number.

config HRM_MANUFACTURER_ID
	int "manufacturer id for the common pages"
	range 0 255
	default 255
	help
	  255 is the ANT+ development id. A shipped strap needs a real one from
	  the alliance; using it here would be claiming somebody else's.

# ── The sensor seam ─────────────────────────────────────────────────────────
#
# A CHOICE AND NOT A BOOL, AND THAT IS THE SAFETY PROPERTY. With a bool
# ("enable the simulator") a manufacturer who forgets to turn it off ships a
# chest strap that reports a constant 72 bpm from a simulator, and nothing in
# the build says so. A choice makes "I forgot to unhook the simulator"
# impossible to express: exactly one arm is compiled, exactly one
# hrm_sensor_register() call is linked, and the boot log names which.
#
# There is deliberately NO fallback from HRM_SENSOR_CUSTOM to the simulator.
# See that symbol's help.
choice HRM_SENSOR
	prompt "heart-rate source"
	default HRM_SENSOR_SIMULATED
	help
	  Which implementation of src/hrm_sensor.h's seam is compiled in. The
	  seam is push (source-driven), not poll: a real detector is an ISR on
	  an analogue front end's comparator line and knows the instant the beat
	  happened, whereas an application tick only knows when it last looked.
	  That direction is the design and not an implementation detail - see
	  src/hrm_sensor.h's header for why the Zephyr sensor API was rejected.

config HRM_SENSOR_SIMULATED
	bool "simulated - a fixed rate, no hardware"
	help
	  src/hrm_sim.c. A DK has no electrodes. The beat generator produces
	  beats at HRM_SENSOR_SIM_BPM so the page 0 event count and event time -
	  the fields that actually survive a lost packet - advance the way a
	  real strap's do.

	  This is the reference implementation of the seam as well as the bench
	  instrument: its scheduler is a pure function in src/hrm_sim_sched.c
	  precisely so that the drift property can be tested without a radio.

config HRM_SENSOR_EXAMPLE
	bool "example driver - the seam's second implementation"
	help
	  src/hrm_sensor_example.c: a worked example of a driver that owns a
	  hardware timestamp, written to be read rather than to be shipped. It
	  reports beats from a k_timer handler (interrupt context) using
	  hrm_sensor_now_1024(), which is the same shape an AFE comparator ISR
	  has.

	  IT IS BUILT IN CI ON PURPOSE. A seam with one implementation is
	  indistinguishable from a direct call with extra prototypes - the same
	  argument .github/workflows/release.yml already makes about
	  encryption.conf. The second implementation is what proves the seam is
	  a seam.

config HRM_SENSOR_CUSTOM
	bool "custom - your driver, registered at boot"
	help
	  NOTHING IN THIS TREE IMPLEMENTS THE SEAM UNDER THIS OPTION. Your code
	  calls hrm_sensor_register() before main()'s hrm_sensor_start(), from a
	  SYS_INIT() or from a driver's own init hook.

	  If it does not, the node transmits PROFILE_HR_INVALID_BPM forever and
	  logs an error at boot. That is the CORRECT failure and it is
	  deliberately NOT a fallback to the simulator: a strap that quietly
	  reports 72 bpm from a simulator on a real chest is a worse outcome
	  than one that reports nothing, because only the second is visible from
	  the receiving end.

endchoice

config HRM_SENSOR_SIM_BPM
	int "simulated heart rate, beats per minute"
	depends on HRM_SENSOR_SIMULATED || HRM_SENSOR_EXAMPLE
	range 30 220
	default 72
	help
	  Was CONFIG_STRAP_HR_BPM, and it moved under the source rather than
	  staying an application-level symbol because it is a property of ONE
	  implementation of the seam. A custom driver has a real heart to read;
	  a rate setting means nothing to it.

	  30..220 is the range profile_hr's page 0 can represent as a computed
	  value and that a receiver will believe. Note that the byte is not
	  clamped at 255 as a sentinel: on this profile 0 means "no reading" and
	  0xFF is a real 255 bpm.

config HRM_BLE_HRS
	bool "also advertise the SIG Heart Rate Service over BLE"
	depends on BT && BT_PERIPHERAL
	select BT_HRS
	#
	# SELECT, NOT DEPENDS, AND THE SYMBOL WAS CHECKED FIRST.
	#
	# `select` bypasses a symbol's own `depends on`, so selecting something
	# with non-trivial dependencies can produce an invalid configuration
	# that Kconfig only warns about. RADIANT_BACKEND_NRF_GATE_MPSL has NO
	# `depends on` at all - radiant/Kconfig says so explicitly and explains
	# why (it cannot depend on RADIANT_BACKEND_NRF, because the nrf arm's
	# own `!BT` exclusion is relaxed by this symbol, and each depending on
	# the other is a Kconfig loop). So there is nothing here for `select` to
	# bypass, and `select` is the right verb.
	#
	# WHAT IT RETIRES. CONFIG_BT=y breaks the `!BT` half of the nrf
	# backend's `depends on !BT || RADIANT_BACKEND_NRF_GATE_MPSL`. Without
	# the gate the choice silently falls back to RADIANT_BACKEND_NULL - a
	# node that boots, logs "transmitting", and puts nothing on the air.
	# This used to be a hand-written line in ble.conf, which meant the
	# interlock held only for as long as one fragment stayed correct.
	# CMakeLists.txt carries a FATAL_ERROR backstop for the same interlock
	# approached from the other side (CONFIG_BT without this symbol).
	select RADIANT_BACKEND_NRF_GATE_MPSL
	#
	# PIN THE SOFTDEVICE CONTROLLER HERE, NOT ONLY IN A .conf FRAGMENT.
	# coex.conf (apps/dongle_thread) already sets CONFIG_BT_LL_SOFTDEVICE=y
	# for the bridge's BLE arm, but hrm_ble had no equivalent - it relied on
	# whatever the default link layer happens to be for CONFIG_BT=y on the
	# target board, which is a controller choice this design cannot leave to
	# chance: S4-A's tombstone (BLE connected arm, docs/testing.md) and the
	# gate/MPSL arbitration this whole file exists for both assume the SDC,
	# not the open-source LL, is what is beside radiant on the radio.
	select BT_LL_SOFTDEVICE
	help
	  P8b: the SoftDevice Controller beside the ANT+ master, advertising
	  the standard SIG Heart Rate Service, so that one strap serves both a
	  phone and an ANT+ receiver.

	  THE CONNECTION AND ADVERTISING INTERVALS ARE THE PRIORITY MECHANISM,
	  not a power tuning. Finding 1 of the plan: MPSL's two
	  application-visible priorities rank us against ourselves and not
	  against the Bluetooth controller, which outranks anything an
	  application can request. So RadiANT keeps its slots by SHAPING the
	  other stack's demand, exactly as nrf/samples/esb/esb_ptx_ble does
	  with a 1 s connection interval.

config HRM_BLE_ADV_INTERVAL_MS
	int "BLE advertising interval, milliseconds"
	depends on HRM_BLE_HRS
	range 100 10000
	default 1000
	help
	  1-2 s is what the plan specifies for the strap. Shortening it is not
	  a power trade, it is a decision to take air away from ANT+, and the
	  coexistence gate is what says whether it can be afforded.

	  The cost of the long interval is discovery latency, and it is
	  measured, not estimated: at 1009 ms a scanner saw 18 advertisements in
	  120 s, and both a 12 s and a 40 s scan found nothing while the node
	  was on the air. Budget >= 90 s before calling a node missing. See
	  docs/hrm-reference-design.md section 7.

config HRM_BLE_MIN_CONN_INTERVAL_UNITS
	int "shortest connection interval to accept, 1.25 ms units"
	depends on HRM_BLE_HRS
	range 6 3200
	default 800
	help
	  800 units is 1 s, which is what nrf/samples/esb/esb_ptx_ble uses to
	  run BLE beside a timeslot user, and it is chosen for the same reason.
	  A phone will ask for far less - iOS asks for tens of milliseconds -
	  and accepting hands the controller a recurring high-priority event
	  every few milliseconds for the life of the connection. MPSL gives the
	  controller priority levels above anything this application can
	  request, so that air is simply gone; refusing the update is the only
	  place the decision can be made.

config HRM_SUPPRESS_ANT_WHEN_CONNECTED
	bool "stop ANT+ while a BLE connection is live"
	depends on HRM_BLE_HRS
	default y
	help
	  P9's suppression rule, as policy above the link layer: a phone that
	  has connected is receiving the same heart rate over the SIG service,
	  so continuing to broadcast ANT+ spends air on a duplicate - and it
	  means the hard contention case never normally arises at all.

	  Turn it off for the minority-manufacturer behaviour, where straps
	  keep transmitting ANT+ while connected so a watch and a phone can be
	  served at once. That configuration is the one the coexistence gate
	  actually stresses.

module = HRM
module-str = hrm
source "subsys/logging/Kconfig.template.log_config"

endif # HRM
```

## sample.yaml
```
# SPDX-License-Identifier: Apache-2.0
#
# Twister coverage for the heart-rate node.
#
# THIS FILE PREDATES THE STRAP_* -> HRM_* RENAME, DELIBERATELY. Until it and
# .github/workflows/release.yml's build-node job existed, apps/hrm_ble appeared in
# neither the workflow nor scripts/build_all.ps1, so nothing anywhere compiled
# it: a rename that broke the build would have stayed invisible until somebody
# next needed the board, turning a mechanical edit into a bench session.
# Coverage first, rename second.
#
# build_only on every entry. These are compile-and-configure assertions, not
# tests - the node's actual behaviour needs a radio, a BLE central and a
# stopwatch, and docs/hrm-reference-design.md section 7 is where that lives. The
# one property that IS testable without hardware has its own ztest application
# in tests/sim_sched/, because the scheduler was made a pure function so that it
# could.
#
# The value is NOT in the compile. It is in the .config read-back that the
# build-node CI job does afterwards: see 3.0 of the plan, where
# `-Dstrap_EXTRA_CONF_FILE=` turned out to be a silent no-op after the
# directory rename, because sysbuild derives the image name from the basename
# of APP_DIR. The flag named an image that no longer existed, CMake emitted
# only its end-of-run "manually-specified variables were not used" warning, and
# the BLE image built green with no BLE in it. A build-only entry would have
# passed that too. Asserting the resulting .config is the only thing that would
# not have.

# WHO ACTUALLY RUNS THIS FILE. Not CI, today: the ztest job's twister
# invocation walks `app/radiant/tests` and `app/apps/hrm_ble/tests`, and this
# file sits beside them rather than under either. The configurations below are
# built and asserted by the build-node job in .github/workflows/release.yml and by
# scripts/build_all.ps1's node rows; this file is for
# `twister -T apps/hrm_ble -p nrf54l15dk/nrf54l15/cpuapp` by hand, and for
# stating the matrix in one place that the two of them can be read against.
# Saying so here rather than implying coverage that does not exist.
#
# sysbuild: true, and it is load-bearing rather than boilerplate. Every
# `hrm_ble_`-prefixed argument below is an IMAGE-SCOPED sysbuild setting; run
# without sysbuild, twister would pass them to a build that has no image scoping
# at all and they would be silently ignored - the exact failure this application
# is named after.
common:
  build_only: true
  sysbuild: true
  tags:
    - radiant
    - hrm_ble

tests:
  # The plain ANT+ node: no BLE, no arbiter. The baseline the others are read
  # against, and the configuration a manufacturer starts from.
  hrm_ble.node:
    platform_allow:
      - nrf54l15dk/nrf54l15/cpuapp
    extra_args:
      - RADIANT_BACKEND=nrf

  # THE OTHER HALF OF THE BACKEND'S `depends on`.
  #
  # radiant/Kconfig's nrf arm is `SOC_COMPATIBLE_NRF52X || SOC_COMPATIBLE_NRF54LX`
  # and until this entry existed only the nRF54L half was ever compiled - so the
  # profile + node + BLE combination had never been built on the family most
  # existing ANT+ silicon actually is. boards/nrf52840dk_nrf52840.overlay names
  # TIMER4, because the backend needs five CC channels and on nRF52 only TIMER3
  # and TIMER4 have more than four.
  #
  # BUILD-VERIFIED ONLY, and the overlay says so at more length: nothing on an
  # nRF52 has been on a bench, and radiant/Kconfig's own help text records that
  # the part's on-air behaviour is predicted from the nRF54L15 measurements
  # rather than confirmed.
  hrm_ble.node_nrf52840:
    platform_allow:
      - nrf52840dk/nrf52840
    extra_args:
      - RADIANT_BACKEND=nrf

  # The BLE half, image-scoped through the CORRECT image name. `hrm_ble_` here
  # is the fix for 3.0: the basename of this directory is what sysbuild uses,
  # so `strap_` silently addressed nothing.
  hrm_ble.ble:
    platform_allow:
      - nrf54l15dk/nrf54l15/cpuapp
    extra_args:
      - RADIANT_BACKEND=nrf
      - hrm_ble_EXTRA_CONF_FILE=ble.conf

  # The configuration that actually stresses the arbiter.
  #
  # With HRM_SUPPRESS_ANT_WHEN_CONNECTED=y - the default - the node stops
  # transmitting ANT+ for the duration of a BLE connection, so the two stacks
  # never genuinely contend and the gate is never asked to do its job. This
  # entry is the one where MPSL has to arbitrate a 4.06 Hz ANT+ obligation
  # against a live BLE connection, which is the case the timeslot code exists
  # for. Kconfig's own help text for that symbol says as much.
  hrm_ble.ble_nosuppress:
    platform_allow:
      - nrf54l15dk/nrf54l15/cpuapp
    extra_args:
      - RADIANT_BACKEND=nrf
      - hrm_ble_EXTRA_CONF_FILE="ble.conf;ble_nosuppress.conf"

  # THE SEAM'S SECOND IMPLEMENTATION.
  #
  # A seam with one implementation is indistinguishable from a direct call with
  # extra prototypes - the same argument build.yml already makes about
  # encryption.conf. src/hrm_sensor_example.c is the one that reports beats from
  # interrupt context, which is the case the whole lock-free {seq, event_time}
  # design exists for, so it is also the arm that would break first if somebody
  # "simplified" hrm_sensor_report_beat().
  hrm_ble.example:
    platform_allow:
      - nrf54l15dk/nrf54l15/cpuapp
    extra_args:
      - RADIANT_BACKEND=nrf
      - hrm_ble_EXTRA_CONF_FILE=sensor_example.conf

  # THE ARM WITH NO SENSOR IN IT, and it is here to prove a negative.
  #
  # CONFIG_HRM_SENSOR_CUSTOM compiles no implementation of the seam at all. The
  # image must still LINK - if it does not, an integrator's first build fails
  # for a reason that has nothing to do with their driver - and it must still
  # run, logging an error and transmitting PROFILE_HR_INVALID_BPM rather than
  # falling back to the simulator. Only the link half is checkable here; the
  # rest is in hrm_sensor.c's hrm_sensor_start() and in the reference design's
  # section on porting.
  hrm_ble.custom:
    platform_allow:
      - nrf54l15dk/nrf54l15/cpuapp
    extra_args:
      - RADIANT_BACKEND=nrf
      - hrm_ble_EXTRA_CONF_FILE=sensor_custom.conf

# Deliberately not here, so that the absence is a recorded decision rather than
# an oversight:
#
#   * nrf54lm20dk/nrf54lm20a/cpuapp. The overlay exists
#     (boards/nrf54lm20dk_nrf54lm20a_cpuapp.overlay) and scripts/build_all.ps1's
#     node rows build it, but it adds nothing to THIS file: it is the same
#     SOC_COMPATIBLE_NRF54LX arm as the L15 with the same TIMER answer, so a
#     twister entry for it would cost a full build per CI run to re-prove a
#     property the L15 row already proves. The nRF52840 row above is the one
#     that covers a different arm.
#   * A BLE row on nRF52840. It would be the first time SDC, MPSL and the gate
#     were compiled together on that family, which makes it valuable and also
#     makes it the row most likely to fail for a reason nobody here can
#     reproduce - there is no nRF52 bench slot for this application. It lands
#     with the first nRF52 bench session, not before it.
```

## prj.conf
```kconfig
# RadiANT heart-rate node.
#
# Nothing here is shared with the dongle's prj.conf on purpose, and for the same
# reason apps/sim says it: this build has no USB, no serial bridge and no
# partition-manager constraints. It is a sensor. What it does share with the
# dongle - and apps/sim does not - is the whole radio stack, because that is the
# point of the application.

CONFIG_HRM=y

# radiant and its antr_* adapter. The backend itself comes from
# -DRADIANT_BACKEND via the generated fragment in CMakeLists.txt, so that a
# null-radio build is a deliberate choice rather than a default nobody noticed.
CONFIG_RADIANT=y
CONFIG_RADIANT_ANTR_API=y

# The identity record and its storage. ADR 0009 makes the device number a
# property of the node rather than of the image, and settings-backed NVM is the
# same implementation the dongle uses.
#
# RADIANT_SEC is not optional here and not a feature choice: src/node/Kconfig
# says `depends on RADIANT_SEC` because everything in node_ident derives keys,
# down to the boot counter's epoch. A strap without it is a strap with no
# identity, which is the one thing ADR 0009 says a node must have.
CONFIG_RADIANT_SEC=y
CONFIG_RADIANT_NODE_IDENT=y
CONFIG_RADIANT_NODE_NVM_SETTINGS=y
CONFIG_SETTINGS_NVS=y

# The entropy source K_dev is generated from on first boot (ADR 0020): the
# board's zephyr,entropy node through Zephyr's entropy driver - CRACEN on
# nRF54L, the RNG peripheral on nRF52840 (boards/nrf52840dk_nrf52840.overlay
# chooses it). With it, CONFIG_RADIANT_NODE_IDENT_SELF_PROVISION defaults on,
# and every unit flashed from one image gets its own device number.
# Its cost (+2.5 KB RAM main stack on a plain nRF54L build) is accepted only for
# products that self-provision. A product that opts out must drop this line, not
# just set SELF_PROVISION=n, unless something else needs radiant_sec_rng()
# (ADR 0020, "Accepted costs").
CONFIG_RADIANT_SEC_RNG_ENTROPY=y

CONFIG_HEAP_MEM_POOL_SIZE=2048

# Logs out the DK's first VCOM. Not RTT: RTT needs SEGGER's JLinkARM DLL
# installed, whereas the VCOM is carried by the cable that already programs the
# board.
CONFIG_LOG=y
CONFIG_LOG_MODE_DEFERRED=y
CONFIG_SERIAL=y
CONFIG_CONSOLE=y
CONFIG_UART_CONSOLE=y
CONFIG_LOG_BACKEND_UART=y

# Halt on a fault rather than rebooting into it. A sensor that resets in a loop
# still transmits between resets, which reads as an intermittent radio fault
# from the receiving end - the most expensive kind of symptom to chase, and one
# this project has already paid for twice.
CONFIG_RESET_ON_FATAL_ERROR=n
CONFIG_THREAD_NAME=y
```

## ble.conf
```kconfig
# P8b: enable the BLE HRS branch on top of the ANT+ node build.
#
# Was strap_ble.conf. Passed IMAGE-SCOPED:
#
#   -Dhrm_ble_EXTRA_CONF_FILE=ble.conf
#
# THE PREFIX IS THE BASENAME OF THE APPLICATION DIRECTORY, and getting it wrong
# is silent. Sysbuild derives an image's name from the basename of APP_DIR, so
# while this directory was strap/ the flag was `-Dstrap_EXTRA_CONF_FILE=`. After
# the rename that flag named an image that does not exist: CMake said nothing
# beyond its end-of-run "manually-specified variables were not used" warning,
# and the BLE image built green with no BLE in it. Measured - two builds, one
# with the flag and one without, produced byte-identical .config files (the
# with-flag one recording `# CONFIG_BT is not set`), which is what proves it was
# a total no-op rather than a partial one.
#
# A plain -DEXTRA_CONF_FILE= is no better: it lands in the sysbuild cache and
# never reaches the image at all. .github/workflows/release.yml's build-node job
# asserts the resulting .config for exactly this reason - a build-only check
# passes the no-op without noticing.

CONFIG_HRM_BLE_HRS=y
CONFIG_BT=y
CONFIG_BT_PERIPHERAL=y
# The name a phone, Zwift, or a BLE scanner shows for this node. It is a
# simulated heart rate monitor, so it is named as one - "RadiANT HR", not
# "RadiANT Strap". src/hrm_ble.c puts this same string in the advertising
# payload (BT_DATA_NAME_COMPLETE), so it is visible in a scan list without
# connecting first, and BUILD_ASSERTs the 22-character budget it has to fit.
CONFIG_BT_DEVICE_NAME="RadiANT HR"

# NOT SET HERE ANY MORE, and their absence is the point:
#
#   CONFIG_RADIANT_BACKEND_NRF_GATE_MPSL=y
#   CONFIG_MPSL_TIMESLOT_SESSION_COUNT=1
#
# Both used to be hand-written in this file, which meant the interlock held only
# for as long as one fragment stayed correct - and this file is precisely the
# one that a manufacturer replaces. They are now a `select` and a `default` on
# HRM_BLE_HRS in apps/hrm_ble/Kconfig, so turning the BLE branch on carries them
# with it however it is turned on. CMakeLists.txt keeps a FATAL_ERROR backstop
# for the same interlock approached from the other side (CONFIG_BT set without
# HRM_BLE_HRS), and build-node asserts both symbols land in .config.
```

## ble_nosuppress.conf
```kconfig
# Layered ON TOP OF ble.conf, never instead of it:
#
#   -Dhrm_ble_EXTRA_CONF_FILE="ble.conf;ble_nosuppress.conf"
#
# A fragment rather than a `-DCONFIG_...=n` on the command line, for the same
# reason ble.conf is image-scoped: under sysbuild a bare -DCONFIG_x lands in the
# sysbuild cache and never reaches the image, exactly as a bare
# -DEXTRA_CONF_FILE does. The semicolon-list form is the one already used for
# the P4 SED arm (thread.conf;thread_sed.conf).
#
# WHAT THIS IS FOR. With HRM_SUPPRESS_ANT_WHEN_CONNECTED=y - the default - the
# node stops transmitting ANT+ for the duration of a BLE connection, so the two
# stacks never genuinely contend and MPSL is never asked to arbitrate anything.
# That default is right for a shipping strap and useless as a test: it is the
# configuration in which the timeslot code cannot fail.
#
# Turning it off is what puts a 4.06 Hz ANT+ transmit obligation and a live BLE
# connection on one radio at the same time, which is the case the gate exists
# for. Kconfig's own help text for the symbol says as much.
CONFIG_HRM_SUPPRESS_ANT_WHEN_CONNECTED=n
```

## sensor_custom.conf
```kconfig
# Compile NO implementation of the heart-rate seam - the integrator's starting
# point.
#
#   -Dhrm_ble_EXTRA_CONF_FILE=sensor_custom.conf
#
# A fragment rather than a bare -DCONFIG_ for the reason ble.conf gives: under
# sysbuild a bare -DCONFIG_x lands in the sysbuild cache and never reaches the
# image.
#
# WHAT THIS BUILD DOES. It links - which is the whole reason it is in CI, since
# an integrator's very first build failing for a reason unrelated to their
# driver is an expensive way to start - and at boot hrm_sensor_start() returns
# -ENODEV, logs an error naming this symbol, and the node transmits
# PROFILE_HR_INVALID_BPM forever.
#
# THAT IS THE CORRECT FAILURE AND IT IS NOT A BUG. There is deliberately no
# fallback to the simulator: a strap quietly reporting a simulated 72 bpm on a
# real chest is invisible from the receiving end, and a strap reporting nothing
# is not. Your code calls hrm_sensor_register() from a SYS_INIT() before main()
# reaches hrm_sensor_start(); see src/hrm_sensor.h and
# docs/hrm-reference-design.md.
CONFIG_HRM_SENSOR_CUSTOM=y
```

## sensor_example.conf
```kconfig
# Compile the seam's second implementation instead of the simulator.
#
#   -Dhrm_ble_EXTRA_CONF_FILE=sensor_example.conf
#
# A FRAGMENT AND NOT A BARE -DCONFIG_HRM_SENSOR_EXAMPLE=y, for the same reason
# ble.conf is image-scoped: under sysbuild a bare -DCONFIG_x lands in the
# sysbuild cache and never reaches the image. It is accepted, it warns about
# nothing, and the build compiles the simulator - which is precisely the class
# of silent no-op this application already shipped once (see ble.conf).
#
# src/hrm_sensor_example.c is a worked example of a driver that reports beats
# from interrupt context. It has no front end in it and is not shippable; read
# its header before copying it.
CONFIG_HRM_SENSOR_EXAMPLE=y
```

## boards/nrf52840dk_nrf52840.conf
```kconfig
# nRF52840 DK, as a RadiANT heart-rate node.
#
# The other half of the overlay's `zephyr,entropy = &rng`. Choosing the RNG
# peripheral does not stop the CryptoCell entropy driver from being built: it
# instantiates a device for the (still enabled) cryptocell node whatever the
# chosen node is, and that device links CryptoCell's platform library (and
# NCS raises MAIN_STACK_SIZE to 2048 for it) for a driver nothing calls.
# Measured on this board, 2026-11-07: 6728 B of flash and 1937 B of RAM more
# than with this line. K_dev is drawn once in the life of the part (ADR 0020)
# and the RNG peripheral serves it.
CONFIG_ENTROPY_CC3XX=n
```

## boards/nrf52840dk_nrf52840.overlay
```dts
/*
 * nRF52840 DK, as a RadiANT heart-rate node.
 *
 * THE POINT OF THIS BOARD IS THAT IT IS NOT AN nRF54L. HRM_BLE_HRS ends up
 * compiled against radiant's nrf backend, whose `depends on` is
 * `SOC_COMPATIBLE_NRF52X || SOC_COMPATIBLE_NRF54LX` - and until this file
 * existed only the nRF54L half was ever built anywhere. The profile + node +
 * BLE + MPSL-gate combination had therefore never been compiled on an nRF52 at
 * all, on the family that most existing ANT+ silicon actually is.
 *
 * BUILD-VERIFIED ONLY. Nothing here has been on a bench. The two things a
 * bench would decide - whether TIMER4 stays uncontended once the SoftDevice
 * Controller is running, and whether the nRF52 t_sync calibration constants
 * hold - are both open; radiant/Kconfig's own help text says the nRF52840's
 * on-air behaviour is predicted from the nRF54L15 measurements and has not been
 * confirmed. Do not read a green build here as a working node.
 */

/ {
	chosen {
		/*
		 * The TIMER radiant's nrf backend owns outright. It runs at
		 * 1 MHz forever and is what t_sync is hardware-captured into
		 * from RADIO's ADDRESS event, so it cannot be shared: naming it
		 * here rather than in the source is what makes a second user a
		 * devicetree conflict instead of two drivers reprogramming each
		 * other's prescaler.
		 *
		 * TIMER4, and the choice is constrained from both ends. The
		 * backend needs FIVE compare/capture channels - t_sync capture,
		 * RX start, window close, software now-capture, TX start - and
		 * on nRF52 only TIMER3 and TIMER4 have more than four, which is
		 * a compile-time #error in radiant_radio_nrf.c rather than
		 * something to discover on the air.
		 *
		 * TIMER4 rather than TIMER3 to match apps/dongle's Feather and
		 * Dongle overlays, so that the nRF52 answer is one number
		 * across this repository rather than two. MPSL on nRF52 reserves
		 * TIMER0 (mpsl_hwres.h), not these.
		 */
		radiant,radio-timer = &timer4;

		/*
		 * The entropy source K_dev is drawn from on first boot (ADR
		 * 0020, CONFIG_RADIANT_SEC_RNG_ENTROPY). The SoC default is
		 * &cryptocell, whose entropy driver needs CryptoCell's
		 * platform library linked in for one 16-byte draw in the
		 * life of the part; the RNG peripheral is a TRNG of its own
		 * and its driver is a few hundred bytes. Bias correction is
		 * Zephyr's default for it (ENTROPY_NRF5_BIAS_CORRECTION).
		 */
		zephyr,entropy = &rng;
	};
};

&timer4 {
	status = "okay";
};
```

## boards/nrf54lm20dk_nrf54lm20a_cpuapp.overlay
```dts
/*
 * nRF54LM20A DK, as a RadiANT heart-rate node.
 *
 * The same family as the nRF54L15 and the same answer, which is why this file
 * is short: SOC_COMPATIBLE_NRF54LX covers both, the peripheral map is the same
 * shape, and TIMER20 is free on both. It earns its place by proving that the
 * family is a family - a second part in the same `depends on` arm - rather than
 * by exercising anything new.
 *
 * BUILD-VERIFIED ONLY, and there is no LM20 on this bench. See
 * apps/dongle/boards/nrf54lm20dk_nrf54lm20a_cpuapp.conf for what else about
 * this part is untested.
 */

/ {
	chosen {
		/*
		 * The TIMER the backend owns outright, hardware-capturing
		 * t_sync from RADIO's ADDRESS event. See the nRF54L15 DK
		 * overlay beside this one for the full reasoning, including
		 * P0's TIMER audit: mpsl.rst lists MPSL as owning TIMER10 and
		 * TIMER20 on nRF54L while mpsl_hwres.h reserves only TIMER10,
		 * and TIMER20 was measured not to collide - ON THE L15. That
		 * measurement has not been repeated on this part, so if a
		 * timeslot build here misbehaves, this is the first line to
		 * suspect and TIMER22 is the alternative that behaved
		 * identically on the L15.
		 */
		radiant,radio-timer = &timer20;
	};
};

&timer20 {
	status = "okay";
};
```

## src/hrm_ble.h
```c
/* SPDX-License-Identifier: Apache-2.0 */
#ifndef HRM_BLE_H_
#define HRM_BLE_H_

#include <stdbool.h>
#include <stdint.h>

/*
 * P8b: the SIG Heart Rate Service beside the ANT+ 0x78 master.
 *
 * Enables the controller and starts advertising; the beat work handler in
 * main.c notifies HRS at the same instants it advances the ANT+ accumulators,
 * so the two radios cannot disagree about the rate.
 *
 * Not Garmin-protocol-compatible and no running dynamics - this is the standard
 * SIG service only (not Garmin's proprietary Multi-Link/GFDI). See
 * docs/ble-running-dynamics-notes.md.
 */
int hrm_ble_start(void);

/*
 * True while a phone is connected. CONFIG_HRM_SUPPRESS_ANT_WHEN_CONNECTED reads
 * this to suppress the ANT+ duplicate broadcast. Exposed rather than acted on
 * internally, since stopping an ANT+ channel is the ANT+ side's business.
 */
bool hrm_ble_connected(void);

/* Push a heart rate to the SIG service. No-op when nothing is connected. */
void hrm_ble_notify_hr(uint8_t bpm);

#endif /* HRM_BLE_H_ */
```

## src/hrm_sensor_example.c
```c
/*
 * SPDX-License-Identifier: Apache-2.0
 *
 * CONFIG_HRM_SENSOR_EXAMPLE: the seam's SECOND implementation, written to be
 * read rather than to be shipped.
 *
 * WHY IT EXISTS AT ALL, AND WHY CI BUILDS IT. A seam with one implementation is
 * indistinguishable from a direct call with extra prototypes - it compiles, it
 * looks like an abstraction, and the first person to actually use it discovers
 * which parts of it were never exercised. This is the same argument
 * .github/workflows/release.yml already makes about encryption.conf, applied to
 * an API instead of a Kconfig fragment. The hrm_ble.custom / hrm_ble.example
 * rows in sample.yaml are what keep it honest.
 *
 * WHAT IT DEMONSTRATES, in the order a manufacturer will need it:
 *
 *   1. Registration from a SYS_INIT, before main() calls hrm_sensor_start().
 *   2. Reporting a beat FROM INTERRUPT CONTEXT. The k_timer handler here runs
 *      in the ISR that expires the timer, which is deliberately the same
 *      context an analogue front end's comparator interrupt has. It is the
 *      hard case, and the whole point of the seam being ISR-safe.
 *   3. Timestamping with hrm_sensor_now_1024() - the node's own 1/1024 s base,
 *      so no conversion and no second rounding rule sit between the detector
 *      and byte 4 of page 0x00.
 *   4. A `poll` that does the slow, level-valued work (here: nothing but a
 *      contact-state placeholder), which is what poll is FOR - never beats.
 *
 * WHAT IT IS NOT. There is no detector in it: it fires on a timer, so on the
 * air it is indistinguishable from the simulator. Substituting a timer for an
 * AFE is exactly the substitution a real port removes, and it is called out
 * here so that nobody reads this file as a working front end.
 */

#include <zephyr/kernel.h>
#include <zephyr/logging/log.h>
#include <zephyr/init.h>

#include "hrm_sensor.h"

LOG_MODULE_DECLARE(hrm, CONFIG_HRM_LOG_LEVEL);

static void beat_timer_fn(struct k_timer *t);
static K_TIMER_DEFINE(beat_timer, beat_timer_fn, NULL);

/*
 * ISR CONTEXT. Everything this handler is allowed to do is in
 * hrm_sensor_report_beat()'s contract: one atomic store and one
 * k_work_submit(). It must not touch profile_hr, must not call into the BLE
 * stack, and must not log at anything but the cheapest level - which is why it
 * does not log at all.
 */
static void beat_timer_fn(struct k_timer *t)
{
	ARG_UNUSED(t);

	/*
	 * A real driver passes the instant its hardware captured. This one has
	 * none, so it reads the node's clock at the moment of the edge - which
	 * is still strictly better than letting an application tick guess,
	 * because the ISR runs at the edge and the tick does not.
	 */
	hrm_sensor_report_beat(hrm_sensor_now_1024());
}

static int example_start(const struct hrm_sensor *sensor)
{
	const uint32_t bpm = CONFIG_HRM_SENSOR_SIM_BPM;
	const uint32_t interval_ms = (bpm != 0u) ? (60000u / bpm) : 1000u;

	ARG_UNUSED(sensor);

	/*
	 * The rate is reported once, from thread context, and then never again:
	 * a driver whose detector is the source of truth reports the EDGE and
	 * lets the receiver derive the rate from the accumulator pair. Byte 7 is
	 * a convenience beside that pair, not a substitute for it.
	 */
	hrm_sensor_report_rate((uint8_t)bpm);

	k_timer_start(&beat_timer, K_MSEC(interval_ms), K_MSEC(interval_ms));
	return 0;
}

static int example_stop(const struct hrm_sensor *sensor)
{
	ARG_UNUSED(sensor);
	k_timer_stop(&beat_timer);
	hrm_sensor_report_rate(0u); /* PROFILE_HR_INVALID_BPM: no reading. */
	return 0;
}

static void example_poll(const struct hrm_sensor *sensor)
{
	ARG_UNUSED(sensor);

	/*
	 * Runs on the node's 100 ms tick, in thread context. Contact detection,
	 * AGC and battery sampling belong here. Reporting a beat from here
	 * would not be a layering mistake so much as a measurement one: the
	 * beat would carry this tick's timestamp, and a receiver differencing
	 * event times would see the tick period instead of the beat interval.
	 * That is the 72-versus-66.7 bpm bug, re-created on purpose by a driver
	 * instead of by a scheduler.
	 */
}

static const struct hrm_sensor_api example_api = {
	.start = example_start,
	.stop = example_stop,
	.poll = example_poll,
};

static const struct hrm_sensor example_sensor = {
	.name = "example (timer-driven, no front end)",
	.api = &example_api,
};

static int example_register(void)
{
	int err = hrm_sensor_register(&example_sensor);

	if (err != 0) {
		LOG_ERR("hrm_sensor_example: register: %d", err);
	}
	return 0;
}

SYS_INIT(example_register, APPLICATION, CONFIG_APPLICATION_INIT_PRIORITY);
```
