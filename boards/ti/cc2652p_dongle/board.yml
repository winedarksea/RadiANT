## boards/ti/cc2652p_dongle/board.yml
```yaml
board:
  name: cc2652p_dongle
  full_name: CC2652P + CP2102N USB dongle
  vendor: ti
  socs:
  - name: cc2652p
```

## radiant/samples/hr_receiver/sample.yaml
```yaml
# SPDX-License-Identifier: Apache-2.0

sample:
  name: RadiANT heart-rate receiver
common:
  tags:
    - radiant
  build_only: true
tests:
  sample.radiant.hr_receiver:
    platform_allow:
      - native_sim
      - nrf52840dk/nrf52840
      - nrf54l15dk/nrf54l15/cpuapp
    integration_platforms:
      - native_sim
      - nrf52840dk/nrf52840
```

## radiant_core/src/node/Kconfig
```kconfig
# SPDX-License-Identifier: Apache-2.0
#
# The hostless node's identity, epoch and pairing scalar.
# docs/decisions/0009-hostless-node-identity.md.

menu "RadiANT node identity (hostless)"

config RADIANT_NODE_IDENT
	bool "hostless node identity, boot counter and node-side epoch"
	default n
	depends on RADIANT_SEC
	help
	  src/node/node_ident.c: the NVM monotonic boot counter that becomes
	  this node's epoch, K_dev and the Tier 0 device number derived from
	  it, and the deterministic pairing scalar
	  KDF(K_dev, "pair" || pair_counter).

	  FOR A NODE WITH NO HOST. A dongle behind a PC does not want this: its
	  epoch authority is the PC, over 0xF3, and its pairing scalar arrives
	  over 0xF5. A battery heart-rate strap has neither, which is the whole
	  of why this exists.

	  Depends on RADIANT_SEC because everything here derives keys with the
	  AES-CMAC KDF that symbol compiles, and hands the result to
	  radiant_sec_set_epoch(). It adds NO entry point to radiant_core - ADR
	  0009 decision 7 keeps the persistence in the application, and the
	  module still only ever receives an epoch through its existing API.

	  Selecting this requires a node_nvm.h backend. There is no default and
	  no RAM fallback: a volatile store here is a boot counter that restarts
	  at 1 on every power cycle, which is a replayed epoch and a repeated
	  pairing scalar arriving silently. A build with no backend fails to
	  link, which is the loudest available way to say so.

config RADIANT_NODE_NVM_SETTINGS
	bool "store the node's counters in the Zephyr settings subsystem"
	default y if RADIANT_NODE_IDENT
	depends on RADIANT_NODE_IDENT
	select SETTINGS
	select FLASH
	select FLASH_MAP
	select NVS
	help
	  src/node/node_nvm_settings.c: three records - two u32 counters and
	  K_dev - in the "radiant" settings subtree, over NVS in the board's
	  storage_partition. The standard Zephyr answer, chosen because this
	  repository had no persistence layer at all before this phase and a
	  private one for three records would be the worse mistake.

	  Turn it OFF to supply your own node_nvm.h implementation - a secure
	  element, which is where ADR 0009 says the counters belong on a part
	  that has one, or a test double. radiant_core/tests/fake_nvm.c is the
	  second implementation that keeps this a seam rather than a layer with
	  one caller.

	  REQUIRES A storage_partition IN THE BOARD'S DEVICETREE. NVS has
	  nowhere to go without one and the failure is at build time.

	  It selects NVS but NOT SETTINGS_NVS, and that is a Kconfig constraint
	  rather than an omission: the settings storage backend is a CHOICE, and
	  select has no effect on a choice symbol - Zephyr turns the attempt into
	  a hard error rather than ignoring it. With NVS enabled and no file
	  system in the build, SETTINGS_NVS is the choice's default and nothing
	  more is needed; an application that wants a different one sets it in
	  its own .conf, which is the only place a choice can be made.

endmenu
```

## sim/Kconfig
```kconfig
#
# ANT+ sensor simulator.
#
# One prefix for the whole application, ANT_SIM_*, the same way the dongle uses
# ANT_DONGLE_*. The two never build together, but a shared prefix would make a
# grep for "which application does this symbol belong to" ambiguous, and the
# answer to that question is how the sysbuild and CI assertions stay honest.
#

source "Kconfig.zephyr"

menuconfig ANT_SIM
	bool "ANT+ sensor simulator"
	select ANT
	select ANT_KEY_MANAGER
	select ANT_CHANNEL_CONFIG
	select ANT_STATE_INDICATOR
	select DK_LIBRARY
	default y
	help
	  Transmits as a realistic ANT+ sensor so a dongle can be tested
	  without owning one. Not a dongle build: this application has no USB
	  and no serial bridge.

if ANT_SIM

choice ANT_SIM_PROFILE
	prompt "Sensor profile to transmit"
	default ANT_SIM_PROFILE_BPWR_STANDARD

config ANT_SIM_PROFILE_BPWR_STANDARD
	bool "Bicycle power, standard power page 0x10"
	select ANT_BPWR
	help
	  The page every power meter emits. Instantaneous power, accumulated
	  power and cadence, one power event per message.

config ANT_SIM_PROFILE_BPWR_CRANK_TORQUE
	bool "Bicycle power, crank torque page 0x12"
	select ANT_BPWR
	help
	  Power carried as accumulated torque and accumulated crank period,
	  with one event per crank revolution rather than one per message. At
	  80 rpm that is roughly one message in three, which is the case a
	  receiver's delta arithmetic has to survive.

config ANT_SIM_PROFILE_BPWR_WHEEL_TORQUE
	bool "Bicycle power, wheel torque page 0x11"
	select ANT_BPWR
	help
	  The same arithmetic against wheel revolutions at road speed. Torque
	  is lower for the same power, so a receiver that confuses this page
	  with 0x12 is wrong by the gear ratio rather than obviously wrong.

config ANT_SIM_PROFILE_BSC_COMBINED
	bool "Combined speed and cadence, device type 0x79"
	select ANT_BSC
	help
	  Cadence event time and crank revolutions alongside speed event time
	  and wheel revolutions, in a page that carries no page number at all.

endchoice

menu "Signal"

config ANT_SIM_TARGET_WATTS
	int "Target power, watts"
	default 100
	range 0 2000
	help
	  Held, not swept. A receiver cannot be shown to be right about a value
	  that never settles, which is what the stock sdk-ant simulators
	  produce.

config ANT_SIM_TARGET_RPM
	int "Target cadence, rpm"
	default 80
	range 0 254
	help
	  254 is the maximum: 255 is the profile's "cadence not reported"
	  sentinel, and a target that reached it would turn cadence off rather
	  than report a very fast rider.

config ANT_SIM_WHEEL_RPM
	int "Wheel speed, rpm"
	default 238
	range 0 1000
	help
	  Used by the wheel torque page and by the speed half of the combined
	  page. 238 rpm is 30 km/h on a 2.105 m wheel.

config ANT_SIM_NOISE
	int "Noise band, plus or minus, on both signals"
	default 3
	help
	  Zero makes every delta identical, which hides an accumulator that is
	  recomputed from the target instead of accumulated.

config ANT_SIM_SEED
	int "Seed for the noise generator"
	default 1
	help
	  A run that cannot be replayed is not a measurement. Zero is accepted
	  and replaced internally, because xorshift is dead at zero.

endmenu

menu "Channel"

config ANT_SIM_CHANNEL_NUM
	int "ANT channel number"
	default 0

config ANT_SIM_NETWORK_NUM
	int "ANT+ network number"
	default 0

config ANT_SIM_DEVICE_NUMBER
	int "Channel ID: device number"
	default 14871
	range 1 65535
	help
	  Matches tools/ant_sim.py's default (0x3A17), so a capture from either
	  transmitter carries the same identity and the two are directly
	  comparable. Zero is excluded: on a channel ID it is the wildcard.

config ANT_SIM_TRANS_TYPE
	int "Channel ID: transmission type"
	default 5
	range 1 255
	help
	  5 throughout this project - tools/ant_sim.py, this application, and
	  the master path in zephyr_aerosense. The profile permits others; what
	  matters is that everything here picks the same one.

config ANT_SIM_RF_FREQ
	int "RF frequency, MHz above 2400"
	default 57
	range 0 124
	help
	  57 is 2457 MHz, the ANT+ public network frequency, and is the only
	  value at which this simulator is a valid ANT+ sensor. Leave it there
	  for any test of what a dongle will do in the field.

	  Change it only to answer one question: whether packet loss on the
	  bench is the radio environment or the boards. 2457 MHz is inside
	  Wi-Fi channel 11 and shared with every other ANT+ device in range,
	  so a run there measures the room as much as the dongle. Repeating a
	  run somewhere quiet - 2 or 78, either end of the band and clear of
	  Wi-Fi 1, 6 and 11 - separates the two. Loss that vanishes was the
	  room; loss that follows is worth chasing.

	  tools/ant_verify.py --rf-freq has to be given the same number, or
	  the two are not on the same channel and nothing is heard at all.

config ANT_SIM_TX_POWER
	int "Transmit power level"
	default 3
	range 0 5
	help
	  sdk-ant's levels: 0 is -20 dBm, 1 is -12, 2 is -4, 3 is 0 dBm and
	  the ANT default, 4 is +4 dBm. Level 5 (+8 dBm) exists only on the
	  nRF52820, nRF52833 and nRF52840 and is refused elsewhere.

	  Changing this does not measurably change packet loss, which was
	  worth finding out rather than assuming. Across 300 s runs at -12, 0
	  and +4 dBm - a 16 dB spread - loss stayed between 0.85 and 1.37 %,
	  which is the run-to-run spread of the 0 dBm setting on its own. Loss
	  that survives 16 dB is not a link-budget problem: it is other
	  traffic landing on top of a 150 us slot, and a slot that is occupied
	  is occupied at any power.

	  Those figures were taken before a host-side USB read timeout was
	  found to be inventing about 0.4 points of loss on every run, so they
	  are all too high by roughly the same amount - see the README. The
	  error is common to all three, so the comparison they were made for
	  survives it. The real floor on that bench is nearer 0.4 %.

	  There is now a number behind the reasoning rather than an argument.
	  ant_verify.py asks for RSSI and reports it: the two boards on a desk
	  sit near -28 dBm against a tracking threshold around -90, so there
	  is some 60 dB of margin and this knob spans 16. Loss measured within
	  one run went the wrong way against signal strength as the room
	  changed - more of it in the strongest stretch, none in the weakest -
	  which is not what running out of signal looks like.

	  So this is here to rule that out, not to tune it. A real power meter
	  runs at 0 dBm and a dongle has to work with one, which is what level
	  3 leaves you testing.

endmenu

menu "Product information"

config ANT_SIM_HW_VERSION
	int "Hardware revision"
	default 1
	range 0 255

config ANT_SIM_MFG_ID
	int "Manufacturer ID"
	default 255
	range 0 65535
	help
	  255 is the development manufacturer id. Borrowing a real one would
	  make this sensor claim to be somebody's product.

config ANT_SIM_MODEL_NUM
	int "Model number"
	default 1
	range 0 65535

config ANT_SIM_SW_VERSION
	int "Software version"
	default 1
	range 0 255

config ANT_SIM_SERIAL_NUM
	int "Serial number"
	default 5526867
	range 0 2147483647

config ANT_SIM_CALIBRATION_DATA
	int "Calibration data returned to a display that asks"
	default 21930
	range 0 65535

endmenu

endif # ANT_SIM
```

## src/profiles/Kconfig
```kconfig
# SPDX-License-Identifier: Apache-2.0
#
# The ANT+ compatibility profiles' policy settings.
# docs/radiant-security.md section 11.6 is the table these mirror.

menu "RadiANT profile policy"

choice
	prompt "enrol: how a new receiver gets this node's key"
	default RADIANT_ENROL_PHYSICAL
	help
	  Adding a receiver to an existing encrypted network. A user buys a
	  second head unit in March and has to be able to add it to a strap they
	  set up in January, without re-provisioning the first head unit and
	  without taking the strap apart.

	  Read this before choosing, because it is the whole trade: PAIRING
	  HAPPENS IN THE CLEAR. An active attacker present during the window can
	  be the man in the middle. The mitigation is a six-digit fingerprint a
	  human compares ACROSS TWO SCREENS - and a strap has no screen, so over
	  the air that comparison is one-sided. Out-of-band provisioning, a
	  printed key or a QR code, genuinely defeats the attack rather than
	  mitigating it, and it stays the recommended path for anything that
	  matters.

	  And the asymmetry nobody expects: RadiANT v1 can ADD a receiver in
	  sixty seconds and can REMOVE one only by re-provisioning the whole
	  network, because every keyholder holds the same root key. Per-receiver
	  revocation is out of scope. Read that sentence before choosing
	  open-window.

config RADIANT_ENROL_CLOSED
	bool "closed - no over-air enrolment, ever"
	help
	  Keys arrive only out of band: the host message set on a host-attached
	  node, or the manufacturer's provisioning path. There is no over-air
	  pairing window and no way to open one.

	  THIS IS THE RECOMMENDED SETTING FOR ANYTHING THAT MATTERS. No
	  protocol, no attack surface during pairing at all, and no dependence
	  on the user actually looking at a number. It is not the default only
	  because a sealed strap with no port has no path at all under it.

config RADIANT_ENROL_PHYSICAL
	bool "physical - a bounded window opened by a physical action (default)"
	help
	  A 60-second pairing window opened by a button, a magnet or a strap
	  re-seat at the node. One pairing per window, and a second press does
	  not extend the first.

	  The window opens on whichever channel the node is currently on - the
	  frames are additional pages, not a channel change - so every receiver
	  that is already listening keeps its stream throughout, and a node in
	  private mode does not have to leave it to gain a receiver.

	  The mitigations are the bounded window, one pairing per window, the
	  physical trigger, and optionally reduced transmit power so the
	  attacker has to be in the room. They are mitigations, not a fix: the
	  fingerprint is still one-sided on a device with no display.

config RADIANT_ENROL_OPEN_WINDOW
	bool "open-window - a keyholder may open a window with a command"
	help
	  A window a CURRENT KEYHOLDER opens with an authenticated command, for
	  a node with no button and no host. Rate-limited to one window every
	  five minutes and bounded to sixty seconds.

	  THIS IS THE WEAKEST OF THE THREE and it exists because a sealed strap
	  otherwise has no path at all. The authentication of the command is the
	  command layer's, not this module's: a node that opens a window on an
	  unverified command has built "anybody may enrol against me".

	  Combined with the paragraph above about removal - add in sixty
	  seconds, remove only by re-provisioning - this is the setting that
	  most deserves a second reading before a product ships with it.

endchoice

endmenu
```
