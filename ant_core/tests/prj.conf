## CMakeLists.txt
```
# SPDX-License-Identifier: Apache-2.0
#
# The ant_core unit-test application.
#
# This is a standalone Zephyr application, deliberately not a subdirectory of
# the dongle build: it never includes the top-level CMakeLists.txt, so it has
# no sdk-ant dependency of any kind and the CI job that runs it needs no
# secret. That is the whole point - native_sim does not build on Windows (no
# host C compiler, no QEMU), so every C assertion in this project executes
# only in CI on Linux, and it has to execute on forks and on every pull
# request or the parallel core work has no verification at all.

cmake_minimum_required(VERSION 3.20.0)

find_package(Zephyr REQUIRED HINTS $ENV{ZEPHYR_BASE})
project(ant_core_tests)

# ── Adding a test suite ─────────────────────────────────────────────────────
#
# Drop a .c file into src/ that declares its own ZTEST_SUITE(). Nothing else.
# The glob is CONFIGURE_DEPENDS, and twister configures from scratch on every
# run anyway, so a new file is picked up without editing this file. This is
# structured for a fan-out of parallel agents each owning one core module and
# one suite file: an explicit source list would make this file contested, and
# a contested file serialises the fan-out it exists to enable.
file(GLOB suite_sources CONFIGURE_DEPENDS "${CMAKE_CURRENT_SOURCE_DIR}/src/*.c")
target_sources(app PRIVATE ${suite_sources})

# ── The mock radio ──────────────────────────────────────────────────────────
#
# ant_core/tests/fake_radio.c implements ant_core/include/ant_radio_hal.h
# against no hardware, and is what makes six of the seven core agents able to
# work in parallel without a board. It is keystone K5 and is authored after
# K3 freezes the HAL header; the file present today is a placeholder that
# compiles to nothing so this slot exists before its owner arrives.
target_sources(app PRIVATE "${CMAKE_CURRENT_SOURCE_DIR}/fake_radio.c")

# ── The code under test ─────────────────────────────────────────────────────
#
# ant_core/include/ does not exist yet (keystone K3 authors it). CMake does
# not require an include directory to exist, so naming it now costs nothing
# and means the K3 header is on the search path the moment it lands.
target_include_directories(app PRIVATE "${CMAKE_CURRENT_SOURCE_DIR}/../include")

# This directory too, so a suite writes #include "fake_radio.h" rather than
# #include "../fake_radio.h". Suites live in src/ and the mock does not, so
# without this every suite author gets the relative path wrong exactly once.
target_include_directories(app PRIVATE "${CMAKE_CURRENT_SOURCE_DIR}")

# ../../src for ant_event.c only: its output format is struct antr_msg and
# antr_on_message() from src/ant_radio.h, which pulls in the generated
# src/ant_wire.h. Both are plain headers with no application dependency, so
# this does not drag the dongle build into the test build - the test app still
# never reads the root CMakeLists.txt, which is what keeps this job secret-free.
target_include_directories(app PRIVATE "${CMAKE_CURRENT_SOURCE_DIR}/../../src")

# Core module sources are added here as they are written, one line per module.
# They are listed explicitly rather than globbed, because a suite that silently
# stops linking the module it tests still passes, and an explicit list makes
# that a merge conflict instead.
#
# ant_api.c is deliberately absent: it is the integration layer that defines
# the antr_* entry points, and the module suites test the modules, not the
# forwarding. Adding it here would drag src/ant_radio.h's whole surface into a
# build that has no bridge to satisfy it.
set(ant_core_sources
  "${CMAKE_CURRENT_SOURCE_DIR}/../src/ant_frame.c"
  "${CMAKE_CURRENT_SOURCE_DIR}/../src/ant_sched.c"
  "${CMAKE_CURRENT_SOURCE_DIR}/../src/ant_channel.c"
  "${CMAKE_CURRENT_SOURCE_DIR}/../src/ant_search.c"
  "${CMAKE_CURRENT_SOURCE_DIR}/../src/ant_event.c"
  "${CMAKE_CURRENT_SOURCE_DIR}/../src/ant_ack.c"
  "${CMAKE_CURRENT_SOURCE_DIR}/../src/ant_burst.c"
)
if(ant_core_sources)
  target_sources(app PRIVATE ${ant_core_sources})
endif()
```

## prj.conf
```kconfig
# SPDX-License-Identifier: Apache-2.0
#
# Configuration for the ant_core unit-test application.
#
# ant_core is pure logic sitting on top of ant_radio_hal.h, and the tests
# drive it against ant_core/tests/fake_radio.c rather than a radio. So there
# is deliberately nothing here about clocks, USB or the ANT stack: anything
# that needs hardware belongs on the bench, not in this application.
#
# Keep this file minimal. Zephyr aborts the build on an assignment to an
# undefined Kconfig symbol, so every line added here is a way for one agent's
# convenience setting to break every other agent's tests.

CONFIG_ZTEST=y

# The suites build tables of frames and channel state on the stack, and on
# native_sim an overrun surfaces as a wrong answer rather than as a fault -
# which is the worst possible failure mode for a test harness.
CONFIG_MAIN_STACK_SIZE=4096
CONFIG_ZTEST_STACK_SIZE=4096
```

## src/main.c
```c
/*
 * SPDX-License-Identifier: Apache-2.0
 *
 * Provenance: original work. Nothing here derives from sdk-ant, from any
 * adopter-gated document, or from disassembly of libant.a.
 *
 * The harness suite for ant_core.
 *
 * These two tests are not placeholders and they are not smoke tests for
 * ztest. They assert the two host properties that every later suite silently
 * depends on, and that are genuinely capable of differing between the
 * native_sim host and the nRF52840/nRF54L target the code actually runs on.
 * If either one is wrong, the frame, channel and scheduler suites still pass
 * while proving nothing - which is the failure mode a test harness must not
 * have, because it is indistinguishable from success.
 *
 * Core module suites go in sibling files under this directory, each with its
 * own ZTEST_SUITE(). Nothing needs to be added to CMakeLists.txt.
 */

#include <stddef.h>
#include <stdint.h>
#include <string.h>

#include <zephyr/toolchain.h>
#include <zephyr/ztest.h>

ZTEST_SUITE(host_abi, NULL, NULL, NULL, NULL, NULL);

/*
 * ANT is little-endian on the wire - a 16-bit device number goes out low byte
 * first - and the encode/decode paths will be tested by comparing a struct's
 * bytes in memory against a captured frame. That comparison is only
 * meaningful if the test host orders bytes the way the target does.
 */
ZTEST(host_abi, test_host_is_little_endian)
{
	const uint16_t devnum = 0x1234U;
	static const uint8_t on_the_wire[] = { 0x34U, 0x12U };
	uint8_t bytes[sizeof(devnum)];

	zassert_equal(sizeof(uint8_t), 1U, "uint8_t is not one byte");
	zassert_equal(sizeof(devnum), sizeof(on_the_wire),
		      "uint16_t is not two bytes");

	memcpy(bytes, &devnum, sizeof(devnum));

	zassert_mem_equal(bytes, on_the_wire, sizeof(on_the_wire),
			  "host byte order differs from the target's; "
			  "byte-level frame tests on this host prove nothing");
}

/*
 * The frame layer describes on-air and host-serial frames as packed structs
 * overlaid on a byte buffer. A toolchain that ignored __packed would insert
 * padding, every field would read back correctly through the struct, and
 * every test would pass against a layout that no real receiver would accept.
 * So assert the attribute has an effect before relying on it.
 */
struct wire_layout_probe {
	uint8_t sync;
	uint16_t devnum;
	uint8_t checksum;
} __packed;

ZTEST(host_abi, test_packed_structs_have_no_padding)
{
	zassert_equal(sizeof(struct wire_layout_probe), 4U,
		      "__packed had no effect: struct is %zu bytes, expected 4",
		      sizeof(struct wire_layout_probe));
	zassert_equal(offsetof(struct wire_layout_probe, devnum), 1U,
		      "__packed struct field was aligned up");
	zassert_equal(offsetof(struct wire_layout_probe, checksum), 3U,
		      "__packed struct field was aligned up");
}
```
