## CMakeLists.txt
```
# SPDX-License-Identifier: Apache-2.0
#
# Provenance: clean-room. Standard Zephyr application boilerplate, plus the
# hal_ti module. Nothing here derives from sdk-ant.
#
# A standalone Zephyr application, not part of the dongle build, on the same
# terms as the five spikes beside it: outside the repo root CMakeLists.txt so
# that a spike can never be linked into a shipped image by accident, and so it
# can be built with a different board and a different Kconfig without
# perturbing anything else.
#
#   . .\scripts\env.ps1 -NcsVersion v3.4.0
#   .\scripts\fetch_hal_ti.ps1
#   Push-Location C:\ncs\v3.4.0
#   west -z C:\ncs\v3.4.0\zephyr build `
#        -s C:\Users\Colin\ant_dongle\radiant_core\spike\ti_phy `
#        -d C:\Users\Colin\ant_dongle\build\spike_ti_phy `
#        -b cc26x2r1_launchxl -p always `
#        -- -DEXTRA_ZEPHYR_MODULES=C:/ncs/v3.4.0/modules/hal/ti
#   Pop-Location
#   .\scripts\flash_ti.ps1 -HexPath build\spike_ti_phy\zephyr\zephyr.hex
#
# THE MODULE FLAG IS NOT OPTIONAL AND IS NOT A CONVENIENCE. NCS's west manifest
# filters hal_ti out of its import (see scripts/fetch_hal_ti.ps1), so a build
# without it fails at the first <ti/drivers/rf/RF.h>. That is the loud failure;
# it is mentioned here because the quiet one - a workspace where some OTHER
# hal_ti is on the path - would compile against a revision the rest of the SDK
# was never tested with.

cmake_minimum_required(VERSION 3.20.0)

find_package(Zephyr REQUIRED HINTS $ENV{ZEPHYR_BASE})
project(ant_spike_ti_phy)

target_sources(app PRIVATE
  src/main.c
  # Replaces zephyr/soc/ti/simplelink/cc13x2_cc26x2/power.c, which is NOT
  # compiled here because prj.conf sets CONFIG_POWEROFF=n. Read the header of
  # ti_power_shim.c before changing either: Zephyr's version installs a NULL
  # calibrateFxn that TI's Power driver dereferences unchecked, and this spike
  # measured the resulting branch to address 0 on the first RF_open().
  src/ti_power_shim.c
)

# ── Two hal_ti files this application has to compile for itself ─────────────
#
# hal_ti's own CMakeLists.txt compiles RFCC26X2_multiMode.c - the RF driver -
# unconditionally, and then gates the two things that driver cannot link
# without on Kconfig symbols belonging to OTHER drivers:
#
#   driverlib/rfc.c   "Required for RFCDoorbellSendTo which is not in ROM",
#                     compiled only under CONFIG_IEEE802154_CC13XX_CC26XX,
#                     ..._SUB_GHZ or CONFIG_BLE_CC13XX_CC26XX.
#   rf_patches/*.c    likewise, and only the multi-protocol and 802.15.4
#                     patches; rf_patch_cpe_prop.c is compiled by nothing at
#                     all.
#
# So an application that uses the RF driver WITHOUT being one of Zephyr's
# in-tree radio drivers links against a dozen undefined NOROM_RFC* symbols. It
# is a loud failure and it is at the link, which is the right place, but it
# reads as "hal_ti is broken" rather than "hal_ti assumes you are the 802.15.4
# driver" - hence this note.
#
# Adding the files here rather than patching hal_ti keeps the module a
# pristine checkout of the revision scripts/fetch_hal_ti.ps1 pins, which is the
# whole point of pinning it. radiant_core/CMakeLists.txt does the same thing
# for the cc26xx backend.
if(DEFINED ZEPHYR_HAL_TI_MODULE_DIR)
  set(HAL_TI_DIR "${ZEPHYR_HAL_TI_MODULE_DIR}")
elseif(DEFINED ZEPHYR_TI_MODULE_DIR)
  set(HAL_TI_DIR "${ZEPHYR_TI_MODULE_DIR}")
else()
  message(FATAL_ERROR
    "spike/ti_phy: no hal_ti module in this build.\n"
    "NCS's west manifest filters hal_ti out of its import, so it is never "
    "present unless it has been fetched deliberately:\n"
    "  .\\scripts\\fetch_hal_ti.ps1\n"
    "and then passed on the command line:\n"
    "  -DEXTRA_ZEPHYR_MODULES=C:/ncs/v3.4.0/modules/hal/ti")
endif()

set(HAL_TI_DEV "${HAL_TI_DIR}/simplelink/source/ti/devices/cc13x2_cc26x2")

target_sources(app PRIVATE
  ${HAL_TI_DEV}/driverlib/rfc.c
  ${HAL_TI_DEV}/rf_patches/rf_patch_cpe_prop.c
)

# D1's falsifier (docs/decisions/0015-cc26xx-coexistence-design.md): does the
# multi-protocol CPE patch alone degrade this PHY? -DSPIKE_TI_PHY_MULTI_PATCH=1
# swaps main.c's rf_mode to RF_MODE_MULTIPLE + rf_patch_cpe_multi_protocol.
if(SPIKE_TI_PHY_MULTI_PATCH)
  target_sources(app PRIVATE
    ${HAL_TI_DEV}/rf_patches/rf_patch_cpe_multi_protocol.c
  )
  target_compile_definitions(app PRIVATE SPIKE_TI_PHY_MULTI_PATCH=1)
endif()
```

## prj.conf
```kconfig
# SPDX-License-Identifier: Apache-2.0
#
# Provenance: clean-room. Zephyr Kconfig only; nothing here derives from
# sdk-ant.
#
# This spike owns the RF core outright, exactly as Spike A owns the nRF RADIO,
# and for the same reason: the whole question is whether the bare peripheral
# can be made to hear an ANT frame, so anything else that would want the radio
# has to be absent. On this part that means the IEEE 802.15.4 driver, which the
# board devicetree already disables (&radio and &ieee802154 are both
# status = "disabled" in cc26x2r1_launchxl.dts) - stated here as well so the
# answer does not depend on a board file somebody may fix.
#
# The console is the entire output of this program. It goes out uart0, which on
# this board is the XDS110 backchannel - one COM port over the same cable that
# programs it, with no adapter. NOTE THAT THIS IS THE OPPOSITE ARRANGEMENT TO
# THE DONGLE IMAGE, which reserves uart0 for the ANT serial protocol and sends
# its log to uart1 on BoosterPack pins. The difference is not an inconsistency:
# a spike has no ANT serial protocol to carry, so the one reachable port should
# carry the thing the spike exists to produce.

CONFIG_SERIAL=y
CONFIG_CONSOLE=y
CONFIG_UART_CONSOLE=y
CONFIG_PRINTK=y

# No logging subsystem. printk is synchronous, and the phases here print at
# human rates; deferred logging would add a way to lose the last lines of a
# phase to a wrapped buffer, which is the one output that matters when a phase
# fails.
CONFIG_LOG=n

# NOTHING TURNS THE RF DRIVER ON, and that is worth a line rather than a
# silence. hal_ti's own CMakeLists.txt compiles RFCC26X2_multiMode.c, the
# SimpleLink Power driver and the DPL shim whenever CONFIG_HAS_CC13X2_CC26X2_SDK
# is set, which the SoC's Kconfig sets as soon as the module is on the path. So
# there is no CONFIG_TI_RF to state and stating one would be an assignment to a
# symbol that does not exist - which Zephyr treats as fatal. What decides
# whether the driver is present is -DEXTRA_ZEPHYR_MODULES, in CMakeLists.txt.

# ── Why a spike about a radio turns POWEROFF OFF ────────────────────────────
#
# This started as CONFIG_POWEROFF=y and it was wrong, in a way that took a
# hardware run to see. Recorded in full because the reasoning that produced the
# =y is reasoning anyone would repeat.
#
# THE REASON FOR =y. It was never about powering anything off. The SimpleLink
# RF driver references PowerCC26X2_config, PowerCC26XX_schedulerDisable and
# PowerCC26XX_schedulerRestore and cannot link without them; all three live in
# soc/ti/simplelink/cc13x2_cc26x2/power.c, which that SoC's CMakeLists.txt
# compiles only under CONFIG_PM, CONFIG_PM_DEVICE or CONFIG_POWEROFF. POWEROFF
# was chosen over PM because PM additionally lets the idle thread put the part
# into STANDBY, which powers down the debug interface - a plausible way to lose
# both the RAT and the probe mid-measurement.
#
# WHY IT IS NOW =n. That file also sets
#
#     .calibrateFxn = NULL
#
# for any build that is not one of Zephyr's three in-tree radio drivers, and
# PowerCC26X2.c:1357 dereferences that pointer WITHOUT A NULL CHECK the first
# time anything requests XOSC_HF - which is the first RF_open(). The spike's
# first run on hardware faulted there, PC = 0x00000000. So dragging power.c in
# does not merely cost oscillator accuracy, as this file previously claimed and
# as README.md still needs correcting to say: it makes the radio unusable.
#
# With POWEROFF off, power.c is not compiled and src/ti_power_shim.c supplies
# those three symbols instead, with calibrateFxn pointing at
# PowerCC26XX_calibrate. Read that file's header before touching this line.
# STANDBY is not a risk either way, because CONFIG_PM stays off.
CONFIG_POWEROFF=n

# Nothing else may claim the RF core.
CONFIG_IEEE802154=n
CONFIG_NETWORKING=n
CONFIG_BT=n

CONFIG_MAIN_STACK_SIZE=4096
CONFIG_HEAP_MEM_POOL_SIZE=4096
CONFIG_CBPRINTF_FP_SUPPORT=n

# The RF driver posts commands and waits on them from a thread, and its
# callbacks run from a SWI. Neither is deep, but the default 1024 is tight for
# a callback that also formats a line of output.
CONFIG_ISR_STACK_SIZE=2048
CONFIG_SYSTEM_WORKQUEUE_STACK_SIZE=2048
```

## src/ti_power_shim.c
```c
/*
 * SPDX-License-Identifier: Apache-2.0
 *
 * Provenance: clean-room. This file's structure follows Zephyr's own
 * soc/ti/simplelink/cc13x2_cc26x2/power.c (Apache-2.0, Copyright (c) 2019
 * Linaro Limited), which it replaces; nothing here derives from sdk-ant.
 *
 * ---------------------------------------------------------------------------
 * WHY THIS FILE EXISTS: a NULL function pointer that Zephyr installs and TI's
 * driver dereferences without checking. Measured, not deduced - the spike
 * faulted here on its first run on 2026-08-13:
 *
 *     ***** USAGE FAULT *****
 *     Illegal use of the EPSR
 *     Faulting instruction address (r15/pc): 0x00000000
 *     r14/lr: 0x0000237d   -> switchXOSCHF, PowerCC26X2.c:1357
 *
 * PowerCC26X2.c:1357 is
 *
 *     readyToCal = (*(PowerCC26X2_config.calibrateFxn))(PowerCC26X2_INITIATE_CALIBRATE);
 *
 * with no NULL check, reached the first time anything asks for XOSC_HF - which
 * for this spike is the first RF_open(). And Zephyr's power.c sets
 *
 *     .calibrateFxn = NULL
 *
 * for every build that does not define CONFIG_IEEE802154_CC13XX_CC26XX,
 * CONFIG_BLE_CC13XX_CC26XX or CONFIG_IEEE802154_CC13XX_CC26XX_SUB_GHZ, under a
 * comment reading "disable oscillator calibration functionality for now".
 *
 * THE README FOR THIS SPIKE PREDICTED THIS DEFECT AND GOT ITS SEVERITY WRONG,
 * which is worth leaving on the record rather than quietly correcting. It said
 * an out-of-tree radio user "silently gets oscillator calibration disabled...
 * costs accuracy, not function, so nothing fails". It is not accuracy. The
 * three in-tree radio drivers are the only users Zephyr's power.c was written
 * for, and outside them the very first radio operation branches to address 0.
 *
 * WHY A REPLACEMENT RATHER THAN A PATCH. The three ways out, and why this one:
 *
 *   - Define one of those three Kconfig symbols. Each of them turns on a radio
 *     driver that claims the RF core, which is precisely what a PHY spike may
 *     not share. Rejected.
 *   - Patch modules/hal/ti or the Zephyr tree. Both are pinned checkouts that
 *     scripts/fetch_hal_ti.ps1 and west restore from upstream revisions; a
 *     local edit there is invisible to the repo and is undone by the next
 *     fetch. Rejected.
 *   - Do not compile Zephyr's power.c, and supply its symbols here. That is a
 *     Kconfig choice this project already owns - the file is compiled only
 *     under CONFIG_PM, CONFIG_PM_DEVICE or CONFIG_POWEROFF, and the spike had
 *     turned CONFIG_POWEROFF on for the sole purpose of dragging it in. So the
 *     fix is to turn that back off and provide the three symbols the RF driver
 *     actually needs, with calibrateFxn pointing somewhere.
 *
 * THIS IS P2's PROBLEM TOO. radiant_radio_cc26xx.c will need the same three
 * symbols by the same route; it is not spike scaffolding.
 * ---------------------------------------------------------------------------
 */

#include <zephyr/kernel.h>
#include <zephyr/init.h>

#include <driverlib/pwr_ctrl.h>
#include <driverlib/sys_ctrl.h>

#include <ti/drivers/Power.h>
#include <ti/drivers/power/PowerCC26X2.h>

/*
 * The radio variant of the configuration, which is what Zephyr installs for
 * its own three radio drivers and what this spike is.
 *
 * calibrateRCOSC_LF and _HF are true for the same reason the in-tree drivers
 * set them: with the RCOSCs uncalibrated the low-frequency clock is off by
 * enough to matter to a protocol whose whole timing budget is a 32.768 kHz
 * derived channel period, and this port exists to hit ANT's timing. Note that
 * the true/false here does NOT decide whether the pointer above is called -
 * PowerCC26X2.c calls it unconditionally and passes the request, and the
 * calibrate function itself consults these flags. Setting the flags false
 * while leaving the pointer NULL is the combination that faults.
 */
const PowerCC26X2_Config PowerCC26X2_config = {
	.policyInitFxn     = NULL,
	.policyFxn         = NULL,
	.calibrateFxn      = &PowerCC26XX_calibrate,
	.enablePolicy      = false,
	.calibrateRCOSC_LF = true,
	.calibrateRCOSC_HF = true,
};

/*
 * Both empty, and both must exist: the SimpleLink Power driver calls them
 * around Power_sleep() to keep its own RTOS's scheduler out of a critical
 * section. Zephyr's power.c leaves them empty with the note that its scheduler
 * cannot run there anyway because interrupts are disabled, which is equally
 * true here.
 */
void PowerCC26XX_schedulerDisable(void)
{
}

void PowerCC26XX_schedulerRestore(void)
{
}

static int ti_power_init(void)
{
	unsigned int key = irq_lock();

	Power_init();
	irq_unlock(key);

	return 0;
}

/*
 * Unlatch IO pins after a wake from shutdown. Carried over from Zephyr's
 * power.c rather than dropped: without it a board that was ever put into
 * shutdown comes back with its pads latched and its UART mute, which is a
 * failure that looks exactly like the one this spike is trying to diagnose.
 */
static int ti_unlatch_pins(void)
{
	if (SysCtrlResetSourceGet() == RSTSRC_WAKEUP_FROM_SHUTDOWN) {
		PowerCtrlPadSleepDisable();
	}

	return 0;
}

SYS_INIT(ti_power_init, POST_KERNEL, CONFIG_KERNEL_INIT_PRIORITY_DEFAULT);
SYS_INIT(ti_unlatch_pins, POST_KERNEL, CONFIG_APPLICATION_INIT_PRIORITY);
```
