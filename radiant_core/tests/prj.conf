## CMakeLists.txt
```
# SPDX-License-Identifier: Apache-2.0
#
# The radiant_core unit-test application.
#
# This is a standalone Zephyr application, deliberately not a subdirectory of
# the dongle build: it never includes the top-level CMakeLists.txt, so it has
# no sdk-ant dependency of any kind and the CI job that runs it needs no
# secret. That is the whole point - native_sim does not build on Windows (no
# host C compiler, no QEMU), so every C assertion in this project executes
# only in CI on Linux, and it has to execute on forks and on every pull
# request or the parallel core work has no verification at all.

cmake_minimum_required(VERSION 3.20.0)

# radiant_core is consumed here exactly as any third party would consume it:
# as a Zephyr module, before find_package(Zephyr), with CONFIG_RADIANT_CORE=y
# in prj.conf doing the selecting. This application therefore contains no
# application code of its own beyond the suites and the mock radio - which is
# what earns the module claim. It also means the module owns its source list
# and this file does not duplicate it; the duplicate that used to live here
# was one line per core module and a suite that silently stopped linking the
# module it tests still passes.
list(APPEND ZEPHYR_EXTRA_MODULES "${CMAKE_CURRENT_SOURCE_DIR}/..")

find_package(Zephyr REQUIRED HINTS $ENV{ZEPHYR_BASE})
project(radiant_core_tests)

# ── Adding a test suite ─────────────────────────────────────────────────────
#
# Drop a .c file into src/ that declares its own ZTEST_SUITE(). Nothing else.
# The glob is CONFIGURE_DEPENDS, and twister configures from scratch on every
# run anyway, so a new file is picked up without editing this file. This is
# structured for a fan-out of parallel agents each owning one core module and
# one suite file: an explicit source list would make this file contested, and
# a contested file serialises the fan-out it exists to enable.
file(GLOB suite_sources CONFIGURE_DEPENDS "${CMAKE_CURRENT_SOURCE_DIR}/src/*.c")
target_sources(app PRIVATE ${suite_sources})

# ── The mock radio ──────────────────────────────────────────────────────────
#
# radiant_core/tests/fake_radio.c implements
# radiant_core/include/radiant_core/radiant_radio_hal.h against no hardware,
# and is what makes six of the seven core agents able to work in parallel
# without a board. It is the HAL implementation for this image, which is why
# prj.conf selects CONFIG_RADIANT_CORE_BACKEND_NONE: the module compiles no
# backend of its own and this file is the one definition of the eight entry
# points.
target_sources(app PRIVATE "${CMAKE_CURRENT_SOURCE_DIR}/fake_radio.c")

# ── The mock NVM ────────────────────────────────────────────────────────────
#
# The same arrangement one layer up: fake_nvm.c implements src/node/node_nvm.h
# against RAM, so src/node/node_ident.c is compiled unmodified and the two
# things a real backend cannot be asked to do on demand - a power cycle and a
# write that fails - are callable from a suite.
#
# src/node/node_nvm_settings.c is deliberately NOT built here. It is the
# shipping backend (the settings subsystem over NVS) and it needs a storage
# partition this test application does not have; linking both would be a
# duplicate-symbol error, which is the same guard CONFIG_RADIANT_CORE_BACKEND_
# NONE provides for the radio.
target_sources(app PRIVATE "${CMAKE_CURRENT_SOURCE_DIR}/fake_nvm.c")

# ── src/profiles ────────────────────────────────────────────────────────────
#
# The RadiANT telemetry envelope (device type 0x60): docs/radiant-telemetry.md
# in code. Compiled into THIS APPLICATION rather than into the radiant_core
# module, and the directory boundary is the reason, not convenience:
# docs/decisions/0002-clean-room-policy.md draws its read-scope line at a path.
# radiant_core/** is strict clean-room; src/profiles/ is the pragmatic side,
# where an implementer may read a page-layout table. A profile encoder that
# linked into the link layer would erase that boundary, so it does not.
#
# (Phase E itself read no gated document at all - it is derived entirely from
# docs/radiant-telemetry.md, which is this project's own specification. The
# separation is structural, so that the next profile author inherits it.)
#
# Listed explicitly rather than globbed: unlike src/ above, this is a library
# and not a suite drop box, and a new file here is a deliberate act.
# profile_handoff.c and profile_schedule.c are the two files here that include a
# radiant_core header: the page codecs are pure, but applying a handoff means
# driving a channel and announcing a clock accuracy means widening one, and a
# format with no consumer would not have been worth specifying. The dependency
# still runs application -> core, which is the direction the module boundary
# permits: these files live inside radiant_core/src/profiles/ now (they used to
# reach here from outside the module entirely), but radiant_core's own
# CMakeLists.txt does not compile them into the module's library - only an
# application that lists them, as this one does, links them at all.
target_sources(app PRIVATE
  "${CMAKE_CURRENT_SOURCE_DIR}/../src/profiles/profile_bits.c"
  "${CMAKE_CURRENT_SOURCE_DIR}/../src/profiles/profile_telemetry.c"
  "${CMAKE_CURRENT_SOURCE_DIR}/../src/profiles/profile_sched.c"
  "${CMAKE_CURRENT_SOURCE_DIR}/../src/profiles/profile_handoff.c"
  "${CMAKE_CURRENT_SOURCE_DIR}/../src/profiles/profile_schedule.c"
  # The ANT+ compatibility profiles (compat-C5): heart rate 0x78 and bicycle
  # power 0x0B, the common pages they share, and the compat client that inserts
  # the RadiANT beacon and attestation pages through profile_sched.c's seam.
  #
  # profile_compat.c is the THIRD file here that includes a radiant_core header,
  # and it is the only one of the four that does. That is the boundary the phase
  # exists to draw: profile_hr.c and profile_power.c reach no radiant_core
  # header even transitively, so "the profile modules never call radiant_sec" is
  # a property of the include graph rather than a rule somebody remembers.
  "${CMAKE_CURRENT_SOURCE_DIR}/../src/profiles/profile_common.c"
  "${CMAKE_CURRENT_SOURCE_DIR}/../src/profiles/profile_compat.c"
  "${CMAKE_CURRENT_SOURCE_DIR}/../src/profiles/profile_hr.c"
  "${CMAKE_CURRENT_SOURCE_DIR}/../src/profiles/profile_power.c"
  "${CMAKE_CURRENT_SOURCE_DIR}/../src/profiles/profile_tracker.c"
  "${CMAKE_CURRENT_SOURCE_DIR}/../src/profiles/profile_controls.c"
  # Running dynamics. Listed here for the same reason as its two neighbours -
  # src/test_profile_rd.c is in this application's test sources, so leaving the
  # implementation out is a link error, not a missing test. It was exactly that
  # for a while: the RD phase added the decoder, the adapter in src/bridge and
  # the test, and the adapter's own CMake entry below, but never this line.
  "${CMAKE_CURRENT_SOURCE_DIR}/../src/profiles/profile_rd.c"
  # Layer D (compat-C7): the over-air enrolment window. The FOURTH file here
  # that includes a radiant_core header, and the second that has to - adding a
  # keyholder is a key operation. It names no page number and no frame index,
  # so the boundary profile_compat.c draws is not widened by it.
  "${CMAKE_CURRENT_SOURCE_DIR}/../src/profiles/profile_enrol.c"
  # Layer C (compat-C8): the private-mode switch. The FIFTH file here that
  # includes a radiant_core header and the third that has to - deriving the
  # locator needs K_id and verifying a command needs K_cmd, and both live where
  # the root key does. It names no page number of its own: the announcement is
  # two frames of the beacon page's set, which profile_compat.h already owns.
  "${CMAKE_CURRENT_SOURCE_DIR}/../src/profiles/profile_private.c"
  # Adaptive frequency (RF-7): choosing a quieter RF index from the
  # channel-quality map, and announcing the move on page 0x13 before it happens.
  # The SIXTH file here that includes a radiant_core header and the fourth that
  # has to - it reads radiant_chanmap.h, which is the map ADR 0012 selects from,
  # and radiant_radio_hal.h for the index range. It reaches no scheduler and no
  # search header on purpose: "discovery never moves" is a property of the
  # include graph here, not a rule somebody remembers.
  "${CMAKE_CURRENT_SOURCE_DIR}/../src/profiles/profile_freq.c"
  # Response slots and the reliable-command state machine (RF-8): section 9's
  # idempotency rule, the inline tag at both widths, and the downlink window
  # profile_schedule.c has been announcing since RF-5a. The SEVENTH file here
  # that includes a radiant_core header and the fifth that has to - verifying a
  # command needs a key, and arming a listen slot needs the scheduler. It adds
  # no slot kind to radiant_sched.c and reaches no search header: a response
  # slot is an ordinary bounded receive window, which is the claim
  # test_command.c exists to keep honest.
  "${CMAKE_CURRENT_SOURCE_DIR}/../src/profiles/profile_command.c"
)
target_include_directories(app PRIVATE
  "${CMAKE_CURRENT_SOURCE_DIR}/../src/profiles")

# ── radiant_core/src/bridge ──────────────────────────────────────────────────
#
# The sample bus and sink registry (P5 of the multiprotocol plan; see
# docs/radiant-bridge.md sections 3-4). Reaches no radiant_core header, same
# claim radiant_core/src/profiles/profile_hr.c makes about itself - this is
# the layer above the profile decoder, and section 2's amended rule 3 draws
# the line there.
target_sources(app PRIVATE
  "${CMAKE_CURRENT_SOURCE_DIR}/../src/bridge/radiant_bridge.c"
  "${CMAKE_CURRENT_SOURCE_DIR}/../src/bridge/radiant_hr_adapter.c"
  # The running-dynamics adapter. It includes src/profiles/profile_rd.h for the
  # two page decoders rather than re-deriving the bit splits, which is why the
  # src/profiles include directory above is not optional for this file.
  "${CMAKE_CURRENT_SOURCE_DIR}/../src/bridge/radiant_rd_adapter.c"
  # P6: the binding table (section 5) and the rule evaluator (section 6.1/6.2).
  # radiant_rules.c registers itself as an ordinary RADIANT_SINK_DEFINE()
  # sink, so it needs nothing from CMake beyond being compiled and linked -
  # the ITERABLE_SECTION_ROM(radiant_sink, ...) fragment below already covers
  # every sink in this application, this one included.
  "${CMAKE_CURRENT_SOURCE_DIR}/../src/bridge/radiant_binding.c"
  "${CMAKE_CURRENT_SOURCE_DIR}/../src/bridge/radiant_rules.c"
  # P7: the Matter plane's type map and endpoint model (section 8.1). Another
  # ordinary sink, and deliberately NOT the Matter stack - see the header.
  "${CMAKE_CURRENT_SOURCE_DIR}/../src/bridge/radiant_matter.c"
)
target_include_directories(app PRIVATE
  "${CMAKE_CURRENT_SOURCE_DIR}/../src/bridge")
# The linker fragment RADIANT_SINK_DEFINE()'s STRUCT_SECTION_ITERABLE needs -
# see the comment in radiant_bridge_sections.ld for why this is not optional.
zephyr_linker_sources(SECTIONS "${CMAKE_CURRENT_SOURCE_DIR}/../src/bridge/radiant_bridge_sections.ld")

# ── radiant_core/src/node ────────────────────────────────────────────────────
#
# The hostless node's identity, epoch and pairing scalar (compat-C6):
# docs/decisions/0009-hostless-node-identity.md in code.
#
# Not part of radiant_core's own library, for the reason the ADR gives in its
# decision 7, not for convenience: radiant_core is TOLD an epoch and refuses
# one that has not advanced, and putting the persistence inside its library
# would hand every consumer of the module a flash dependency and a storage
# backend to serve one class of node. So the dependency still runs
# application -> core, the same direction as before this directory moved
# inside radiant_core/src/ - only an application that lists node_ident.c
# itself, as this one does, links it. There is no new core entry point for a
# node-derived epoch: node_ident.c calls radiant_sec_set_epoch(), which is the
# same function the host adapter calls with a host-supplied value.
target_sources(app PRIVATE
  "${CMAKE_CURRENT_SOURCE_DIR}/../src/node/node_ident.c"
)
target_include_directories(app PRIVATE
  "${CMAKE_CURRENT_SOURCE_DIR}/../src/node")

# This directory, so a suite writes #include "fake_radio.h" rather than
# #include "../fake_radio.h". Suites live in src/ and the mock does not, so
# without this every suite author gets the relative path wrong exactly once.
#
# Nothing else is needed: the module's own zephyr_include_directories() puts
# radiant_core/include - and only that, now - on the search path for this
# target too. There used to be a second entry, ../src, for src/ant_radio.h and
# the generated src/ant_wire.h; radiant_event.c reads radiant_msg.h and
# radiant_wire.h instead now, both inside radiant_core/include, so no suite
# here has ever needed the application's src/ at all.
target_include_directories(app PRIVATE "${CMAKE_CURRENT_SOURCE_DIR}")
```

## prj.conf
```kconfig
# SPDX-License-Identifier: Apache-2.0
#
# Configuration for the radiant_core unit-test application.
#
# radiant_core is pure logic sitting on top of radiant_radio_hal.h, and the
# tests drive it against radiant_core/tests/fake_radio.c rather than a radio.
# So there is deliberately nothing here about clocks, USB or the ANT stack:
# anything that needs hardware belongs on the bench, not in this application.
#
# Keep this file minimal. Zephyr aborts the build on an assignment to an
# undefined Kconfig symbol, so every line added here is a way for one agent's
# convenience setting to break every other agent's tests.

CONFIG_ZTEST=y

# The module under test, consumed as a module. BACKEND_NONE because
# fake_radio.c in this directory is the HAL implementation for this image, and
# a second one would be a duplicate-symbol link error. The antr_* adapter
# (src/ant_radio_radiant.c, application-side since it moved out of the module)
# is never part of this build at all now - there is no CONFIG_RADIANT_CORE_ANTR_API
# to turn off here any more, because there is no application Kconfig tree in
# this application to declare it in the first place, matching the reasoning
# the old =n line gave: the suites test the modules, not the forwarding onto
# src/ant_radio.h.
CONFIG_RADIANT_CORE=y
CONFIG_RADIANT_CORE_BACKEND_NONE=y

# The crypto primitives. On here and off in every product build: the feature's
# governing constraint is that it costs nothing to the overwhelming majority
# who never enable it, so src/radiant_sec_aes.c is Kconfig-gated rather than
# compiled unconditionally the way radiant_crc_repair.c is. This is the door a
# real application uses, and the suite goes through it rather than around it.
#
# No CONFIG_RADIANT_SEC_HOST_MESSAGES line: like RADIANT_CORE_ANTR_API above,
# that symbol now lives in src/Kconfig.antr_api, an application-side fragment
# this module-only application never sources - so src/ant_sec_host.c, the host
# adapter that is the one security file reaching an application header, is
# never reachable from here at all, the same way it was meant to stay off.
CONFIG_RADIANT_SEC=y

# Energy detect and the channel-quality map (RF-4). Through the same door a
# bench build uses, and for the same reason CONFIG_RADIANT_SEC is on here:
# without it src/test_ed.c compiles against the header's disabled inlines,
# every map read returns false, and the suite reports a pass for having
# asserted nothing. The scheduler's SLOT_ED branches fold away against a
# compile-time zero, so this is also the only configuration in which the
# phase's own gate - the tracked schedule being identical with ED on - is a
# comparison rather than a tautology.
CONFIG_RADIANT_CORE_ED_SCAN=y

# The compat attestation primitives, for the same reason and through the same
# door. Nothing in radiant_core calls them yet - src/test_sec_compat.c is their
# only caller anywhere - so without this line the suite would link against the
# header's disabled inlines and assert ENOTSUP at every call site while
# reporting a pass.
CONFIG_RADIANT_SEC_COMPAT=y

# Four compat contexts rather than the default two, because compat-C8's gate is
# a NODE PLUS THREE KEYED RECEIVERS: the one that sent the switch command and
# two that did not. Three is the smallest number that can catch the failure the
# private-mode switch is most likely to ship with - a handover that is clean for
# the receiver which asked and a dropout for every other one - and a bench with
# one head unit cannot see it at all.
#
# 672 bytes each, and nothing else changes: the default of two is sized for a
# node, and this image is a room.
CONFIG_RADIANT_SEC_COMPAT_MAX_CHANNELS=4

# X25519 and the pairing state machine (compat-C7).
#
# It WAS a twister-only scenario (testcase.yaml's radiant_core.unit.pairing),
# and that meant every pairing assertion in this repository - test_sec_pair.c,
# test_sec_x25519.c, node_ident.c's window and now the whole of Layer D -
# compiled to nothing in the run the hardware gate actually performs
# (scripts/run_ztest_hw.ps1 builds this prj.conf and nothing else). A suite that
# is empty on the gate that must pass is a suite that reports a pass for having
# said nothing, which is the exact failure mode ANTR_API=n's comment above
# exists to prevent.
#
# The cost is the software ladder, and it is bounded: test_sec_x25519.c pins one
# X25519 at under 250 ms and the whole of pairing across this application is
# tens of ladders, against the gate's 240-second ceiling.
CONFIG_RADIANT_SEC_PAIRING_X25519=y

# The suites build tables of frames and channel state on the stack, and on
# native_sim an overrun surfaces as a wrong answer rather than as a fault -
# which is the worst possible failure mode for a test harness.
CONFIG_MAIN_STACK_SIZE=4096
CONFIG_ZTEST_STACK_SIZE=4096
```

## src/main.c
```c
/*
 * SPDX-License-Identifier: Apache-2.0
 *
 * Provenance: original work. Nothing here derives from sdk-ant, from an
 * ANT+ device profile document, or from disassembly of libant.a.
 *
 * The harness suite for radiant_core.
 *
 * These two tests assert host properties every later suite depends on but
 * that can differ between native_sim and the nRF52840/nRF54L target: if
 * either is wrong, the frame/channel/scheduler suites pass while proving
 * nothing.
 *
 * Core module suites go in sibling files under this directory, each with its
 * own ZTEST_SUITE(). Nothing needs to be added to CMakeLists.txt.
 */

#include <stddef.h>
#include <stdint.h>
#include <string.h>

#include <zephyr/toolchain.h>
#include <zephyr/ztest.h>

ZTEST_SUITE(host_abi, NULL, NULL, NULL, NULL, NULL);

/* ANT is little-endian on the wire; frame tests compare struct bytes in
 * memory against a captured frame, which is only meaningful if the host
 * orders bytes the way the target does. */
ZTEST(host_abi, test_host_is_little_endian)
{
	const uint16_t devnum = 0x1234U;
	static const uint8_t on_the_wire[] = { 0x34U, 0x12U };
	uint8_t bytes[sizeof(devnum)];

	zassert_equal(sizeof(uint8_t), 1U, "uint8_t is not one byte");
	zassert_equal(sizeof(devnum), sizeof(on_the_wire),
		      "uint16_t is not two bytes");

	memcpy(bytes, &devnum, sizeof(devnum));

	zassert_mem_equal(bytes, on_the_wire, sizeof(on_the_wire),
			  "host byte order differs from the target's; "
			  "byte-level frame tests on this host prove nothing");
}

/* The frame layer overlays packed structs on a byte buffer; a toolchain that
 * ignored __packed would insert padding and every test would silently pass
 * against a layout no real receiver would accept. */
struct wire_layout_probe {
	uint8_t sync;
	uint16_t devnum;
	uint8_t checksum;
} __packed;

ZTEST(host_abi, test_packed_structs_have_no_padding)
{
	zassert_equal(sizeof(struct wire_layout_probe), 4U,
		      "__packed had no effect: struct is %zu bytes, expected 4",
		      sizeof(struct wire_layout_probe));
	zassert_equal(offsetof(struct wire_layout_probe, devnum), 1U,
		      "__packed struct field was aligned up");
	zassert_equal(offsetof(struct wire_layout_probe, checksum), 3U,
		      "__packed struct field was aligned up");
}
```

## src/sec_modes_backend.c
```c
/* SPDX-License-Identifier: Apache-2.0 */
/*
 * A mode-level crypto backend, for the seam and not for a product.
 *
 * radiant_sec.h claims a two-level seam: policy calls modes, modes call
 * blocks, and a backend implements whichever level it can do well. This file
 * proves the seam is live: CONFIG_RADIANT_SEC_BACKEND_MODES suppresses the
 * portable AES-CTR/CMAC layer in src/radiant_sec_aes.c, and this supplies the
 * Level 2 entry points and radiant_sec_caps() (has_ctr/has_cmac) instead, as
 * a CRACEN or CC310 backend would. The same published vectors run against it.
 * If policy ever reaches past Level 2 to radiant_sec_aes_ecb() directly, the
 * vectors would still pass, so the zero-cost job also greps radiant_sec.c for
 * that call.
 *
 * The CMAC here buffers differently from the portable one (eager, one-block
 * lookahead, vs. holding a full block back) so running RFC 4493 vectors
 * through both is a real cross-check, not just a memcpy check - the
 * message-length-multiple-of-16 case is where the two strategies diverge.
 * The block primitive is shared since there is only one AES to test.
 */

#ifdef CONFIG_RADIANT_SEC_BACKEND_MODES

#include <string.h>

#include <radiant_core/radiant_sec.h>

static const struct radiant_sec_caps modes_caps = {
	.name          = "test-modes",
	.has_ctr       = true,
	.has_cmac      = true,
	.has_x25519    = false,
	/* Stated rather than left to the zero-initialiser, so the next person
	 * to copy this struct sees the field. */
	.has_rng       = false,
	.key_is_opaque = false,
	.key_bits_mask = RADIANT_SEC_KEY_BITS_128,
	.block_us      = 0,
};

const struct radiant_sec_caps *radiant_sec_caps(void)
{
	return &modes_caps;
}

static void counter_inc(uint8_t c[16])
{
	unsigned i;

	for (i = 16; i-- > 0;) {
		c[i]++;
		if (c[i] != 0u) {
			return;
		}
	}
}

int radiant_sec_ctr_xor(const struct radiant_sec_key *k, const uint8_t iv[16],
			uint8_t *buf, size_t len)
{
	uint8_t counter[16];
	uint8_t stream[16];
	size_t done = 0;

	if (iv == NULL || (buf == NULL && len != 0u)) {
		return RADIANT_SEC_EINVAL;
	}
	memcpy(counter, iv, sizeof(counter));

	while (done < len) {
		size_t i;
		size_t chunk = len - done;
		int rc = radiant_sec_aes_ecb(k, counter, stream);

		if (rc != RADIANT_SEC_OK) {
			return rc;
		}
		if (chunk > 16u) {
			chunk = 16u;
		}
		for (i = 0; i < chunk; i++) {
			buf[done + i] ^= stream[i];
		}
		done += chunk;
		counter_inc(counter);
	}

	memset(stream, 0, sizeof(stream));
	return RADIANT_SEC_OK;
}

static void dbl_block(uint8_t v[16])
{
	unsigned i;
	uint8_t carry = (uint8_t)(v[0] >> 7);

	for (i = 0; i < 15; i++) {
		v[i] = (uint8_t)((v[i] << 1) | (v[i + 1] >> 7));
	}
	v[15] = (uint8_t)((v[15] << 1) ^ (0x87u * carry));
}

int radiant_sec_cmac_init(struct radiant_sec_cmac_ctx *c,
			  const struct radiant_sec_key *k)
{
	if (c == NULL) {
		return RADIANT_SEC_EINVAL;
	}
	if (k == NULL || k->bits == 0u || k->serial == 0u) {
		return RADIANT_SEC_ENOKEY;
	}
	memset(c, 0, sizeof(*c));
	c->key = k;
	c->started = 1u;
	return RADIANT_SEC_OK;
}

/* Eager buffering with a one-block lookahead: `partial` holds a block
 * accepted but not yet folded in, since it might be the last one.
 * partial_len == 16 means "a full block is pending". */
int radiant_sec_cmac_update(struct radiant_sec_cmac_ctx *c, const uint8_t *msg,
			    size_t len)
{
	if (c == NULL || c->started == 0u) {
		return RADIANT_SEC_EINVAL;
	}
	if (len == 0u) {
		return RADIANT_SEC_OK;
	}
	if (msg == NULL) {
		return RADIANT_SEC_EINVAL;
	}

	while (len != 0u) {
		size_t room;
		size_t take;

		if (c->partial_len == 16u) {
			unsigned i;
			int rc;

			for (i = 0; i < 16; i++) {
				c->chain[i] ^= c->partial[i];
			}
			rc = radiant_sec_aes_ecb(c->key, c->chain, c->chain);
			if (rc != RADIANT_SEC_OK) {
				return rc;
			}
			c->partial_len = 0u;
		}

		room = 16u - c->partial_len;
		take = (len < room) ? len : room;
		memcpy(c->partial + c->partial_len, msg, take);
		c->partial_len = (uint8_t)(c->partial_len + take);
		msg += take;
		len -= take;
	}
	return RADIANT_SEC_OK;
}

int radiant_sec_cmac_final(struct radiant_sec_cmac_ctx *c, uint8_t tag[16])
{
	static const uint8_t zero[16] = { 0 };
	uint8_t sub[16];
	uint8_t last[16];
	unsigned i;
	int rc;

	if (c == NULL || c->started == 0u || tag == NULL) {
		return RADIANT_SEC_EINVAL;
	}

	rc = radiant_sec_aes_ecb(c->key, zero, sub);
	if (rc != RADIANT_SEC_OK) {
		return rc;
	}
	dbl_block(sub);                    /* K1 */
	if (c->partial_len != 16u) {
		dbl_block(sub);            /* K2 */
	}

	memcpy(last, c->partial, c->partial_len);
	if (c->partial_len != 16u) {
		last[c->partial_len] = 0x80u;
		for (i = (unsigned)c->partial_len + 1u; i < 16u; i++) {
			last[i] = 0u;
		}
	}
	for (i = 0; i < 16; i++) {
		last[i] ^= sub[i] ^ c->chain[i];
	}

	rc = radiant_sec_aes_ecb(c->key, last, tag);

	memset(c, 0, sizeof(*c));
	memset(sub, 0, sizeof(sub));
	memset(last, 0, sizeof(last));
	return rc;
}

int radiant_sec_cmac(const struct radiant_sec_key *k, const uint8_t *msg,
		     size_t len, uint8_t tag[16])
{
	struct radiant_sec_cmac_ctx c;
	int rc = radiant_sec_cmac_init(&c, k);

	if (rc != RADIANT_SEC_OK) {
		return rc;
	}
	rc = radiant_sec_cmac_update(&c, msg, len);
	if (rc != RADIANT_SEC_OK) {
		return rc;
	}
	return radiant_sec_cmac_final(&c, tag);
}

#endif /* CONFIG_RADIANT_SEC_BACKEND_MODES */
```

## src/test_binding.c
```c
/*
 * SPDX-License-Identifier: Apache-2.0
 *
 * Provenance: original clean-room work, against radiant_binding.h/.c, itself
 * a transcription of docs/radiant-bridge.md section 5.
 *
 * Covers: bind is idempotent by key; -ENOSPC only for a new key on a full
 * table, an existing key still resolves; uuid is nonzero and differs per
 * binding; unbind-then-rebind of the same key is a new identity (re-pair is
 * a user action, not automatic reconciliation).
 */

#include <errno.h>
#include <stdint.h>

#include <zephyr/toolchain.h>
#include <zephyr/ztest.h>

#include "radiant_binding.h"

static void binding_reset(void *unused)
{
	ARG_UNUSED(unused);
	radiant_binding_init();
}

ZTEST(radiant_binding, test_bind_is_idempotent_by_key)
{
	uint32_t s1, s2;

	zassert_equal(radiant_binding_bind(1234u, 0x78u, 1u, "strap", &s1), 0, NULL);
	zassert_equal(radiant_binding_bind(1234u, 0x78u, 1u, "strap", &s2), 0, NULL);
	zassert_equal(s1, s2, "same key must resolve to the same source");
}

ZTEST(radiant_binding, test_different_keys_get_different_sources)
{
	uint32_t s1, s2;

	zassert_equal(radiant_binding_bind(1u, 0x78u, 1u, NULL, &s1), 0, NULL);
	zassert_equal(radiant_binding_bind(2u, 0x78u, 1u, NULL, &s2), 0, NULL);
	zassert_not_equal(s1, s2, NULL);

	zassert_equal(radiant_binding_find(1u, 0x78u, 1u), s1, NULL);
	zassert_equal(radiant_binding_find(2u, 0x78u, 1u), s2, NULL);
	zassert_equal(radiant_binding_find(3u, 0x78u, 1u), RADIANT_BINDING_NONE, NULL);
}

ZTEST(radiant_binding, test_table_full_refuses_new_key_not_existing_one)
{
	uint32_t sources[RADIANT_BINDING_MAX];
	uint32_t extra;
	int      rc;
	uint32_t i;

	for (i = 0u; i < RADIANT_BINDING_MAX; i++) {
		rc = radiant_binding_bind((uint16_t)(100u + i), 0x78u, 1u, NULL,
					  &sources[i]);
		zassert_equal(rc, 0, "table is not yet full at slot %u", i);
	}

	rc = radiant_binding_bind(9999u, 0x78u, 1u, NULL, &extra);
	zassert_equal(rc, -ENOSPC, "table is full: a new key must be refused");

	/* An EXISTING key still resolves - fullness must not break lookups
	 * of what is already bound. */
	rc = radiant_binding_bind(100u, 0x78u, 1u, NULL, &extra);
	zassert_equal(rc, 0, "an existing binding must resolve even when full");
	zassert_equal(extra, sources[0], NULL);
}

ZTEST(radiant_binding, test_uuid_is_nonzero_and_differs_across_bindings)
{
	uint32_t s1, s2;
	const struct radiant_binding *b1, *b2;

	radiant_binding_bind(1u, 0x78u, 1u, NULL, &s1);
	radiant_binding_bind(2u, 0x78u, 1u, NULL, &s2);

	b1 = radiant_binding_get(s1);
	b2 = radiant_binding_get(s2);

	zassert_not_null(b1, NULL);
	zassert_not_null(b2, NULL);
	zassert_not_equal(b1->uuid, 0u, "a real binding must have a nonzero uuid");
	zassert_not_equal(b1->uuid, b2->uuid,
		       "two different bindings must not share a uuid");
}

ZTEST(radiant_binding, test_unbind_then_rebind_is_a_new_identity)
{
	uint32_t source, rebound;
	uint64_t first_uuid;
	const struct radiant_binding *b;

	radiant_binding_bind(42u, 0x78u, 1u, "old strap", &source);
	b = radiant_binding_get(source);
	first_uuid = b->uuid;

	zassert_equal(radiant_binding_unbind(source), 0, NULL);
	zassert_is_null(radiant_binding_get(source),
			"an unbound slot must not answer get()");

	zassert_equal(radiant_binding_bind(42u, 0x78u, 1u, "new strap", &rebound), 0,
		     NULL);
	b = radiant_binding_get(rebound);
	zassert_not_equal(b->uuid, first_uuid,
		       "re-pairing the same key must not silently inherit the old uuid");
}

static void *binding_setup(void)
{
	return NULL;
}

ZTEST_SUITE(radiant_binding, NULL, binding_setup, binding_reset, NULL, NULL);
```

## src/test_bridge.c
```c
/*
 * SPDX-License-Identifier: Apache-2.0
 *
 * Provenance: original clean-room work, against radiant_bridge.h/.c and
 * radiant_hr_adapter.h/.c, which are themselves transcriptions of
 * docs/radiant-bridge.md sections 3-4. Nothing here derives from sdk-ant.
 *
 * ---------------------------------------------------------------------------
 * Tests for the sample bus, the sink registry, and the ANT+ HR adapter
 * ---------------------------------------------------------------------------
 * Five things earn their place:
 *
 *   1. THE RING DROPS OLDEST AND COUNTS IT. Section 3.3's whole contract - a
 *      sink that falls behind loses history, not the module.
 *   2. want() IS FIRST REFUSAL. A sink that declines a sample never sees it in
 *      publish(), which is what makes "adding a sink touches zero ANT code"
 *      true rather than aspirational.
 *   3. THE DROP COUNTER SELF-PUBLISHES, ONCE PER CHANGE. Not a heartbeat: an
 *      idle bus that never drops must never manufacture a diagnostics sample.
 *   4. THE HR ADAPTER'S FIRST MESSAGE ESTABLISHES A BASELINE AND POSTS NO
 *      ACCUMULATOR DELTA. There is nothing yet to difference against.
 *   5. THE 1/1024 S CONVERSION IS EXACT ACROSS A WRAP, both for the u8 beat
 *      count and the u16 event time. This is the test that would have caught
 *      the "convert then difference" trap section 3.2 warns about - a wrapped
 *      counter is exactly where truncate-then-difference and
 *      difference-then-convert disagree.
 */

#include <stdbool.h>
#include <stdint.h>
#include <string.h>

#include <zephyr/toolchain.h>
#include <zephyr/ztest.h>

#include "radiant_bridge.h"
#include "radiant_hr_adapter.h"

/* ---------------------------------------------------------------------------
 * One capturing sink, registered for the life of the test binary
 * (STRUCT_SECTION_ITERABLE is a link-time array; a sink cannot be
 * created and destroyed per test). test_reset() below clears its capture
 * state instead, alongside radiant_bridge_reset()'s clearing of the bus.
 * ---------------------------------------------------------------------------
 */

#define CAP_MAX 40 /* > RADIANT_BRIDGE_RING_CAP (32) + one diagnostics sample */

static struct radiant_sample cap_buf[CAP_MAX];
static uint32_t          cap_n;
static bool               cap_want_reject; /* when true, want() declines everything */

static bool cap_want(const struct radiant_sample *s)
{
	ARG_UNUSED(s);
	return !cap_want_reject;
}

static void cap_publish(const struct radiant_sample *s)
{
	if (cap_n < CAP_MAX) {
		cap_buf[cap_n++] = *s;
	}
}

RADIANT_SINK_DEFINE(test_cap_sink, cap_want, cap_publish, NULL);

/* A second sink that always declines, proving want()==false never reaches
 * publish(): if it did, this sink's own publish() being NULL would crash. */
static bool never_want(const struct radiant_sample *s)
{
	ARG_UNUSED(s);
	return false;
}

RADIANT_SINK_DEFINE(test_deaf_sink, never_want, NULL, NULL);

static void test_reset(void *unused)
{
	ARG_UNUSED(unused);
	radiant_bridge_reset();
	memset(cap_buf, 0, sizeof(cap_buf));
	cap_n = 0u;
	cap_want_reject = false;
}

/* ---------------------------------------------------------------------------
 * The bus
 * ---------------------------------------------------------------------------
 */

static struct radiant_sample sample(uint32_t source, uint8_t field_id,
				 uint8_t field_type, int64_t raw)
{
	struct radiant_sample s = {
		.source = source,
		.field_id = field_id,
		.field_type = field_type,
		.flags = 0u,
		.exp = 0,
		.raw = raw,
		.t_us = 0u,
	};
	return s;
}

ZTEST(radiant_bridge, test_post_and_drain_delivers_in_order)
{
	struct radiant_sample a = sample(1u, 0u, RADIANT_FIELD_TEMPERATURE, 100);
	struct radiant_sample b = sample(1u, 1u, RADIANT_FIELD_HUMIDITY, 50);

	radiant_bridge_post(&a);
	radiant_bridge_post(&b);

	zassert_equal(radiant_bridge_drain(), 2u, "two samples queued");
	zassert_equal(cap_n, 2u, "one capturing sink, two deliveries");
	zassert_equal(cap_buf[0].raw, 100, "FIFO: oldest first");
	zassert_equal(cap_buf[1].raw, 50, "FIFO: newest second");
	zassert_equal(radiant_bridge_stats_get()->posted, 2u, NULL);
	zassert_equal(radiant_bridge_stats_get()->dropped, 0u, NULL);
}

ZTEST(radiant_bridge, test_want_false_never_reaches_publish)
{
	/*
	 * test_deaf_sink's publish is NULL; if want()==false were ignored and
	 * dispatch_one() called it anyway, this would crash rather than merely
	 * fail an assertion - which is the point of using a NULL publish as
	 * the probe instead of a counter.
	 */
	struct radiant_sample a = sample(1u, 0u, RADIANT_FIELD_TEMPERATURE, 1);

	radiant_bridge_post(&a);
	radiant_bridge_drain();

	cap_want_reject = true;
	radiant_bridge_post(&a);
	zassert_equal(radiant_bridge_drain(), 1u,
		     "drain() counts what left the ring, not what a sink accepted");
	zassert_equal(cap_n, 1u, "second sample: want() declined it, publish() never ran");
}

ZTEST(radiant_bridge, test_ring_drops_oldest_and_counts)
{
	/* Fill the ring past capacity without draining, so the drop path runs
	 * before any sink sees anything - proving the ring itself enforces
	 * the bound rather than relying on a drain to keep up. */
	const uint32_t cap = 32u; /* RADIANT_BRIDGE_RING_CAP, mirrored: no
				   * public accessor, and the value is part of
				   * this test's contract with the module. */
	uint32_t   i;

	for (i = 0u; i < cap + 5u; i++) {
		struct radiant_sample s = sample(1u, 0u, RADIANT_FIELD_EVENT_COUNT,
						 (int64_t)i);
		radiant_bridge_post(&s);
	}

	zassert_equal(radiant_bridge_stats_get()->posted, cap + 5u, NULL);
	zassert_equal(radiant_bridge_stats_get()->dropped, 5u,
		     "five posts past capacity, five drops");

	radiant_bridge_drain();
	/* The five OLDEST (raw 0..4) were evicted; the ring now holds
	 * raw 5..(cap+4), oldest first. */
	zassert_equal(cap_buf[0].raw, 5, "oldest surviving record is the sixth posted");
	zassert_equal(cap_buf[cap - 1u].raw, (int64_t)(cap + 4u),
		     "newest surviving record is the last posted");
}

ZTEST(radiant_bridge, test_drop_counter_self_publishes_once_per_change)
{
	uint32_t i;
	bool     saw_diag = false;
	uint32_t diag_value = 0u;

	/* No drops yet: an idle-but-used bus must not manufacture a
	 * diagnostics sample. */
	struct radiant_sample s = sample(1u, 0u, RADIANT_FIELD_EVENT_COUNT, 1);

	radiant_bridge_post(&s);
	radiant_bridge_drain();
	for (i = 0u; i < cap_n; i++) {
		if (cap_buf[i].source == RADIANT_BRIDGE_DIAG_SOURCE) {
			saw_diag = true;
		}
	}
	zassert_false(saw_diag, "nothing dropped yet: no diagnostics sample expected");

	/* Force one drop, then drain: exactly one diagnostics sample, value 1. */
	cap_n = 0u;
	for (i = 0u; i < 33u; i++) { /* RADIANT_BRIDGE_RING_CAP + 1 */
		struct radiant_sample f = sample(1u, 0u, RADIANT_FIELD_EVENT_COUNT,
						 (int64_t)i);
		radiant_bridge_post(&f);
	}
	radiant_bridge_drain();

	saw_diag = false;
	for (i = 0u; i < cap_n; i++) {
		if (cap_buf[i].source == RADIANT_BRIDGE_DIAG_SOURCE) {
			zassert_false(saw_diag, "exactly one diagnostics sample per drain, not one per drop");
			saw_diag = true;
			diag_value = (uint32_t)cap_buf[i].raw;
		}
	}
	zassert_true(saw_diag, "one drop happened: a diagnostics sample must appear");
	zassert_equal(diag_value, 1u, "the diagnostics sample carries the running total");

	/* Drain again with nothing new dropped: no second diagnostics sample. */
	cap_n = 0u;
	radiant_bridge_post(&s);
	radiant_bridge_drain();
	for (i = 0u; i < cap_n; i++) {
		zassert_not_equal(cap_buf[i].source, RADIANT_BRIDGE_DIAG_SOURCE,
			       "drop count unchanged: no repeat diagnostics sample");
	}
}

/* ---------------------------------------------------------------------------
 * The ANT+ HR adapter
 * ---------------------------------------------------------------------------
 */

static void body(uint8_t out[8], uint8_t page, uint16_t event_time,
		 uint8_t beat_count, uint8_t computed_hr)
{
	out[0] = page;
	out[1] = 0u;
	out[2] = 0u;
	out[3] = 0u;
	out[4] = (uint8_t)(event_time & 0xFFu);
	out[5] = (uint8_t)(event_time >> 8);
	out[6] = beat_count;
	out[7] = computed_hr;
}

ZTEST(radiant_bridge, test_hr_adapter_first_message_posts_only_instantaneous)
{
	struct radiant_hr_adapter a;
	uint8_t              b[8];
	uint32_t             n;

	radiant_hr_adapter_init(&a);
	body(b, 0x00u, 1000u, 50u, 72u);

	n = radiant_hr_adapter_decode(&a, 7u, b, 12345u);
	zassert_equal(n, 1u, "first message: nothing to difference against yet");

	radiant_bridge_drain();
	zassert_equal(cap_n, 1u, NULL);
	zassert_equal(cap_buf[0].field_type, RADIANT_FIELD_HEART_RATE, NULL);
	zassert_equal(cap_buf[0].field_id, RADIANT_HR_FIELD_COMPUTED_BPM, NULL);
	zassert_equal(cap_buf[0].raw, 72, NULL);
	zassert_equal(cap_buf[0].source, 7u, "source is threaded through unchanged");
}

ZTEST(radiant_bridge, test_hr_adapter_second_message_posts_all_three)
{
	struct radiant_hr_adapter a;
	uint8_t              b[8];

	radiant_hr_adapter_init(&a);
	body(b, 0x00u, 1000u, 50u, 72u);
	radiant_hr_adapter_decode(&a, 1u, b, 0u);
	radiant_bridge_drain();
	cap_n = 0u;

	/* One beat, 1024/1024 s later - exactly one second. */
	body(b, 0x00u, 2024u, 51u, 73u);
	radiant_hr_adapter_decode(&a, 1u, b, 1000000u);
	radiant_bridge_drain();

	zassert_equal(cap_n, 3u, "second message: instantaneous + two accumulators");

	zassert_equal(cap_buf[0].field_id, RADIANT_HR_FIELD_COMPUTED_BPM, NULL);
	zassert_equal(cap_buf[0].raw, 73, NULL);

	zassert_equal(cap_buf[1].field_id, RADIANT_HR_FIELD_BEAT_COUNT, NULL);
	zassert_equal(cap_buf[1].field_type, RADIANT_FIELD_EVENT_COUNT, NULL);
	zassert_true((cap_buf[1].flags & RADIANT_SAMPLE_ACCUMULATING) != 0u, NULL);
	zassert_equal(cap_buf[1].raw, 1, "one beat since the first message");

	zassert_equal(cap_buf[2].field_id, RADIANT_HR_FIELD_BEAT_TIME_MS, NULL);
	zassert_equal(cap_buf[2].field_type, RADIANT_FIELD_DURATION, NULL);
	zassert_equal(cap_buf[2].exp, -3, "milliseconds");
	zassert_equal(cap_buf[2].raw, 1000, "1024/1024 s = exactly 1000 ms");
}

ZTEST(radiant_bridge, test_hr_adapter_beat_count_wraps_at_u8)
{
	struct radiant_hr_adapter a;
	uint8_t              b[8];

	radiant_hr_adapter_init(&a);
	body(b, 0x00u, 0u, 254u, 72u);
	radiant_hr_adapter_decode(&a, 1u, b, 0u);
	radiant_bridge_drain();
	cap_n = 0u;

	/* 254 -> 255 -> 0 -> 1 -> 2 is four beats, not a negative or
	 * wrapped-nonsense delta. */
	body(b, 0x00u, 100u, 2u, 72u);
	radiant_hr_adapter_decode(&a, 1u, b, 1000u);
	radiant_bridge_drain();

	zassert_equal(cap_buf[1].raw, 4, "254 -> 2 across a u8 wrap is four beats");
}

ZTEST(radiant_bridge, test_hr_adapter_event_time_conversion_exact_across_wrap)
{
	struct radiant_hr_adapter a;
	uint8_t              b[8];
	int                   i;

	/*
	 * THE TEST THIS FILE EXISTS FOR. Sixty-five one-beat steps of 1000
	 * (1/1024 s) each - just under one second per step - crossing the
	 * u16 event-time wrap (65536) once partway through. If the adapter
	 * converted-then-differenced (the wrong construction section 3.2
	 * names), each step would carry a truncation error and the total
	 * published duration would drift; the right construction - difference
	 * in 1/1024 s, accumulate exactly, convert once per publish - cannot
	 * drift by more than the single final rounding.
	 *
	 * Exact total: 65 * 1000 = 65000 (1/1024 s) = 63476.5625 ms, so the
	 * published total after integer ms truncation must be exactly 63476.
	 */
	radiant_hr_adapter_init(&a);
	body(b, 0x00u, 0u, 0u, 72u);
	radiant_hr_adapter_decode(&a, 1u, b, 0u);
	radiant_bridge_drain();

	for (i = 1; i <= 65; i++) {
		uint16_t et = (uint16_t)((uint32_t)(i * 1000) % 65536u);

		cap_n = 0u;
		body(b, 0x00u, et, (uint8_t)i, 72u);
		radiant_hr_adapter_decode(&a, 1u, b, (uint64_t)i * 1000000u);
		radiant_bridge_drain();
	}

	/* The LAST publish carries the exact running total. */
	zassert_equal(cap_buf[2].field_id, RADIANT_HR_FIELD_BEAT_TIME_MS, NULL);
	zassert_equal(cap_buf[2].raw, 63476,
		     "65000/1024 s truncated to ms, exact after a u16 wrap");
}

static void *bridge_setup(void)
{
	return NULL;
}

ZTEST_SUITE(radiant_bridge, NULL, bridge_setup, test_reset, NULL, NULL);
```
