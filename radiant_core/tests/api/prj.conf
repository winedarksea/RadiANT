## CMakeLists.txt
```
# SPDX-License-Identifier: Apache-2.0
#
# The radiant_api composition test application.
#
# ── Why this is a second application and not a suite in ../src ───────────────
#
# src/ant_radio_radiant.c (radiant_api.c, before it moved out of radiant_core -
# see radiant_core/include/radiant_core/radiant_msg.h for why) is the only
# module in radiant_core's orbit with no ztest coverage, and the whole
# master-exchange path lives in it: every module underneath is tested and the
# composition is not. That gap is where the "a master answers the first slave
# exchange and none after it" bug lived, and closing it turns a two-board
# human-gated experiment into a 40-second run.
#
# The obvious move - add it to the parent application's own suite - does not
# link. radiant_event_crit_enter(), radiant_event_crit_exit() and
# radiant_event_wakeup() are port hooks, and ../src/test_event.c defines its own
# versions of all three; ../src/test_channel.c likewise defines
# radiant_channel_event_out(). ant_radio_radiant.c defines the production
# versions of the same four symbols (plus radiant_on_message()), so the two
# would collide at link - and if the collision were resolved in
# ant_radio_radiant.c's favour it would change what those 187 tests assert,
# which is worse than a link error because it is quiet.
#
# So: a sibling application, sharing ../fake_radio.c and the module itself, with
# ../src/ deliberately out of the glob. Nothing in the existing suite changes,
# and CI's `twister -T app/radiant_core/tests` walks subdirectories, so
# testcase.yaml here is picked up with no workflow edit.

cmake_minimum_required(VERSION 3.20.0)

# Two levels up: the module root is radiant_core/, this is radiant_core/tests/api.
list(APPEND ZEPHYR_EXTRA_MODULES "${CMAKE_CURRENT_SOURCE_DIR}/../..")

find_package(Zephyr REQUIRED HINTS $ENV{ZEPHYR_BASE})
project(radiant_core_api_tests)

# Same glob rule as the parent application: a new suite is a new file in src/
# and this file does not change. The parent's glob does not reach in here and
# this one does not reach out there, which is what keeps the two link images
# separate.
file(GLOB suite_sources CONFIGURE_DEPENDS "${CMAKE_CURRENT_SOURCE_DIR}/src/*.c")
target_sources(app PRIVATE ${suite_sources})

# The mock radio, shared with the parent application rather than copied. It is
# the HAL implementation for this image too - prj.conf selects
# CONFIG_RADIANT_CORE_BACKEND_NONE for the same reason.
target_sources(app PRIVATE "${CMAKE_CURRENT_SOURCE_DIR}/../fake_radio.c")

# The one thing this application exists to build: the antr_* adapter, from its
# new home outside the module. Unconditional rather than
# target_sources_ifdef(CONFIG_RADIANT_CORE_ANTR_API ...) - compiling it is the
# whole point of this application, unlike root/strap's CMakeLists.txt where the
# symbol genuinely toggles whether a real product links it.
target_sources(app PRIVATE "${CMAKE_CURRENT_SOURCE_DIR}/../../../src/ant_radio_radiant.c")
target_sources_ifdef(CONFIG_RADIANT_SEC_HOST_MESSAGES app PRIVATE
  "${CMAKE_CURRENT_SOURCE_DIR}/../../../src/ant_sec_host.c")

# ../ so a suite writes #include "fake_radio.h", the same spelling the parent's
# suites use. The module's own zephyr_include_directories() puts
# radiant_core/include on the search path; ../../../src is added explicitly
# here (unlike the parent application, which never needs it) for
# ant_radio_radiant.c's own #include "ant_wire.h" / "ant_radio.h" and for any
# suite that wants the same.
target_include_directories(app PRIVATE
  "${CMAKE_CURRENT_SOURCE_DIR}/.."
  "${CMAKE_CURRENT_SOURCE_DIR}/../../../src")
```

## Kconfig
```
# SPDX-License-Identifier: Apache-2.0
#
# CONFIG_RADIANT_SEC_HOST_MESSAGES is the only symbol this application needs
# from src/Kconfig.antr_api - testcase.yaml's radiant_core.api.sec_host
# scenario turns it on to compile src/ant_sec_host.c in - but
# CONFIG_RADIANT_CORE_ANTR_API comes along with it from the same file. That is
# harmless: this application's own CMakeLists.txt adds
# ../../../src/ant_radio_radiant.c unconditionally rather than reading that
# symbol (see the comment there), so RADIANT_CORE_ANTR_API's value has no
# effect here either way - it is declared only because RADIANT_SEC_HOST_MESSAGES
# `depends on` it, and a `depends on` names a symbol that must exist.
rsource "../../../src/Kconfig.antr_api"

source "Kconfig.zephyr"
```

## prj.conf
```kconfig
# SPDX-License-Identifier: Apache-2.0
#
# Configuration for the radiant_api composition test application.
#
# The difference from ../prj.conf is CMakeLists.txt here always adding
# ../../../src/ant_radio_radiant.c, which is the reason this is a separate
# application - see the CMakeLists here for why it cannot simply be added to
# the parent's suite.

CONFIG_ZTEST=y

CONFIG_RADIANT_CORE=y
# fake_radio.c is the HAL implementation for this image; a second one would be a
# duplicate-symbol link error.
CONFIG_RADIANT_CORE_BACKEND_NONE=y
# Declared by this application's own Kconfig (rsource of src/Kconfig.antr_api)
# rather than by radiant_core's. CMakeLists.txt here does not read it to decide
# whether to compile ant_radio_radiant.c - it always does - but
# CONFIG_RADIANT_SEC_HOST_MESSAGES `depends on` this symbol, and the
# radiant_core.api.sec_host testcase.yaml scenario needs to be able to turn
# that on.
CONFIG_RADIANT_CORE_ANTR_API=y

# radiant_api.c runs a real Zephyr thread and a real mutex, so this application
# needs both to exist. The suite drives the radio from the ztest thread and
# leans on the event thread only where it is the subject - the housekeeping
# watchdog - so nothing here waits on it otherwise.
CONFIG_MAIN_STACK_SIZE=4096
CONFIG_ZTEST_STACK_SIZE=4096

# LOG_DBG in radiant_api.c is what a bring-up session is read on. Off by
# default here: a suite that runs eight periods per test would emit a line per
# window, and ztest's own output is the thing being parsed.
CONFIG_LOG=y
CONFIG_RADIANT_CORE_LOG_LEVEL_WRN=y
```

## src/test_api_sec.c
```c
/* SPDX-License-Identifier: Apache-2.0 */
/*
 * The on-air half of the zero-cost claim. The `zero-cost` CI job compares
 * section sizes and symbol sets, but can't see the air; this file checks
 * that with CONFIG_RADIANT_SEC compiled in and every switch off at runtime,
 * fake_radio TX bodies and addresses are identical to without it.
 *
 * Joins the `api` suite (rather than its own) to inherit its setup and run
 * in both twister scenarios - feature absent and present - which is what
 * catches "the transform ran when nothing asked it to".
 */

#include <zephyr/ztest.h>
#include <string.h>

#include "ant_radio.h"
#include "ant_wire.h"

#include <radiant_core/radiant_channel.h>
#include <radiant_core/radiant_frame.h>
#include <radiant_core/radiant_radio_hal.h>
#include <radiant_core/radiant_sec.h>
#include <radiant_core/radiant_transfer.h>

#include "fake_radio.h"

#define SEC_CH        0u
#define SEC_DEVNUM    0x3A17u
#define SEC_DEVTYPE   0x0Bu
#define SEC_TRANSTYPE 0x05u
#define SEC_RF        57u

/*
 * A transmitted body is [trans_type][ctrl][d0..d7], so the host's payload
 * starts at body[2], not body[1] (the ANT control byte). Matters here
 * because payload byte [1] (body[3]) is what radiant_sec owns on a secured
 * channel - an off-by-one read would make that ownership look like it leaked
 * into a header field the transform must never touch.
 */
#define SEC_BODY_D0  2u
#define SEC_BODY_LEN 10u

/* Every byte distinguishable from a zero, a counter, or a tag byte. Byte [0]
 * is 0x05, inside the default secured page range (0x01..0x0F) - matters for
 * the acknowledgement test below, which needs a page the transform actually
 * touches (0x10 would be one past the range). */
static const uint8_t sec_payload[8] = {
	0x05, 0xA5, 0xC3, 0x5A, 0x77, 0x18, 0x2B, 0x9E,
};

/* The ANT+ network key derives address A6 C5 (what radiant_frame_addr()
 * takes and what goes on air) - the key's own first two bytes (B9 A5) never
 * appear in a frame; confusing the two breaks address assertions for the
 * wrong reason. */
static const uint8_t sec_net_key[8] = {
	0xB9, 0xA5, 0x21, 0xFB, 0xBD, 0x72, 0xC3, 0x45,
};

static const uint8_t sec_net_addr[RADIANT_NET_ADDR_LEN] = {
	RADIANT_NET_ADDR_ANT_PLUS_0,
	RADIANT_NET_ADDR_ANT_PLUS_1,
};

static void sec_open(uint8_t type)
{
	zassert_equal((antr_err_t)ANTW_RESPONSE_NO_ERROR,
		      antr_network_address_set(0u, sec_net_key));
	zassert_equal((antr_err_t)ANTW_RESPONSE_NO_ERROR,
		      antr_channel_assign(SEC_CH, type, 0u, 0u));
	zassert_equal((antr_err_t)ANTW_RESPONSE_NO_ERROR,
		      antr_channel_id_set(SEC_CH, SEC_DEVNUM, SEC_DEVTYPE,
					  SEC_TRANSTYPE));
	zassert_equal((antr_err_t)ANTW_RESPONSE_NO_ERROR,
		      antr_channel_period_set(SEC_CH,
					      RADIANT_CHANNEL_PERIOD_ANT_PLUS));
	zassert_equal((antr_err_t)ANTW_RESPONSE_NO_ERROR,
		      antr_channel_radio_freq_set(SEC_CH, SEC_RF));
	zassert_equal((antr_err_t)ANTW_RESPONSE_NO_ERROR,
		      antr_channel_open(SEC_CH));
}

static void sec_close(void)
{
	(void)antr_channel_close(SEC_CH);
	(void)antr_channel_unassign(SEC_CH);
}

static const struct fake_radio_arm *sec_last_tx(void)
{
	uint32_t i = fake_radio_arm_count();

	while (i-- > 0u) {
		const struct fake_radio_arm *a = fake_radio_arm(i);

		if (a != NULL && a->kind == FAKE_RADIO_ARM_TX &&
		    a->rc == RADIANT_RADIO_OK_RC) {
			return a;
		}
	}
	return NULL;
}

/* A master's own broadcast is 0x0A and its acknowledgement is 0xF2, so the
 * control byte is how the two are told apart in the arm log. */
static const struct fake_radio_arm *sec_last_tx_with_ctrl(uint8_t ctrl)
{
	uint32_t i = fake_radio_arm_count();

	while (i-- > 0u) {
		const struct fake_radio_arm *a = fake_radio_arm(i);

		if (a != NULL && a->kind == FAKE_RADIO_ARM_TX &&
		    a->rc == RADIANT_RADIO_OK_RC && a->body[1] == ctrl) {
			return a;
		}
	}
	return NULL;
}

static void sec_write(void)
{
	uint8_t buf[8];

	memcpy(buf, sec_payload, sizeof(buf));
	zassert_equal((antr_err_t)ANTW_RESPONSE_NO_ERROR,
		      antr_broadcast_message_tx(SEC_CH, 8u, buf));
}

/* Run the armed master slot out, then its turnaround: api_pump_locked()
 * skips a channel whose scheduler slot is still pending, and the turnaround
 * IS that slot until it closes. A reduced copy of test_api.c's
 * run_one_quiet_period() - separate because the two files test different
 * things about the same sequence. */
static void sec_run_slot(void)
{
	const struct fake_radio_arm *tx = sec_last_tx();
	radiant_time_t               t_sync;

	zassert_not_null(tx, "no master slot was armed");
	t_sync = tx->t_sync_at;

	fake_radio_advance_to(t_sync + 1u);
	zassert_true(tx->terminated, "the master's slot did not complete");
	fake_radio_advance_to(t_sync + RADIANT_TRANSFER_SLOT_REPLY_US +
			      RADIANT_TRANSFER_ACK_GUARD_US + 10u);
}

/*
 * Get the channel to a slot that actually carries the host's payload. A
 * master's first slot after open carries zeros by design -
 * api_post_master_tx() transmits from the first slot regardless, since a
 * master waiting for a write would deadlock every host library. The write
 * lands on the SECOND slot; inspecting the first would read an unwritten
 * buffer and call the zeros a transform.
 */
static const struct fake_radio_arm *sec_slot_with_payload(void)
{
	sec_write();
	sec_run_slot();
	sec_write();
	return sec_last_tx();
}

ZTEST(api, test_sec_a_masters_body_is_the_hosts_payload_when_nothing_is_on)
{
	const struct fake_radio_arm *tx;

	sec_open((uint8_t)ANTW_CHANNEL_TYPE_MASTER);
	tx = sec_slot_with_payload();
	zassert_not_null(tx, "the master armed no transmit");

	/* The assertion: body is [trans_type][ctrl][8 payload bytes], byte for
	 * byte the host's. With SEC=n this is a regression guard; with =y
	 * it's the claim - an unkeyed, unconfigured channel transmits exactly
	 * what it would without the transform compiled in. */
	zassert_equal(SEC_BODY_LEN, tx->body_len, "body is %u bytes, not %u",
		      (unsigned)tx->body_len, (unsigned)SEC_BODY_LEN);
	zassert_equal(SEC_TRANSTYPE, tx->body[0], "the header moved");
	zassert_mem_equal(&tx->body[SEC_BODY_D0], sec_payload, 8u,
			  "a channel with no key and no switches changed the "
			  "bytes on the air");
	sec_close();
}

ZTEST(api, test_sec_a_retransmission_is_byte_identical)
{
	const struct fake_radio_arm *tx;
	uint8_t                      first[8];
	uint8_t                      i;

	/* A master retransmits its current body every slot regardless of new
	 * writes. If a transform wrote through to the host's buffer instead
	 * of a copy, the second slot would encrypt already-encrypted bytes -
	 * a receiver would decode only the first slot, looking like a range
	 * problem. */
	sec_open((uint8_t)ANTW_CHANNEL_TYPE_MASTER);
	tx = sec_slot_with_payload();
	zassert_not_null(tx);
	memcpy(first, &tx->body[SEC_BODY_D0], sizeof(first));
	zassert_mem_equal(first, sec_payload, 8u, "the first slot already "
			  "differs; the wrong slot is being inspected");

	for (i = 0u; i < 4u; i++) {
		sec_run_slot();
		tx = sec_last_tx();
		zassert_not_null(tx);
		zassert_mem_equal(&tx->body[SEC_BODY_D0], first, 8u,
				  "slot %u differs from the first without the "
				  "host writing anything", (unsigned)i);
	}
	sec_close();
}

ZTEST(api, test_sec_the_on_air_address_is_the_one_the_channel_id_derives)
{
	struct radiant_channel_id id = {
		.device_number = SEC_DEVNUM,
		.device_type = SEC_DEVTYPE,
		.trans_type = SEC_TRANSTYPE,
	};
	const struct fake_radio_arm *tx;
	uint8_t                      want[RADIANT_RADIO_ADDR_MAX];

	/* The address path is untouched by design - v1 is payload transforms
	 * only. Asserting on a master's own transmit rather than a slave's
	 * receive filters avoids dragging in whatever frame config the search
	 * happens to be sweeping with. */
	zassert_equal((int)RADIANT_FRAME_ADDR_LEN_TRACKING,
		      radiant_frame_addr(RADIANT_FRAME_CFG_TRACKING,
					 sec_net_addr, &id, want,
					 sizeof(want)));

	sec_open((uint8_t)ANTW_CHANNEL_TYPE_MASTER);
	tx = sec_slot_with_payload();
	zassert_not_null(tx);

	zassert_equal(RADIANT_FRAME_ADDR_LEN_TRACKING, tx->addr_len,
		      "the transmit changed address length");
	zassert_mem_equal(tx->addr, want, RADIANT_FRAME_ADDR_LEN_TRACKING,
			  "the address on the air is not the one the channel "
			  "ID derives; a payload transform must not touch the "
			  "address path");
	sec_close();
}

/* The peer's frame, hand-assembled from docs/ant-radio-link.md rather than
 * via the encoder under test:
 *     A6 C5 | dl dh | dtype | ttype | ctrl | d0..d7
 */
#define SEC_AIR_LEN 15u

static void sec_build_peer_frame(uint8_t *out, uint8_t ctrl)
{
	out[0] = RADIANT_NET_ADDR_ANT_PLUS_0;
	out[1] = RADIANT_NET_ADDR_ANT_PLUS_1;
	out[2] = (uint8_t)(SEC_DEVNUM & 0xFFu);
	out[3] = (uint8_t)(SEC_DEVNUM >> 8);
	out[4] = SEC_DEVTYPE;
	out[5] = SEC_TRANSTYPE;
	out[6] = ctrl;
	memset(&out[7], 0x5Au, 8u);
}

ZTEST(api, test_sec_an_acknowledgement_carries_what_the_broadcast_put_on_air)
{
	const struct fake_radio_arm *bcast;
	const struct fake_radio_arm *reply;
	uint8_t                      on_air[8];
	uint8_t                      frame[SEC_AIR_LEN];
	radiant_time_t               t_tx;

	/*
	 * The acknowledgement path is the one that leaks. A master answers
	 * acknowledged data with its own broadcast buffer - the host's
	 * plaintext. Sent verbatim under X_CONF, that hands a passive
	 * listener the plaintext of the ciphertext it heard 1560 us earlier -
	 * a voluntary two-time pad. The fix answers with the ciphertext
	 * already built for the current counter, byte-for-byte identical to
	 * the broadcast slot. That equality is true in both twister scenarios
	 * (both plaintext without the feature, both ciphertext with it),
	 * unlike "the reply is not the plaintext" which only runs one way.
	 */
	sec_open((uint8_t)ANTW_CHANNEL_TYPE_MASTER);

#if defined(CONFIG_RADIANT_SEC)
	{
		static const uint8_t root[16] = {
			0x00, 0x11, 0x22, 0x33, 0x44, 0x55, 0x66, 0x77,
			0x88, 0x99, 0xaa, 0xbb, 0xcc, 0xdd, 0xee, 0xff,
		};

		/* Keyed through radiant_sec directly (the host surface is P6)
		 * since this assertion is about the air, not key delivery. */
		zassert_equal(RADIANT_SEC_OK,
			      radiant_sec_set_key(SEC_CH, root, 128,
						  SEC_DEVNUM));
		zassert_equal(RADIANT_SEC_OK,
			      radiant_sec_set_devnum(SEC_CH, SEC_DEVNUM));
		zassert_equal(RADIANT_SEC_OK,
			      radiant_sec_configure(SEC_CH,
						    RADIANT_SEC_SW_CONF, 2u,
						    RADIANT_SEC_PAGE_LO_DEFAULT,
						    RADIANT_SEC_PAGE_HI_DEFAULT));
		zassert_equal(RADIANT_SEC_OK,
			      radiant_sec_set_epoch(SEC_CH, 1u, 0u, 8182u));
		zassert_true(radiant_sec_channel_is_secured(SEC_CH),
			     "the channel did not arm; the rest of this test "
			     "would assert nothing");
	}
#endif

	sec_write();
	sec_run_slot();
	sec_write();

	bcast = sec_last_tx();
	zassert_not_null(bcast);
	t_tx = bcast->t_sync_at;
	memcpy(on_air, &bcast->body[SEC_BODY_D0], sizeof(on_air));

#if defined(CONFIG_RADIANT_SEC)
	/* sec_payload[0] is inside the default secured range, so this is a
	 * transformed page rather than one that only looks untouched. */
	zassert_true(memcmp(&on_air[2], &sec_payload[2], 5u) != 0,
		     "the broadcast went out in the clear; the exchange below "
		     "would then prove nothing");
#endif

	/* Let the master's own slot and its turnaround exist, then speak into
	 * the turnaround as a slave sending acknowledged data. */
	fake_radio_advance_to(t_tx + 1u);
	sec_build_peer_frame(frame, RADIANT_CTRL_BURST_LAST_SEQ0);
	zassert_equal(RADIANT_RADIO_OK_RC,
		      fake_radio_air_frame(t_tx + RADIANT_TRANSFER_SLOT_REPLY_US,
					   frame, SEC_AIR_LEN));
	fake_radio_advance_to(t_tx + RADIANT_TRANSFER_SLOT_REPLY_US +
			      RADIANT_TRANSFER_REPLY_US + 10u);

	reply = sec_last_tx_with_ctrl(RADIANT_CTRL_ACK_LAST_SEQ1);
	zassert_not_null(reply, "the master did not answer 0xA2 with 0xF2");
	zassert_mem_equal(&reply->body[SEC_BODY_D0], on_air, sizeof(on_air),
			  "the acknowledgement did not carry the bytes the "
			  "broadcast slot put on the air");
	sec_close();
}

ZTEST(api, test_sec_an_unsecured_channel_reports_clear)
{
	/* "Clear" is the honest word for a channel with no transform on it, and
	 * it is a different statement from "unverified". A host that cannot
	 * tell those apart cannot act on either. */
	zassert_equal(RADIANT_SEC_VERDICT_CLEAR,
		      radiant_sec_last_verdict(SEC_CH));
	zassert_false(radiant_sec_channel_is_secured(SEC_CH));
}
```

## src/test_api_sec_host.c
```c
/* SPDX-License-Identifier: Apache-2.0 */
/*
 * The 0xF1-0xF4 adapter: antr_sec_config(), antr_sec_key_set(),
 * antr_sec_epoch_set(), antr_sec_status_get(). Tests the ADAPTER, not the
 * transforms (radiant_sec's own suite covers those): the two ordering
 * rules, the refusals, and the status encoding.
 *
 * Ordering rules: a channel needs its ID before its key (the device number
 * is bound into the KDF and read from the channel, not the wire) and its
 * period before its epoch (period turns a phase into a packet index).
 * Neither fails loudly if skipped - keys under device 0 verify against
 * nothing, a counter from the wrong period drifts like clock error - so
 * both are refused with ANTW_CHANNEL_IN_WRONG_STATE.
 *
 * Compiled only into the radiant_core.api.sec_host scenario, the only one
 * that links the adapter.
 */

#include <zephyr/kernel.h>

/* The whole file is behind the symbol because CMakeLists.txt globs src/*.c
 * into every scenario and two of three don't link the adapter; the
 * antr_sec_* declarations are behind the same #ifdef in src/ant_radio.h so
 * the two halves appear and disappear together. */
#if defined(CONFIG_RADIANT_SEC_HOST_MESSAGES)

#include <zephyr/ztest.h>
#include <string.h>

#include "ant_radio.h"
#include "ant_wire.h"

#include <radiant_core/radiant_channel.h>
#include <radiant_core/radiant_sec.h>

#define HOST_CH     0u
#define HOST_DEVNUM 0x3A17u
#define HOST_DEVTYPE 0x0Bu
#define HOST_TRANS  0x05u
#define HOST_RF     57u

#define STATUS_LEN 23u

static const uint8_t host_key[16] = {
	0x00, 0x11, 0x22, 0x33, 0x44, 0x55, 0x66, 0x77,
	0x88, 0x99, 0xaa, 0xbb, 0xcc, 0xdd, 0xee, 0xff,
};

static const uint8_t host_net_key[8] = {
	0xB9, 0xA5, 0x21, 0xFB, 0xBD, 0x72, 0xC3, 0x45,
};

/* Assign and identify a channel, without opening it: none of these tests need
 * the radio, and an open channel would leave one armed for the next test. */
static void host_assign(bool with_id, bool with_period)
{
	zassert_equal((antr_err_t)ANTW_RESPONSE_NO_ERROR,
		      antr_network_address_set(0u, host_net_key));
	zassert_equal((antr_err_t)ANTW_RESPONSE_NO_ERROR,
		      antr_channel_assign(HOST_CH,
					  (uint8_t)ANTW_CHANNEL_TYPE_MASTER,
					  0u, 0u));
	if (with_id) {
		zassert_equal((antr_err_t)ANTW_RESPONSE_NO_ERROR,
			      antr_channel_id_set(HOST_CH, HOST_DEVNUM,
						  HOST_DEVTYPE, HOST_TRANS));
	}
	if (with_period) {
		zassert_equal(
			(antr_err_t)ANTW_RESPONSE_NO_ERROR,
			antr_channel_period_set(
				HOST_CH, RADIANT_CHANNEL_PERIOD_ANT_PLUS));
	}
	zassert_equal((antr_err_t)ANTW_RESPONSE_NO_ERROR,
		      antr_channel_radio_freq_set(HOST_CH, HOST_RF));
}

static void host_done(void)
{
	(void)antr_channel_unassign(HOST_CH);
}

static uint16_t rd16(const uint8_t *p)
{
	return (uint16_t)((uint16_t)p[0] | ((uint16_t)p[1] << 8));
}

static uint32_t rd32(const uint8_t *p)
{
	return (uint32_t)p[0] | ((uint32_t)p[1] << 8) |
	       ((uint32_t)p[2] << 16) | ((uint32_t)p[3] << 24);
}

ZTEST(api, test_sec_host_a_key_needs_a_channel_id_first)
{
	host_assign(false, true);

	/*
	 * WRONG STATE, not INVALID_PARAMETER. The key is fine; it arrived too
	 * early. A host that cannot tell those apart retries the wrong thing -
	 * it re-sends the key rather than sending the channel ID.
	 */
	zassert_equal((antr_err_t)ANTW_CHANNEL_IN_WRONG_STATE,
		      antr_sec_key_set(HOST_CH, 128u, host_key),
		      "a key was accepted on a channel with no ID; the KDF "
		      "would have bound device number 0");

	zassert_equal((antr_err_t)ANTW_RESPONSE_NO_ERROR,
		      antr_channel_id_set(HOST_CH, HOST_DEVNUM, HOST_DEVTYPE,
					  HOST_TRANS));
	zassert_equal((antr_err_t)ANTW_RESPONSE_NO_ERROR,
		      antr_sec_key_set(HOST_CH, 128u, host_key));
	host_done();
}

ZTEST(api, test_sec_host_only_a_128_bit_key_is_taken)
{
	host_assign(true, true);

	zassert_equal((antr_err_t)ANTW_INVALID_PARAMETER_PROVIDED,
		      antr_sec_key_set(HOST_CH, 192u, host_key));
	zassert_equal((antr_err_t)ANTW_INVALID_PARAMETER_PROVIDED,
		      antr_sec_key_set(HOST_CH, 64u, host_key));
	zassert_equal((antr_err_t)ANTW_RESPONSE_NO_ERROR,
		      antr_sec_key_set(HOST_CH, 128u, host_key));
	host_done();
}

ZTEST(api, test_sec_host_a_reserved_switch_bit_is_refused_not_masked)
{
	uint8_t bit;

	host_assign(true, true);
	zassert_equal((antr_err_t)ANTW_RESPONSE_NO_ERROR,
		      antr_sec_key_set(HOST_CH, 128u, host_key));

	/*
	 * Masking would enable the switches this version understands and
	 * silently drop the one it does not - so a host asking for a later
	 * switch would be told "yes" and get something weaker than it asked
	 * for, which is the one answer a security surface must never give.
	 */
	for (bit = 0x10u; bit != 0u; bit = (uint8_t)(bit << 1)) {
		zassert_equal((antr_err_t)ANTW_INVALID_PARAMETER_PROVIDED,
			      antr_sec_config(HOST_CH,
					      (uint8_t)(RADIANT_SEC_SW_AUTH |
							bit),
					      2u, 0x01u, 0x0Fu),
			      "reserved bit 0x%02X was accepted",
			      (unsigned)bit);
	}

	zassert_equal((antr_err_t)ANTW_RESPONSE_NO_ERROR,
		      antr_sec_config(HOST_CH, RADIANT_SEC_SW_AUTH, 2u, 0x01u,
				      0x0Fu));
	host_done();
}

ZTEST(api, test_sec_host_the_config_refusals_reach_the_host)
{
	host_assign(true, true);
	zassert_equal((antr_err_t)ANTW_RESPONSE_NO_ERROR,
		      antr_sec_key_set(HOST_CH, 128u, host_key));

	/* W must divide 256 and 65536. */
	zassert_equal((antr_err_t)ANTW_INVALID_PARAMETER_PROVIDED,
		      antr_sec_config(HOST_CH, RADIANT_SEC_SW_AUTH, 3u, 0x01u,
				      0x0Fu));
	/* 0x00 is the descriptor: securing it makes the node undiscoverable. */
	zassert_equal((antr_err_t)ANTW_INVALID_PARAMETER_PROVIDED,
		      antr_sec_config(HOST_CH, RADIANT_SEC_SW_AUTH, 2u, 0x00u,
				      0x0Fu));
	/* 0x50 is common page 80, which every ANT+ receiver understands. */
	zassert_equal((antr_err_t)ANTW_INVALID_PARAMETER_PROVIDED,
		      antr_sec_config(HOST_CH, RADIANT_SEC_SW_AUTH, 2u, 0x01u,
				      0x50u));
	/* The descriptor has no counter and therefore no nonce. */
	zassert_equal((antr_err_t)ANTW_INVALID_PARAMETER_PROVIDED,
		      antr_sec_config(HOST_CH,
				      RADIANT_SEC_SW_CONF |
					      RADIANT_SEC_SW_DESC_CONF,
				      2u, 0x01u, 0x0Fu));
	host_done();
}

ZTEST(api, test_sec_host_an_epoch_needs_a_key_and_only_moves_forwards)
{
	host_assign(true, true);

	/* No key yet: the epoch has nothing to anchor. */
	zassert_equal((antr_err_t)ANTW_CHANNEL_IN_WRONG_STATE,
		      antr_sec_epoch_set(HOST_CH, 0u, 10u, 0u));

	zassert_equal((antr_err_t)ANTW_RESPONSE_NO_ERROR,
		      antr_sec_key_set(HOST_CH, 128u, host_key));
	zassert_equal((antr_err_t)ANTW_RESPONSE_NO_ERROR,
		      antr_sec_config(HOST_CH, RADIANT_SEC_SW_AUTH, 2u, 0x01u,
				      0x0Fu));
	zassert_equal((antr_err_t)ANTW_RESPONSE_NO_ERROR,
		      antr_sec_epoch_set(HOST_CH, 0u, 10u, 0u));

	/*
	 * D3. A reboot that restarted the counter under an unchanged epoch is a
	 * two-time pad for X_CONF and a full session replay against X_AUTH, so
	 * the same epoch twice is refused rather than treated as idempotent.
	 */
	zassert_equal((antr_err_t)ANTW_INVALID_PARAMETER_PROVIDED,
		      antr_sec_epoch_set(HOST_CH, 0u, 10u, 0u));
	zassert_equal((antr_err_t)ANTW_INVALID_PARAMETER_PROVIDED,
		      antr_sec_epoch_set(HOST_CH, 0u, 9u, 0u));
	zassert_equal((antr_err_t)ANTW_RESPONSE_NO_ERROR,
		      antr_sec_epoch_set(HOST_CH, 0u, 11u, 0u));

	/* The top of the range is reserved so a counter wrap has room. */
	zassert_equal((antr_err_t)ANTW_INVALID_PARAMETER_PROVIDED,
		      antr_sec_epoch_set(HOST_CH, 0u, 0xFFFFFFFFu, 0u));

	/* Reserved flag bits. */
	zassert_equal((antr_err_t)ANTW_INVALID_PARAMETER_PROVIDED,
		      antr_sec_epoch_set(HOST_CH, 0x02u, 12u, 0u));
	host_done();
}

ZTEST(api, test_sec_host_status_reports_what_was_configured)
{
	uint8_t st[STATUS_LEN];

	host_assign(true, true);
	zassert_equal((antr_err_t)ANTW_RESPONSE_NO_ERROR,
		      antr_sec_key_set(HOST_CH, 128u, host_key));
	zassert_equal((antr_err_t)ANTW_RESPONSE_NO_ERROR,
		      antr_sec_config(HOST_CH,
				      RADIANT_SEC_SW_AUTH | RADIANT_SEC_SW_CONF,
				      4u, 0x02u, 0x1Fu));
	zassert_equal((antr_err_t)ANTW_RESPONSE_NO_ERROR,
		      antr_sec_epoch_set(HOST_CH, 0u, 0x00ABCDEFu, 0u));

	memset(st, 0xEE, sizeof(st));
	zassert_equal((antr_err_t)ANTW_RESPONSE_NO_ERROR,
		      antr_sec_status_get(HOST_CH, st, sizeof(st)));

	zassert_equal(HOST_CH, st[0]);
	zassert_equal(RADIANT_SEC_SW_AUTH | RADIANT_SEC_SW_CONF, st[1]);
	zassert_equal(4u, st[2]);
	zassert_equal(0x02u, st[3]);
	zassert_equal(0x1Fu, st[4]);
	zassert_equal(0x00ABCDEFu, rd32(&st[5]),
		      "the epoch is not little-endian at [5..8]");
	zassert_equal(0u, rd16(&st[11]), "nothing has verified yet");
	zassert_equal((uint8_t)RADIANT_SEC_VERDICT_CLEAR, st[22]);
	host_done();
}

ZTEST(api, test_sec_host_an_unkeyed_channel_reads_as_zeros_not_as_an_error)
{
	uint8_t st[STATUS_LEN];

	/*
	 * "No security on this channel" is a state a host must be able to read.
	 * Making it an error would force a host to treat every ordinary channel
	 * as a fault, and a host that learns to ignore one error learns to
	 * ignore them all.
	 */
	memset(st, 0xEE, sizeof(st));
	zassert_equal((antr_err_t)ANTW_RESPONSE_NO_ERROR,
		      antr_sec_status_get(HOST_CH, st, sizeof(st)));

	zassert_equal(HOST_CH, st[0]);
	zassert_equal(0u, st[1], "an unkeyed channel reports switches on");
	zassert_equal((uint8_t)RADIANT_SEC_VERDICT_CLEAR, st[22]);
}

ZTEST(api, test_sec_host_a_short_status_buffer_is_refused)
{
	uint8_t st[STATUS_LEN];

	/* Refused rather than truncated: a short reply on the wire would be
	 * parsed by field offset and would misreport every counter after the
	 * cut. */
	zassert_equal((antr_err_t)ANTW_INVALID_MESSAGE,
		      antr_sec_status_get(HOST_CH, st, STATUS_LEN - 1u));
	zassert_equal((antr_err_t)ANTW_INVALID_MESSAGE,
		      antr_sec_status_get(HOST_CH, NULL, sizeof(st)));
}

ZTEST(api, test_sec_host_a_channel_out_of_range_is_refused_everywhere)
{
	uint8_t st[STATUS_LEN];
	uint8_t bad = (uint8_t)RADIANT_CHANNEL_COUNT;

	zassert_equal((antr_err_t)ANTW_INVALID_MESSAGE,
		      antr_sec_config(bad, RADIANT_SEC_SW_AUTH, 2u, 0x01u,
				      0x0Fu));
	zassert_equal((antr_err_t)ANTW_INVALID_MESSAGE,
		      antr_sec_key_set(bad, 128u, host_key));
	zassert_equal((antr_err_t)ANTW_INVALID_MESSAGE,
		      antr_sec_epoch_set(bad, 0u, 1u, 0u));
	zassert_equal((antr_err_t)ANTW_INVALID_MESSAGE,
		      antr_sec_status_get(bad, st, sizeof(st)));
}

#endif /* CONFIG_RADIANT_SEC_HOST_MESSAGES */
```
