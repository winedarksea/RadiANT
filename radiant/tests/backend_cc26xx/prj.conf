## CMakeLists.txt
```
# SPDX-License-Identifier: Apache-2.0
#
# The TI CC26xx backend (radiant_radio_cc26xx.c), included against a fake TI
# RF driver (fakes/ti/drivers/rf/RF.h, fake_rf.c) and hal_ti's REAL driverlib
# command headers (rf_*_cmd.h, rf_data_entry.h, rf_patches/*.h), so the only
# production code under test is the backend - and, in the coex scenario, its
# scheduler-policy hooks (radiant_radio_cc26xx_arb.c).

cmake_minimum_required(VERSION 3.20.0)

list(APPEND ZEPHYR_EXTRA_MODULES "${CMAKE_CURRENT_SOURCE_DIR}/../..")

find_package(Zephyr REQUIRED HINTS $ENV{ZEPHYR_BASE})
project(radiant_backend_cc26xx_tests)

# hal_ti, as radiant/CMakeLists.txt finds it for a real cc26xx build. A
# native_sim build gets nothing from the TI SoC layer, so the device's
# driverlib directory is put on the include path here, behind fakes/.
if(DEFINED ZEPHYR_HAL_TI_MODULE_DIR)
  set(cc_hal_ti "${ZEPHYR_HAL_TI_MODULE_DIR}")
elseif(DEFINED ZEPHYR_TI_MODULE_DIR)
  set(cc_hal_ti "${ZEPHYR_TI_MODULE_DIR}")
else()
  message(FATAL_ERROR
    "radiant/tests/backend_cc26xx needs the hal_ti module (west.yml's "
    "hal_ti project, group `ti`) for TI's driverlib command headers.")
endif()
set(cc_ti_dev "${cc_hal_ti}/simplelink/source/ti/devices/cc13x2_cc26x2")
if(NOT EXISTS "${cc_ti_dev}/driverlib/rf_prop_cmd.h")
  message(FATAL_ERROR
    "radiant/tests/backend_cc26xx: ${cc_ti_dev}/driverlib/rf_prop_cmd.h "
    "is missing; is hal_ti checked out?")
endif()

# -DBACKEND_COEX=1 (scenario radiant.backend_cc26xx.coex): the backend under
# CONFIG_RADIANT_BACKEND_CC26XX_COEX (RF_scheduleCmd, patched caps) plus
# radiant_radio_cc26xx_arb.c and its own cases in src_coex/.
#
# src_caps/ (the caps parity test) runs in every scenario. -DBACKEND_SHORT_MATCH=1
# (scenario radiant.backend_cc26xx.short_match) builds the backend with
# CONFIG_RADIANT_SEARCH_SHORT_MATCH, the shipping default, and runs only that:
# the src/ suites are written against the 3-byte hardware address.
file(GLOB caps_sources CONFIGURE_DEPENDS "${CMAKE_CURRENT_SOURCE_DIR}/src_caps/*.c")
if(BACKEND_SHORT_MATCH)
  set(suite_sources ${caps_sources})
  target_compile_definitions(app PRIVATE BACKEND_SHORT_MATCH=1)
else()
  file(GLOB suite_sources CONFIGURE_DEPENDS "${CMAKE_CURRENT_SOURCE_DIR}/src/*.c")
  list(APPEND suite_sources ${caps_sources})
endif()
if(BACKEND_COEX)
  file(GLOB coex_sources CONFIGURE_DEPENDS "${CMAKE_CURRENT_SOURCE_DIR}/src_coex/*.c")
  list(APPEND suite_sources ${coex_sources})
  target_sources(app PRIVATE "${CMAKE_CURRENT_SOURCE_DIR}/../../src/radiant_radio_cc26xx_arb.c")
  target_compile_definitions(app PRIVATE BACKEND_COEX=1)
endif()
target_sources(app PRIVATE ${suite_sources})
target_sources(app PRIVATE
  "${CMAKE_CURRENT_SOURCE_DIR}/backend_cc26xx_under_test.c"
  "${CMAKE_CURRENT_SOURCE_DIR}/fake_rf.c"
  "${CMAKE_CURRENT_SOURCE_DIR}/../../src/radiant_addr_split.c")

target_include_directories(app BEFORE PRIVATE
  "${CMAKE_CURRENT_SOURCE_DIR}/fakes")
target_include_directories(app PRIVATE
  "${CMAKE_CURRENT_SOURCE_DIR}"
  "${CMAKE_CURRENT_SOURCE_DIR}/../../src"
  "${cc_ti_dev}")
```

## prj.conf
```kconfig
# SPDX-License-Identifier: Apache-2.0
CONFIG_ZTEST=y
CONFIG_RADIANT=y
CONFIG_RADIANT_BACKEND_NONE=y
# crc16_itu_t(): the backend's CRC fast path (RADIANT_BACKEND_CC26XX selects it).
CONFIG_CRC=y
CONFIG_LOG=y
CONFIG_RADIANT_LOG_LEVEL_WRN=y
CONFIG_MAIN_STACK_SIZE=4096
CONFIG_ZTEST_STACK_SIZE=4096
```

## src/test_arm.c
```c
/* SPDX-License-Identifier: Apache-2.0 */
/*
 * The TI backend's arm path against the HAL contract (TODO.md "Backend
 * drift: TI vs nRF", item 1 and two points of item 5):
 *
 *  - rf_index is honoured: an arm on another channel chains a CMD_FS onto
 *    radiant_rf_index_to_mhz(rf_index) ahead of the RX/TX in the same posted
 *    command, the operation itself still starting at its absolute time; the
 *    synthesiser is credited only once that FS ran; an index above
 *    RADIANT_RF_INDEX_MAX is EINVAL with nothing posted.
 *  - a retune needs its settling time: inside the floor plus FS time, ETIME.
 *  - a transmit never goes out late: pastTrig = 0 on the TX start trigger,
 *    and ETIME when its start is already inside the arm floor.
 *  - operation ids skip 0 on wrap, and every failed arm leaves *op == 0.
 *  - transmit power rounds to the nearest table entry and clamps at its
 *    ends, as nRF does (item 6), never keeping a stale power.
 */

#include <string.h>

#include <zephyr/ztest.h>

#include <ti/drivers/rf/RF.h>
#include <driverlib/rf_prop_mailbox.h>

#include <radiant/radiant_radio_hal.h>

#include "backend_cc26xx_probe.h"

static void before(void *fixture)
{
	ARG_UNUSED(fixture);
	cc_reset(true);
}

ZTEST_SUITE(radiant_backend_cc26xx_arm, NULL, NULL, before, NULL, NULL);

static const uint8_t body8[RADIANT_RADIO_BODY_MAX] = {
	0x11, 0x22, 0x33, 0x44, 0x55, 0x66, 0x77, 0x88, 0x99, 0xAA,
};

#define RF_OTHER 66u   /* 2466 MHz */

static int arm_rx(uint8_t rf, radiant_time_t t_open, uint32_t *op)
{
	struct radiant_rx_req req;
	struct radiant_rx_filter filt;

	cc_rx_req(&req, &filt, t_open, 1000u);
	req.rf_index = rf;
	return radiant_radio_rx(&req, op);
}

static int arm_tx(uint8_t rf, radiant_time_t t_sync, uint32_t *op)
{
	struct radiant_tx_req req;

	cc_tx_req(&req, body8, t_sync);
	req.rf_index = rf;
	return radiant_radio_tx(&req, op);
}

/* Run the operation now armed to its normal end. */
static void finish_last(void)
{
	struct fake_rf_cmd *c = fake_rf_last();
	const bool rx = cc_kind() == 1;

	zassert_not_null(c);
	fake_rf_start(c->cmd.ch);
	fake_rf_complete(c->cmd.ch, rx ? PROP_DONE_RXTIMEOUT : PROP_DONE_OK,
			 RF_EventLastCmdDone);
	zassert_equal(cc_kind(), 0);
}

/* The CMD_FS chained ahead of `main_no` in the newest posted command: it must
 * be the chain's head, the main op right behind it. NULL if no FS. */
static const struct fake_rf_op_snap *chained_fs(uint16_t main_no)
{
	const struct fake_rf_cmd *c = fake_rf_last();
	const struct fake_rf_op_snap *fs;

	zassert_not_null(c);
	fs = fake_rf_find_op(c, CMD_FS);
	if (fs == NULL) {
		zassert_equal(c->n_chain, 1u, "no FS: the main op alone");
		zassert_equal(c->chain[0].command_no, main_no);
		return NULL;
	}
	zassert_equal(c->n_chain, 2u, "FS then the main op");
	zassert_equal_ptr(fs, &c->chain[0], "the FS heads the chain");
	zassert_equal(c->chain[1].command_no, main_no);
	zassert_not_equal(fs->cond_rule, COND_NEVER);
	return fs;
}

/* An arm on rf 66 posts one command: CMD_FS at 2466 MHz (the test build's
 * trim is 0) at an absolute time ahead of the RX, and the RX starting exactly
 * where it would without the retune. */
ZTEST(radiant_backend_cc26xx_arm, test_rx_retune_chains_fs)
{
	const radiant_time_t t_open = radiant_radio_now() + 2000u;
	const struct fake_rf_op_snap *fs;
	const struct fake_rf_op_snap *rx;
	uint32_t base_start;
	uint32_t op = 0u;

	zassert_equal(arm_rx(RADIANT_RF_INDEX_ANT_PLUS, t_open, &op), RADIANT_RADIO_OK_RC);
	zassert_is_null(chained_fs(CMD_PROP_RX_ADV), "rf 57 is already tuned");
	base_start = fake_rf_find_op(fake_rf_last(), CMD_PROP_RX_ADV)->start_time;

	cc_reset(true);
	zassert_equal(arm_rx(RF_OTHER, t_open, &op), RADIANT_RADIO_OK_RC);
	fs = chained_fs(CMD_PROP_RX_ADV);
	zassert_not_null(fs, "rf 66 must retune");
	zassert_equal(fs->fs_frequency, radiant_rf_index_to_mhz(RF_OTHER));
	zassert_equal(fs->fs_fract_freq, 0u);
	zassert_equal(fs->trigger_type, TRIG_ABSTIME);
	rx = fake_rf_find_op(fake_rf_last(), CMD_PROP_RX_ADV);
	zassert_equal(rx->trigger_type, TRIG_ABSTIME);
	zassert_equal(rx->start_time, base_start, "the RX keeps its absolute start");
	zassert_true((int32_t)(rx->start_time - fs->start_time) > 0,
		     "the FS starts ahead of the RX");
#if defined(BACKEND_COEX)
	zassert_equal(fake_rf_last()->sch.startTime, fs->start_time,
		      "the scheduler books the air from the FS on");
#endif
}

/* Tuned once, a second arm on the same channel posts no FS; going back to
 * the default retunes to 2457. */
ZTEST(radiant_backend_cc26xx_arm, test_rx_retune_once_and_back)
{
	const struct fake_rf_op_snap *fs;
	uint32_t op = 0u;

	zassert_equal(arm_rx(RF_OTHER, radiant_radio_now() + 2000u, &op),
		      RADIANT_RADIO_OK_RC);
	zassert_not_null(chained_fs(CMD_PROP_RX_ADV));
	finish_last();

	zassert_equal(arm_rx(RF_OTHER, radiant_radio_now() + 2000u, &op),
		      RADIANT_RADIO_OK_RC);
	zassert_is_null(chained_fs(CMD_PROP_RX_ADV), "already on rf 66");
	finish_last();

	zassert_equal(arm_rx(RADIANT_RF_INDEX_ANT_PLUS, radiant_radio_now() + 2000u, &op),
		      RADIANT_RADIO_OK_RC);
	fs = chained_fs(CMD_PROP_RX_ADV);
	zassert_not_null(fs, "back to rf 57 retunes");
	zassert_equal(fs->fs_frequency, 2457u);
}

/* The same for transmits. */
ZTEST(radiant_backend_cc26xx_arm, test_tx_retune)
{
	const struct fake_rf_op_snap *fs;
	const struct fake_rf_op_snap *tx;
	uint32_t op = 0u;

	zassert_equal(arm_tx(RF_OTHER, radiant_radio_now() + 2000u, &op),
		      RADIANT_RADIO_OK_RC);
	fs = chained_fs(CMD_PROP_TX_ADV);
	zassert_not_null(fs, "rf 66 must retune");
	zassert_equal(fs->fs_frequency, radiant_rf_index_to_mhz(RF_OTHER));
	tx = fake_rf_find_op(fake_rf_last(), CMD_PROP_TX_ADV);
	zassert_true((int32_t)(tx->start_time - fs->start_time) > 0,
		     "the FS starts ahead of the TX");
	finish_last();
	zassert_equal(cc_probe()->tx[0].status, RADIANT_RADIO_STATUS_OK);

	zassert_equal(arm_tx(RF_OTHER, radiant_radio_now() + 2000u, &op),
		      RADIANT_RADIO_OK_RC);
	zassert_is_null(chained_fs(CMD_PROP_TX_ADV), "already on rf 66");
	finish_last();

	zassert_equal(arm_tx(RADIANT_RF_INDEX_ANT_PLUS, radiant_radio_now() + 2000u, &op),
		      RADIANT_RADIO_OK_RC);
	fs = chained_fs(CMD_PROP_TX_ADV);
	zassert_not_null(fs, "back to rf 57 retunes");
	zassert_equal(fs->fs_frequency, 2457u);
}

/* rf_index above RADIANT_RF_INDEX_MAX: EINVAL, nothing posted, *op cleared,
 * the slot left free - receive and transmit. */
ZTEST(radiant_backend_cc26xx_arm, test_rf_index_above_max_einval)
{
	const uint32_t posted = fake_rf.n_cmds;
	uint32_t op = 0xDEADBEEFu;

	zassert_equal(arm_rx(RADIANT_RF_INDEX_MAX + 1u, radiant_radio_now() + 2000u, &op),
		      RADIANT_RADIO_EINVAL);
	zassert_equal(op, 0u);
	zassert_equal(fake_rf.n_cmds, posted, "nothing posted");
	zassert_equal(cc_kind(), 0);

	op = 0xDEADBEEFu;
	zassert_equal(arm_tx(RADIANT_RF_INDEX_MAX + 1u, radiant_radio_now() + 2000u, &op),
		      RADIANT_RADIO_EINVAL);
	zassert_equal(op, 0u);
	zassert_equal(fake_rf.n_cmds, posted, "nothing posted");
	zassert_equal(cc_kind(), 0);

	/* The top of the range is a channel like any other. */
	zassert_equal(arm_rx(RADIANT_RF_INDEX_MAX, radiant_radio_now() + 2000u, &op),
		      RADIANT_RADIO_OK_RC);
	zassert_equal(chained_fs(CMD_PROP_RX_ADV)->fs_frequency,
		      radiant_rf_index_to_mhz(RADIANT_RF_INDEX_MAX));
}

/* The synthesiser is credited with rf 66 only once the chained FS ran: an
 * arm aborted before it started, or one whose FS failed, leaves the next arm
 * on rf 66 retuning again. */
ZTEST(radiant_backend_cc26xx_arm, test_retune_credited_only_when_fs_ran)
{
	struct fake_rf_cmd *c;
	uint32_t op = 0u;

	/* Aborted before the RF core reached it: the FS never ran. */
	zassert_equal(arm_rx(RF_OTHER, radiant_radio_now() + 2000u, &op),
		      RADIANT_RADIO_OK_RC);
	zassert_not_null(chained_fs(CMD_PROP_RX_ADV));
	zassert_equal(radiant_radio_abort(), RADIANT_RADIO_OK_RC);
	(void)fake_rf_deliver_pending();

	zassert_equal(arm_rx(RF_OTHER, radiant_radio_now() + 2000u, &op),
		      RADIANT_RADIO_OK_RC);
	zassert_not_null(chained_fs(CMD_PROP_RX_ADV), "the FS never ran: retune");

	/* This time the chain ended, but the FS reported a synth error. */
	c = fake_rf_last();
	fake_rf_complete(c->cmd.ch, PROP_DONE_RXTIMEOUT, RF_EventLastCmdDone);
	c->chain[0].op->status = ERROR_SYNTH_PROG;

	zassert_equal(arm_rx(RF_OTHER, radiant_radio_now() + 2000u, &op),
		      RADIANT_RADIO_OK_RC);
	zassert_not_null(chained_fs(CMD_PROP_RX_ADV), "the FS failed: retune");
	finish_last();

	zassert_equal(arm_rx(RF_OTHER, radiant_radio_now() + 2000u, &op),
		      RADIANT_RADIO_OK_RC);
	zassert_is_null(chained_fs(CMD_PROP_RX_ADV), "that one ran");
}

/* disable/enable starts over on the default channel: enable's blocking CMD_FS
 * is again a lone FS at 2457 (no chain left over from a retune), and rf 66
 * needs a retune again. */
ZTEST(radiant_backend_cc26xx_arm, test_retune_reset_by_reenable)
{
	const struct fake_rf_cmd *run;
	uint32_t op = 0u;

	zassert_equal(arm_rx(RF_OTHER, radiant_radio_now() + 2000u, &op),
		      RADIANT_RADIO_OK_RC);
	zassert_not_null(chained_fs(CMD_PROP_RX_ADV));
	finish_last();

	zassert_equal(radiant_radio_disable(), RADIANT_RADIO_OK_RC);
	zassert_equal(radiant_radio_enable(), RADIANT_RADIO_OK_RC);
	run = fake_rf_nth(fake_rf.n_cmds - 1u);
	zassert_not_null(run);
	zassert_equal(run->via, FAKE_RF_RUN);
	zassert_equal(run->n_chain, 1u, "a lone FS");
	zassert_equal(run->chain[0].command_no, CMD_FS);
	zassert_equal(run->chain[0].fs_frequency, 2457u);
	zassert_equal(run->chain[0].trigger_type, TRIG_NOW);

	zassert_equal(arm_rx(RF_OTHER, radiant_radio_now() + 2000u, &op),
		      RADIANT_RADIO_OK_RC);
	zassert_not_null(chained_fs(CMD_PROP_RX_ADV), "re-enable is back on rf 57");
}

/* A retune owes its settling time: an arm that is fine on the tuned channel
 * is ETIME on another when the FS could not finish first. */
ZTEST(radiant_backend_cc26xx_arm, test_retune_too_close_etime)
{
	const uint32_t posted = fake_rf.n_cmds;
	uint32_t op = 0xDEADBEEFu;

	zassert_equal(arm_rx(RF_OTHER, radiant_radio_now() + 300u, &op),
		      RADIANT_RADIO_ETIME);
	zassert_equal(op, 0u);
	zassert_equal(fake_rf.n_cmds, posted, "nothing posted");
	zassert_equal(cc_kind(), 0);
	zassert_equal(arm_rx(RADIANT_RF_INDEX_ANT_PLUS, radiant_radio_now() + 300u, &op),
		      RADIANT_RADIO_OK_RC, "no retune, no settling owed");
	finish_last();

	op = 0xDEADBEEFu;
	zassert_equal(arm_tx(RF_OTHER, radiant_radio_now() + 450u, &op),
		      RADIANT_RADIO_ETIME);
	zassert_equal(op, 0u);
	zassert_equal(cc_kind(), 0);
	zassert_equal(arm_tx(RADIANT_RF_INDEX_ANT_PLUS, radiant_radio_now() + 450u, &op),
		      RADIANT_RADIO_OK_RC, "no retune, no settling owed");
}

/* A transmit's start trigger has pastTrig = 0: a start the RF core reaches
 * late ends the command (ERROR_PAST_START) instead of sending late. */
ZTEST(radiant_backend_cc26xx_arm, test_tx_past_trig_off)
{
	uint32_t op = 0u;

	zassert_equal(arm_tx(RADIANT_RF_INDEX_ANT_PLUS, radiant_radio_now() + 2000u, &op),
		      RADIANT_RADIO_OK_RC);
	zassert_false(fake_rf_find_op(fake_rf_last(), CMD_PROP_TX_ADV)->past_trig);

	/* With a retune too: the FS may start late, the TX may not. */
	finish_last();
	zassert_equal(arm_tx(RF_OTHER, radiant_radio_now() + 2000u, &op),
		      RADIANT_RADIO_OK_RC);
	zassert_false(fake_rf_find_op(fake_rf_last(), CMD_PROP_TX_ADV)->past_trig);
}

/* A transmit whose start (t_sync less preamble, address and ramp-up) is
 * already inside the arm floor is ETIME, never posted to go out late with
 * an exact t_sync. t_sync itself is past the old t_sync-only floor. */
ZTEST(radiant_backend_cc26xx_arm, test_tx_start_inside_floor_etime)
{
	const uint32_t posted = fake_rf.n_cmds;
	uint32_t op = 0xDEADBEEFu;

	zassert_equal(arm_tx(RADIANT_RF_INDEX_ANT_PLUS, radiant_radio_now() + 200u, &op),
		      RADIANT_RADIO_ETIME);
	zassert_equal(op, 0u);
	zassert_equal(fake_rf.n_cmds, posted, "nothing posted");
	zassert_equal(cc_probe()->tx_events, 0u);
	zassert_equal(cc_kind(), 0);
}

/* Operation ids skip 0 on wrap: 0 means "no operation". */
ZTEST(radiant_backend_cc26xx_arm, test_op_id_skips_zero)
{
	uint32_t op = 0u;

	cc_set_next_op_id(UINT32_MAX);
	zassert_equal(arm_rx(RADIANT_RF_INDEX_ANT_PLUS, radiant_radio_now() + 2000u, &op),
		      RADIANT_RADIO_OK_RC);
	zassert_equal(op, UINT32_MAX);
	finish_last();

	zassert_equal(arm_tx(RADIANT_RF_INDEX_ANT_PLUS, radiant_radio_now() + 2000u, &op),
		      RADIANT_RADIO_OK_RC);
	zassert_not_equal(op, 0u, "the wrap must skip 0");
	zassert_equal(op, cc_op_id());
	finish_last();
	zassert_equal(cc_probe()->tx[0].op, op);
	zassert_not_equal(cc_probe()->tx[0].op, 0u);
}

/* Every failed arm leaves *op == 0, whatever the refusal. */
ZTEST(radiant_backend_cc26xx_arm, test_failed_arm_clears_op)
{
	struct radiant_rx_req req;
	struct radiant_rx_filter filt;
	uint32_t op;

	op = 0xDEADBEEFu;   /* ETIME */
	zassert_equal(arm_tx(RADIANT_RF_INDEX_ANT_PLUS, radiant_radio_now() + 10u, &op),
		      RADIANT_RADIO_ETIME);
	zassert_equal(op, 0u);

	op = 0xDEADBEEFu;   /* EINVAL (window backwards) */
	cc_rx_req(&req, &filt, radiant_radio_now() + 2000u, 1000u);
	req.t_close = req.t_open - 1u;
	zassert_equal(radiant_radio_rx(&req, &op), RADIANT_RADIO_EINVAL);
	zassert_equal(op, 0u);

	op = 0xDEADBEEFu;   /* EDENIED (driver refusal) */
	fake_rf.refuse_posts = 1u;
	zassert_equal(arm_rx(RADIANT_RF_INDEX_ANT_PLUS, radiant_radio_now() + 2000u, &op),
		      RADIANT_RADIO_EDENIED);
	zassert_equal(op, 0u);
	op = 0xDEADBEEFu;
	fake_rf.refuse_posts = 1u;
	zassert_equal(arm_tx(RADIANT_RF_INDEX_ANT_PLUS, radiant_radio_now() + 2000u, &op),
		      RADIANT_RADIO_EDENIED);
	zassert_equal(op, 0u);

	op = 0xDEADBEEFu;   /* EBUSY */
	zassert_equal(arm_rx(RADIANT_RF_INDEX_ANT_PLUS, radiant_radio_now() + 2000u, &op),
		      RADIANT_RADIO_OK_RC);
	op = 0xDEADBEEFu;
	zassert_equal(arm_tx(RADIANT_RF_INDEX_ANT_PLUS, radiant_radio_now() + 4000u, &op),
		      RADIANT_RADIO_EBUSY);
	zassert_equal(op, 0u);
	op = 0xDEADBEEFu;
	zassert_equal(arm_rx(RADIANT_RF_INDEX_ANT_PLUS, radiant_radio_now() + 4000u, &op),
		      RADIANT_RADIO_EBUSY);
	zassert_equal(op, 0u);
	finish_last();

	op = 0xDEADBEEFu;   /* ESTATE */
	zassert_equal(radiant_radio_disable(), RADIANT_RADIO_OK_RC);
	zassert_equal(arm_tx(RADIANT_RF_INDEX_ANT_PLUS, radiant_radio_now() + 2000u, &op),
		      RADIANT_RADIO_ESTATE);
	zassert_equal(op, 0u);
}

/* The CMD_FS is one static struct shared by every chain. A chain aborted while
 * its FS ran can have that FS finish afterwards and write DONE_OK over the
 * status of a later chain's FS that never ran (that chain was cancelled before
 * the RF core reached it). The later channel must not be credited from it:
 * the synthesiser is on the earlier one. (Review 2026-11-19, finding 2.) */
ZTEST(radiant_backend_cc26xx_arm, test_retune_not_credited_from_stale_fs_status)
{
	struct fake_rf_cmd *c;
	rfc_radioOp_t *fs;
	uint32_t op = 0u;

	/* A: a retune to 66, aborted. */
	zassert_equal(arm_rx(RF_OTHER, radiant_radio_now() + 2000u, &op),
		      RADIANT_RADIO_OK_RC);
	zassert_not_null(chained_fs(CMD_PROP_RX_ADV));
	c = fake_rf_last();
	fs = c->chain[0].op;
	zassert_equal(radiant_radio_abort(), RADIANT_RADIO_OK_RC);
	(void)fake_rf_deliver_pending();

	/* B: a retune to 70, cancelled before the RF core reached it. */
	zassert_equal(arm_rx(70u, radiant_radio_now() + 2000u, &op),
		      RADIANT_RADIO_OK_RC);
	zassert_not_null(chained_fs(CMD_PROP_RX_ADV));
	zassert_equal_ptr(fake_rf_last()->chain[0].op, fs, "one shared fs_cmd");
	zassert_equal(radiant_radio_abort(), RADIANT_RADIO_OK_RC);
	(void)fake_rf_deliver_pending();

	/* A's FS completes late, into the shared struct. */
	fs->status = DONE_OK;

	zassert_equal(arm_rx(70u, radiant_radio_now() + 2000u, &op),
		      RADIANT_RADIO_OK_RC);
	zassert_not_null(chained_fs(CMD_PROP_RX_ADV),
			 "B's operation never ran, so neither did its FS: retune");
}

/* Transmit at dbm, complete it, and return the PA value the backend set. */
static uint32_t tx_power_raw(int8_t dbm)
{
	struct radiant_tx_req req;
	struct fake_rf_cmd *c;
	uint32_t op = 0u;

	cc_tx_req(&req, body8, radiant_radio_now() + 2000u);
	req.power.dbm = dbm;
	zassert_equal(radiant_radio_tx(&req, &op), RADIANT_RADIO_OK_RC);
	c = fake_rf_last();
	zassert_not_null(c);
	fake_rf_complete(c->cmd.ch, PROP_DONE_OK, RF_EventLastCmdDone);
	zassert_equal(cc_kind(), 0);
	return fake_rf.last_tx_power.rawValue;
}

/*
 * TODO.md "Backend drift" item 6: an off-table dBm lands on the nearest
 * radiant_cc26xx_txp[] entry, as nRF's apply_power() does. TI's
 * RF_TxPowerTable_findValue() rounded down (-6 went out at -10, -12 at -15)
 * and refused below the first entry, so -40 kept the previous power. The
 * expected values are the table's own rows (radiant_radio_cc26xx.c).
 */
ZTEST(radiant_backend_cc26xx_arm, test_tx_power_rounds_to_nearest_entry)
{
	const RF_TxPowerTable_Value m20 = RF_TxPowerTable_DEFAULT_PA_ENTRY(6, 3, 0, 2);
	const RF_TxPowerTable_Value m10 = RF_TxPowerTable_DEFAULT_PA_ENTRY(15, 3, 0, 5);
	const RF_TxPowerTable_Value m5 = RF_TxPowerTable_DEFAULT_PA_ENTRY(22, 3, 0, 9);
	const RF_TxPowerTable_Value z0 = RF_TxPowerTable_DEFAULT_PA_ENTRY(19, 1, 0, 20);
	const RF_TxPowerTable_Value p5 = RF_TxPowerTable_DEFAULT_PA_ENTRY(23, 0, 0, 57);

	zassert_equal(tx_power_raw(0), z0.rawValue, "on the table");
	zassert_equal(tx_power_raw(-6), m5.rawValue, "-6 dBm: -5 is nearest, not -10");
	zassert_equal(tx_power_raw(-12), m10.rawValue, "-12 dBm: -10 is nearest, not -15");
	zassert_equal(tx_power_raw(0), z0.rawValue);
	zassert_equal(tx_power_raw(-40), m20.rawValue,
		      "below the table: clamps to -20, not the previous 0 dBm");
	zassert_equal(tx_power_raw(20), p5.rawValue, "above the table: clamps to +5");
}
```

## src/test_review2.c
```c
/* SPDX-License-Identifier: Apache-2.0 */
/*
 * Review 2026-11-19 (second pass) findings 1, 3 and 4:
 *  - a refused arm that chained a retune leaves the shared CMD_FS on the new
 *    channel, which the driver may cache and replay at power-up, so the
 *    backend must stop trusting its tuned channel;
 *  - an operation claimed (abort) while its arm is still inside the post call
 *    has no handle yet: the backend must never pass NO_HANDLE (-1, the
 *    driver's RF_CMDHANDLE_FLUSH_ALL) to a cancel, and must cancel the real
 *    handle once known;
 *  - an operation whose terminal arrived inside the post call must not leave
 *    its handle behind in the slot.
 */
#include <zephyr/ztest.h>

#include <ti/drivers/rf/RF.h>
#include <driverlib/rf_prop_mailbox.h>

#include <radiant/radiant_radio_hal.h>

#include "backend_cc26xx_probe.h"

static void before(void *fixture)
{
	ARG_UNUSED(fixture);
	cc_reset(true);
}

ZTEST_SUITE(radiant_backend_cc26xx_review2, NULL, NULL, before, NULL, NULL);

static int arm_rx(uint8_t rf, uint32_t *op)
{
	struct radiant_rx_req req;
	struct radiant_rx_filter filt;

	cc_rx_req(&req, &filt, radiant_radio_now() + 2000u, 1000u);
	req.rf_index = rf;
	return radiant_radio_rx(&req, op);
}

/* Finding 1: refused retune to 66, then an arm back on 57 must chain an FS
 * (the CMD_FS struct the driver may have cached now says 2466). */
ZTEST(radiant_backend_cc26xx_review2, test_refused_retune_forces_fs_next_arm)
{
	const struct fake_rf_op_snap *fs;
	uint32_t op = 0u;

	fake_rf.refuse_posts = 1u;
	zassert_equal(arm_rx(66u, &op), RADIANT_RADIO_EDENIED);
	zassert_equal(cc_kind(), 0);

	zassert_equal(arm_rx(RADIANT_RF_INDEX_ANT_PLUS, &op), RADIANT_RADIO_OK_RC);
	fs = fake_rf_find_op(fake_rf_last(), CMD_FS);
	zassert_not_null(fs, "the refused retune left CMD_FS on 2466: re-tune");
	zassert_equal(fs->fs_frequency,
		      radiant_rf_index_to_mhz(RADIANT_RF_INDEX_ANT_PLUS));
}

static void abort_in_post(RF_CmdHandle ch)
{
	ARG_UNUSED(ch);
	fake_rf.on_post = NULL;
	(void)radiant_radio_abort();
}

/* Finding 3: abort() lands while the arm is inside RF_postCmd. */
ZTEST(radiant_backend_cc26xx_review2, test_abort_mid_post_cancels_real_handle)
{
	struct fake_rf_cmd *c;
	uint32_t op = 0u;

	fake_rf.on_post = abort_in_post;
	zassert_equal(arm_rx(RADIANT_RF_INDEX_ANT_PLUS, &op), RADIANT_RADIO_OK_RC);
	c = fake_rf_last();
	zassert_not_null(c);

	zassert_equal(fake_rf.flush_all_calls, 0u, "never cancel handle -1");
	zassert_equal(cc_probe()->rx_events, 1u);
	zassert_equal(cc_probe()->rx[0].status, RADIANT_RADIO_STATUS_ABORTED);
	zassert_equal(cc_probe()->rx[0].op, op);
	zassert_true(c->cancel_calls > 0u, "the posted command is cancelled");
	zassert_equal(cc_kind(), 0);
	zassert_equal(cc_cmd_handle(), -1, "no handle left in the free slot");

	/* Its own cancel callback is retired: no second terminal. */
	fake_rf_deliver_pending();
	zassert_equal(cc_probe()->rx_events, 1u);

	/* The slot works afterwards. */
	zassert_equal(arm_rx(RADIANT_RF_INDEX_ANT_PLUS, &op), RADIANT_RADIO_OK_RC);
	c = fake_rf_last();
	fake_rf_start(c->cmd.ch);
	fake_rf_complete(c->cmd.ch, PROP_DONE_RXTIMEOUT, RF_EventLastCmdDone);
	zassert_equal(cc_probe()->rx_events, 2u);
	zassert_equal(cc_probe()->rx[1].status, RADIANT_RADIO_STATUS_TIMEOUT);
}

static void end_in_post(RF_CmdHandle ch)
{
	fake_rf_start(ch);
	fake_rf_complete(ch, PROP_DONE_RXTIMEOUT, RF_EventLastCmdDone);
}

/* Finding 4: the command's own terminal arrives inside RF_postCmd, twice in
 * a row. The first must not leave its handle in the slot, or the second's
 * early terminal looks foreign and is lost. */
ZTEST(radiant_backend_cc26xx_review2, test_terminal_mid_post_no_stale_handle)
{
	uint32_t op = 0u;

	fake_rf.on_post = end_in_post;
	zassert_equal(arm_rx(RADIANT_RF_INDEX_ANT_PLUS, &op), RADIANT_RADIO_OK_RC);
	zassert_equal(cc_probe()->rx_events, 1u);
	zassert_equal(cc_kind(), 0);
	zassert_equal(cc_cmd_handle(), -1, "no handle left in the free slot");

	zassert_equal(arm_rx(RADIANT_RF_INDEX_ANT_PLUS, &op), RADIANT_RADIO_OK_RC);
	zassert_equal(cc_probe()->rx_events, 2u, "second early terminal delivered");
	zassert_equal(cc_probe()->rx[1].status, RADIANT_RADIO_STATUS_TIMEOUT);
	zassert_equal(cc_probe()->rx[1].op, op);
	zassert_equal(cc_kind(), 0);
	fake_rf.on_post = NULL;
}
```

## src/test_review3.c
```c
/* SPDX-License-Identifier: Apache-2.0 */
/*
 * Review 2026-11-20 (third pass, commits ded8169..14c43e8):
 *  1. an operation claimed (abort) while its arm is still inside the post
 *     call is cancelled once its handle is known. That cancel must touch that
 *     one command only: the core may already have armed a replacement from
 *     the ABORTED terminal, and RF_flushCmd would cancel it too;
 *  2. a calibration above the preamble, address and ramp-up airtime (up to
 *     +300 against 198 us for a five-byte address) starts the transmit after
 *     t_sync. Clipping it to t_sync sends the frame early;
 *  3. the advertised arm leads must cover the transmit's own arm floor at
 *     every calibration Kconfig allows, or the scheduler arms at the lead
 *     and gets ETIME.
 */
#include <zephyr/ztest.h>

#include <ti/drivers/rf/RF.h>
#include <driverlib/rf_prop_mailbox.h>

#include <radiant/radiant_radio_hal.h>

#include "backend_cc26xx_probe.h"

static void before(void *fixture)
{
	ARG_UNUSED(fixture);
	cc_reset(true);
}

ZTEST_SUITE(radiant_backend_cc26xx_review3, NULL, NULL, before, NULL, NULL);

static int arm_rx(radiant_time_t t_open, uint32_t *op)
{
	struct radiant_rx_req req;
	struct radiant_rx_filter filt;

	cc_rx_req(&req, &filt, t_open, 1000u);
	return radiant_radio_rx(&req, op);
}

static uint32_t rearm_op;
static int rearm_rc;

static void abort_in_post(RF_CmdHandle ch)
{
	ARG_UNUSED(ch);
	fake_rf.on_post = NULL;
	(void)radiant_radio_abort();
}

/* The core re-arming from the ABORTED terminal, as a scheduler pass does. */
static void rearm_on_abort(const struct radiant_rx_event *evt)
{
	if (evt->status == RADIANT_RADIO_STATUS_ABORTED && rearm_op == 0u) {
		rearm_rc = arm_rx(radiant_radio_now() + 3000u, &rearm_op);
	}
}

/* Finding 1: abort() lands inside RF_postCmd and the core arms the next
 * window from its terminal before the first arm learns its handle. */
ZTEST(radiant_backend_cc26xx_review3, test_mid_post_cancel_spares_replacement)
{
	struct fake_rf_cmd *first;
	struct fake_rf_cmd *second;
	uint32_t op1 = 0u;
	const uint32_t n0 = fake_rf.n_cmds;  /* enable() ran its setup and FS */

	rearm_op = 0u;
	rearm_rc = -1;
	fake_rf.on_post = abort_in_post;
	cc_probe()->on_rx = rearm_on_abort;
	zassert_equal(arm_rx(radiant_radio_now() + 2000u, &op1),
		      RADIANT_RADIO_OK_RC);
	cc_probe()->on_rx = NULL;

	zassert_equal(rearm_rc, RADIANT_RADIO_OK_RC, "replacement armed");
	zassert_not_equal(rearm_op, 0u);
	zassert_equal(fake_rf.n_cmds, n0 + 2u);
	first = fake_rf_nth(n0);
	second = fake_rf_nth(n0 + 1u);
	zassert_true(first->cancel_calls > 0u, "the orphan is cancelled");
	zassert_false(first->cancel_flush, "cancel, not flush: later commands live");
	zassert_equal(second->cancel_calls, 0u, "the replacement is untouched");
	zassert_equal(cc_kind(), 1, "the replacement holds the slot");
	zassert_equal(cc_op_id(), rearm_op);
	zassert_equal(cc_cmd_handle(), second->cmd.ch);

	/* The orphan's Cancelled callback is retired, not the replacement's. */
	(void)fake_rf_deliver_pending();
	zassert_equal(cc_probe()->rx_events, 1u);
	zassert_equal(cc_kind(), 1);

	fake_rf_start(second->cmd.ch);
	fake_rf_complete(second->cmd.ch, PROP_DONE_RXTIMEOUT, RF_EventLastCmdDone);
	zassert_equal(cc_probe()->rx_events, 2u);
	zassert_equal(cc_probe()->rx[1].op, rearm_op);
	zassert_equal(cc_probe()->rx[1].status, RADIANT_RADIO_STATUS_TIMEOUT);
}

/* Every calibration the Kconfig range allows, its ends and the clamp edges
 * for a five-byte address (198 us of preamble, address and ramp-up). */
static const int32_t cals[] = { -300, -200, -1, 0, 1, 100, 197, 198, 199, 300 };

/* Finding 2: the start time keeps the sign of its offset. */
ZTEST(radiant_backend_cc26xx_review3, test_tx_start_keeps_positive_cal)
{
	const radiant_time_t t = 5000000u;

	zassert_equal(cc_tx_start_us(t, 5u, 100), t - 98u);
	zassert_equal(cc_tx_start_us(t, 5u, 198), t);
	zassert_equal(cc_tx_start_us(t, 5u, 300), t + 102u,
		      "a +300 calibration starts the command after t_sync");
	zassert_equal(cc_tx_start_us(t, 1u, 300), t + 134u);
	zassert_equal(cc_tx_start_us(t, 5u, -300), t - 498u);
}

/* Finding 3: no transmit the backend accepts needs more lead than it
 * advertises. A retune is covered by min_arm_lead_us; the in-grant lead
 * covers a same-channel follow-on (the reply, the next burst packet). */
ZTEST(radiant_backend_cc26xx_review3, test_tx_floor_within_advertised_lead)
{
	for (size_t i = 0u; i < ARRAY_SIZE(cals); i++) {
		for (uint8_t len = 1u; len <= RADIANT_RADIO_ADDR_MAX; len++) {
			const int32_t cal = cals[i];

			zassert_true(cc_tx_arm_floor_us(len, true, cal) <=
					     cc_min_arm_lead_us(cal),
				     "cal %d len %u retune: floor %u > lead %u",
				     cal, len, cc_tx_arm_floor_us(len, true, cal),
				     cc_min_arm_lead_us(cal));
			zassert_true(cc_tx_arm_floor_us(len, false, cal) <=
					     cc_in_grant_lead_us(cal),
				     "cal %d len %u: floor %u > in-grant %u",
				     cal, len, cc_tx_arm_floor_us(len, false, cal),
				     cc_in_grant_lead_us(cal));
		}
	}
	/* The floor is measured from t_sync, so a start after it costs nothing. */
	zassert_equal(cc_tx_arm_floor_us(5u, false, 300), 150u);
}

/* The leads the caps advertise are the ones the check above covered, and
 * the shipped calibration (+100) keeps the measured 600/400 (coex 1414/600). */
ZTEST(radiant_backend_cc26xx_review3, test_caps_leads_match_build)
{
	const struct radiant_radio_caps *caps = radiant_radio_caps_get();

	zassert_equal(caps->min_arm_lead_us, cc_min_arm_lead_us(cc_tx_cal_us()));
	zassert_equal(caps->min_arm_lead_in_grant_us,
		      cc_in_grant_lead_us(cc_tx_cal_us()));
#if defined(BACKEND_COEX)
	zassert_equal(cc_min_arm_lead_us(100), 1414u);
	zassert_equal(cc_in_grant_lead_us(100), 600u);
#else
	zassert_equal(cc_min_arm_lead_us(100), 600u);
	zassert_equal(cc_in_grant_lead_us(100), 400u);
#endif
	/* A -300 calibration needs 898 us ahead of a retuning transmit. */
	zassert_true(cc_min_arm_lead_us(-300) >= 898u);
}
```

## src/test_smoke.c
```c
/* SPDX-License-Identifier: Apache-2.0 */
/*
 * Smoke cases for the harness: the backend's ordinary paths against the fake
 * RF driver, green on the backend as it stands. They pin what the harness
 * itself can see (what was posted, what the core was told) so later suites
 * can build red-then-green cases on it.
 */

#include <string.h>

#include <zephyr/ztest.h>

#include <ti/drivers/rf/RF.h>
#include <driverlib/rf_prop_mailbox.h>
#include <rf_patches/rf_patch_cpe_prop.h>
#include <rf_patches/rf_patch_cpe_multi_protocol.h>

#include <radiant/radiant_radio_hal.h>

#include "backend_cc26xx_probe.h"

#if defined(BACKEND_COEX)
#define CC_VIA FAKE_RF_SCHEDULE
#else
#define CC_VIA FAKE_RF_POST
#endif

static void before(void *fixture)
{
	ARG_UNUSED(fixture);
	cc_reset(true);
}

ZTEST_SUITE(radiant_backend_cc26xx_smoke, NULL, NULL, before, NULL, NULL);

static const uint8_t body8[RADIANT_RADIO_BODY_MAX] = {
	0x10, 0x20, 0x30, 0x40, 0x50, 0x60, 0x70, 0x80, 0x90, 0xA0,
};

/* init + enable: one RF_open with the setup command and the patch the build
 * names, one blocking CMD_FS onto the default channel, nothing posted. */
ZTEST(radiant_backend_cc26xx_smoke, test_init_enable)
{
	const struct fake_rf_cmd *fs = fake_rf_nth(0);

	zassert_equal(fake_rf.opens, 1u);
	zassert_true(fake_rf.open);
	zassert_not_null(fake_rf.setup);
	zassert_equal(fake_rf.setup->prop_div_pa.commandNo, CMD_PROP_RADIO_DIV_SETUP);
	zassert_equal(fake_rf.params.nInactivityTimeout, UINT32_MAX);
#if defined(BACKEND_COEX)
	zassert_equal_ptr(fake_rf.mode->cpePatchFxn, rf_patch_cpe_multi_protocol);
#else
	zassert_equal_ptr(fake_rf.mode->cpePatchFxn, rf_patch_cpe_prop);
#endif

	zassert_equal(fake_rf.n_cmds, 1u, "only the CMD_FS ran");
	zassert_not_null(fs);
	zassert_equal(fs->via, FAKE_RF_RUN);
	zassert_equal(fs->chain[0].command_no, CMD_FS);
	zassert_equal(fs->chain[0].fs_frequency, 2457u);
	zassert_is_null(fake_rf_last(), "nothing posted");

	zassert_equal(cc_kind(), 0);
	zassert_equal(strcmp(radiant_radio_caps_get()->name, "cc26xx"), 0);
	/* now() reads the fake RAT: 4 ticks per microsecond. */
	zassert_equal(radiant_radio_now(), CC_RAT_START / 4u);
}

/* A receive: posted as one PROP_RX_ADV with absolute, pastTrig triggers
 * around the window; a frame in the window reaches the core with its body,
 * filter and t_sync; LastCmdDone ends it with TIMEOUT. */
ZTEST(radiant_backend_cc26xx_smoke, test_rx_frame_then_timeout)
{
	struct radiant_rx_req req;
	struct radiant_rx_filter filt;
	const radiant_time_t t_open = radiant_radio_now() + 2000u;
	const radiant_time_t t_frame = t_open + 300u;
	struct fake_rf_cmd *c;
	const struct fake_rf_op_snap *rx;
	uint8_t pl[RADIANT_RADIO_ADDR_MAX + RADIANT_RADIO_BODY_MAX + 2];
	uint8_t n;
	uint32_t op = 0u;

	cc_rx_req(&req, &filt, t_open, 1000u);
	zassert_equal(radiant_radio_rx(&req, &op), RADIANT_RADIO_OK_RC);
	zassert_equal(op, cc_op_id());
	zassert_equal(cc_kind(), 1);

	c = fake_rf_last();
	zassert_not_null(c);
	zassert_equal(c->via, CC_VIA);
	zassert_equal(c->cmd.ch, cc_cmd_handle());
	rx = fake_rf_find_op(c, CMD_PROP_RX_ADV);
	zassert_not_null(rx);
	zassert_equal(rx->trigger_type, TRIG_ABSTIME);
	zassert_true(rx->past_trig);
	zassert_true(rx->start_time < (uint32_t)(t_open * 4u), "listening before t_open");
	zassert_equal(rx->end_trigger_type, TRIG_ABSTIME);
	zassert_true(rx->end_time > (uint32_t)(req.t_close * 4u), "still listening at t_close");
	zassert_equal(rx->sync_word0,
		      ((uint32_t)cc_addr[0] << 16) | ((uint32_t)cc_addr[1] << 8) | cc_addr[2]);
	zassert_equal(rx->sync_word1, 0u, "one group: second correlator off");

	n = cc_payload(cc_addr, cc_hw_addr_len(), body8, false, pl);
	zassert_equal(fake_rf_rx_entry(c->cmd.ch, pl, n, -55, cc_rat_for_t_sync(t_frame), 0u), 0);
	fake_rf_advance_us(2300u);
	fake_rf_fire(c->cmd.ch, RF_EventRxEntryDone);

	zassert_equal(cc_probe()->rx_events, 1u);
	zassert_equal(cc_probe()->rx[0].status, RADIANT_RADIO_STATUS_OK);
	zassert_equal(cc_probe()->rx[0].op, op);
	zassert_equal(cc_probe()->rx[0].filter_index, 0u);
	zassert_equal(cc_probe()->rx[0].t_sync, t_frame);
	zassert_true(cc_probe()->rx[0].t_sync_exact);
	zassert_equal(cc_probe()->rx[0].body_len, cc_fmt()->body_len);
	zassert_mem_equal(cc_probe()->rx[0].body, body8, cc_fmt()->body_len);
	zassert_equal(cc_probe()->rx[0].rssi_dbm, -55);
	zassert_equal(cc_kind(), 1, "a frame does not end the window");

	fake_rf_complete(c->cmd.ch, PROP_DONE_RXTIMEOUT, RF_EventLastCmdDone);

	zassert_equal(cc_probe()->rx_events, 2u);
	zassert_equal(cc_probe()->rx[1].status, RADIANT_RADIO_STATUS_TIMEOUT);
	zassert_equal(cc_probe()->rx[1].op, op);
	zassert_equal(cc_kind(), 0);
	zassert_equal(strcmp(cc_probe()->order, "RR"), 0);
}

/* A frame whose CRC fails is dropped (no REPORT_CRC_FAIL), and one whose
 * software-compared address bytes differ is counted, not delivered. */
ZTEST(radiant_backend_cc26xx_smoke, test_rx_bad_frames_dropped)
{
	struct radiant_rx_req req;
	struct radiant_rx_filter filt;
	const radiant_time_t t_open = radiant_radio_now() + 2000u;
	uint8_t other[RADIANT_RADIO_ADDR_MAX];
	uint8_t pl[RADIANT_RADIO_ADDR_MAX + RADIANT_RADIO_BODY_MAX + 2];
	uint8_t n;
	uint32_t op;
	RF_CmdHandle ch;

	cc_rx_req(&req, &filt, t_open, 1000u);
	zassert_equal(radiant_radio_rx(&req, &op), RADIANT_RADIO_OK_RC);
	ch = fake_rf_last()->cmd.ch;

	n = cc_payload(cc_addr, cc_hw_addr_len(), body8, true, pl);
	zassert_equal(fake_rf_rx_entry(ch, pl, n, -60, cc_rat_for_t_sync(t_open + 100u), 0u), 0);
	memcpy(other, cc_addr, sizeof(other));
	other[RADIANT_RADIO_ADDR_MAX - 1] ^= 0xFFu;
	n = cc_payload(other, cc_hw_addr_len(), body8, false, pl);
	zassert_equal(fake_rf_rx_entry(ch, pl, n, -60, cc_rat_for_t_sync(t_open + 200u), 0u), 0);
	fake_rf_fire(ch, RF_EventRxEntryDone);

	zassert_equal(cc_probe()->rx_events, 0u);
	zassert_equal(cc_sw_addr_mismatch(), 1u);

	fake_rf_complete(ch, PROP_DONE_RXTIMEOUT, RF_EventLastCmdDone);
	zassert_equal(cc_probe()->rx_events, 1u);
	zassert_equal(cc_probe()->rx[0].status, RADIANT_RADIO_STATUS_TIMEOUT);
}

/* A transmit: one PROP_TX_ADV carrying the software address bytes, body and
 * CRC; LastCmdDone reports OK with the requested t_sync, exact. */
ZTEST(radiant_backend_cc26xx_smoke, test_tx_ok)
{
	struct radiant_tx_req req;
	const radiant_time_t t_sync = radiant_radio_now() + 2000u;
	struct fake_rf_cmd *c;
	const struct fake_rf_op_snap *tx;
	uint32_t op = 0u;

	cc_tx_req(&req, body8, t_sync);
	zassert_equal(radiant_radio_tx(&req, &op), RADIANT_RADIO_OK_RC);
	zassert_equal(cc_kind(), 2);

	c = fake_rf_last();
	zassert_not_null(c);
	zassert_equal(c->via, CC_VIA);
	tx = fake_rf_find_op(c, CMD_PROP_TX_ADV);
	zassert_not_null(tx);
	zassert_equal(tx->trigger_type, TRIG_ABSTIME);
	zassert_false(tx->past_trig, "a transmit never starts late");
	zassert_true(tx->start_time < (uint32_t)(t_sync * 4u), "starts before t_sync");
	zassert_equal(tx->pkt_len, (cc_fmt()->addr_len - cc_hw_addr_len()) +
				   cc_fmt()->body_len + 2u);
	zassert_equal(tx->sync_word,
		      ((uint32_t)cc_addr[0] << 16) | ((uint32_t)cc_addr[1] << 8) | cc_addr[2]);

	fake_rf_complete(c->cmd.ch, PROP_DONE_OK, RF_EventLastCmdDone);

	zassert_equal(cc_probe()->tx_events, 1u);
	zassert_equal(cc_probe()->tx[0].status, RADIANT_RADIO_STATUS_OK);
	zassert_equal(cc_probe()->tx[0].op, op);
	zassert_equal(cc_probe()->tx[0].t_sync, t_sync);
	zassert_true(cc_probe()->tx[0].t_sync_exact);
	zassert_equal(cc_kind(), 0);
}

/* abort(): ABORTED delivered synchronously, the flush recorded but its
 * callback still owed; delivering it later reaches no one, and the next arm
 * is taken and ends normally. */
ZTEST(radiant_backend_cc26xx_smoke, test_abort_rx)
{
	struct radiant_rx_req req;
	struct radiant_rx_filter filt;
	struct fake_rf_cmd *c;
	RF_CmdHandle ch;
	uint32_t op = 0u;
	uint32_t op2 = 0u;

	cc_rx_req(&req, &filt, radiant_radio_now() + 2000u, 1000u);
	zassert_equal(radiant_radio_rx(&req, &op), RADIANT_RADIO_OK_RC);
	ch = fake_rf_last()->cmd.ch;
	fake_rf_start(ch);

	zassert_equal(radiant_radio_abort(), RADIANT_RADIO_OK_RC);
	zassert_equal(cc_probe()->rx_events, 1u);
	zassert_equal(cc_probe()->rx[0].status, RADIANT_RADIO_STATUS_ABORTED);
	zassert_equal(cc_probe()->rx[0].op, op);
	zassert_equal(cc_kind(), 0);
	zassert_equal(fake_rf.flush_calls, 1u);
	zassert_equal(fake_rf_pending(), 1u, "the cancel callback is asynchronous");

	/* The next operation is armed before the old callback arrives. */
	cc_rx_req(&req, &filt, radiant_radio_now() + 2000u, 1000u);
	zassert_equal(radiant_radio_rx(&req, &op2), RADIANT_RADIO_OK_RC);
	zassert_not_equal(op2, op);

	zassert_equal(fake_rf_deliver_pending(), 1u);
	c = fake_rf_cmd(ch);
	zassert_true((c->fired & RF_EventCmdAborted) != 0u);
	zassert_equal(cc_probe()->rx_events, 1u, "the late cancel reached no one");
	zassert_equal(cc_kind(), 1, "the new window is still live");

	fake_rf_complete(fake_rf_last()->cmd.ch, PROP_DONE_RXTIMEOUT, RF_EventLastCmdDone);
	zassert_equal(cc_probe()->rx_events, 2u);
	zassert_equal(cc_probe()->rx[1].status, RADIANT_RADIO_STATUS_TIMEOUT);
	zassert_equal(cc_probe()->rx[1].op, op2);
}

ZTEST(radiant_backend_cc26xx_smoke, test_abort_tx)
{
	struct radiant_tx_req req;
	uint32_t op = 0u;

	cc_tx_req(&req, body8, radiant_radio_now() + 2000u);
	zassert_equal(radiant_radio_tx(&req, &op), RADIANT_RADIO_OK_RC);

	zassert_equal(radiant_radio_abort(), RADIANT_RADIO_OK_RC);
	zassert_equal(cc_probe()->tx_events, 1u);
	zassert_equal(cc_probe()->tx[0].status, RADIANT_RADIO_STATUS_ABORTED);
	zassert_equal(cc_probe()->tx[0].op, op);
	zassert_false(cc_probe()->tx[0].t_sync_exact);
	zassert_equal(fake_rf_pending(), 1u);

	zassert_equal(fake_rf_deliver_pending(), 1u);
	zassert_equal(cc_probe()->tx_events, 1u);
	zassert_equal(cc_kind(), 0);
}

/* The arm refusals the harness can drive: too late (ETIME, nothing posted)
 * and a driver refusal (EDENIED, the slot left free). */
ZTEST(radiant_backend_cc26xx_smoke, test_arm_refusals)
{
	struct radiant_tx_req req;
	uint32_t op;
	const uint32_t posted = fake_rf.n_cmds;

	cc_tx_req(&req, body8, radiant_radio_now() + 10u);
	zassert_equal(radiant_radio_tx(&req, &op), RADIANT_RADIO_ETIME);
	zassert_equal(fake_rf.n_cmds, posted);

	fake_rf.refuse_posts = 1u;
	cc_tx_req(&req, body8, radiant_radio_now() + 2000u);
	zassert_equal(radiant_radio_tx(&req, &op), RADIANT_RADIO_EDENIED);
	zassert_equal(fake_rf.refusals, 1u);
	zassert_equal(cc_kind(), 0);

	zassert_equal(radiant_radio_tx(&req, &op), RADIANT_RADIO_OK_RC);
}

/* ------------------------------------------------------------------------
 * HAL item 5: window edges, lifecycle and request error codes
 * ------------------------------------------------------------------------
 */

/* t_sync always lies in [t_open, t_close]: the receiver runs early and late,
 * so a frame one microsecond before t_open is dropped in software (and
 * counted where the 0xF7 counters are built); one at exactly t_close is
 * delivered. */
ZTEST(radiant_backend_cc26xx_smoke, test_rx_window_edges)
{
	struct radiant_rx_req req;
	struct radiant_rx_filter filt;
	const radiant_time_t t_open = radiant_radio_now() + 2000u;
	uint8_t pl[RADIANT_RADIO_ADDR_MAX + RADIANT_RADIO_BODY_MAX + 2];
	const uint32_t drops0 = cc_window_drops();
	uint32_t op = 0u;
	uint8_t n;
	RF_CmdHandle ch;

	cc_rx_req(&req, &filt, t_open, 1000u);
	zassert_equal(radiant_radio_rx(&req, &op), RADIANT_RADIO_OK_RC);
	ch = fake_rf_last()->cmd.ch;

	n = cc_payload(cc_addr, cc_hw_addr_len(), body8, false, pl);
	zassert_equal(fake_rf_rx_entry(ch, pl, n, -55, cc_rat_for_t_sync(t_open - 1u), 0u), 0);
	zassert_equal(fake_rf_rx_entry(ch, pl, n, -55, cc_rat_for_t_sync(req.t_close), 0u), 0);
	fake_rf_fire(ch, RF_EventRxEntryDone);

	zassert_equal(cc_probe()->rx_events, 1u, "only the frame at t_close");
	zassert_equal(cc_probe()->rx[0].status, RADIANT_RADIO_STATUS_OK);
	zassert_equal(cc_probe()->rx[0].t_sync, req.t_close);
	zassert_true(cc_probe()->rx[0].t_sync_exact);
	if (cc_diag_built()) {
		zassert_equal(cc_window_drops() - drops0, 1u);
	}
	zassert_equal(cc_kind(), 1);
}

/* init: a missing table or callback is EINVAL; a second init without a
 * fresh boot is ESTATE and leaves the open radio and the live operation
 * alone (it used to memset the state, losing the RF handle). abort: ESTATE
 * before init, OK after init with nothing armed. */
ZTEST(radiant_backend_cc26xx_smoke, test_init_and_abort_lifecycle_codes)
{
	struct radiant_rx_req req;
	struct radiant_rx_filter filt;
	uint32_t op = 0u;

	cc_rx_req(&req, &filt, radiant_radio_now() + 2000u, 1000u);
	zassert_equal(radiant_radio_rx(&req, &op), RADIANT_RADIO_OK_RC);
	zassert_equal(cc_init_call(3), RADIANT_RADIO_ESTATE);
	zassert_true(cc_rf_open(), "a second init dropped the RF handle");
	zassert_equal(cc_kind(), 1, "a second init dropped the live window");
	zassert_equal(cc_op_id(), op);

	cc_forget_init();
	zassert_equal(radiant_radio_abort(), RADIANT_RADIO_ESTATE);
	zassert_equal(cc_init_call(0), RADIANT_RADIO_EINVAL);
	zassert_equal(cc_init_call(1), RADIANT_RADIO_EINVAL);
	zassert_equal(cc_init_call(2), RADIANT_RADIO_EINVAL);
	zassert_equal(cc_init_call(3), RADIANT_RADIO_OK_RC);
	zassert_equal(radiant_radio_abort(), RADIANT_RADIO_OK_RC);
}

/* A NULL format or a zero body is malformed (EINVAL), not a format this
 * backend cannot express (ENOTSUP), on both arm calls. */
ZTEST(radiant_backend_cc26xx_smoke, test_malformed_format_is_einval)
{
	struct radiant_rx_req rx;
	struct radiant_rx_filter filt;
	struct radiant_tx_req tx;
	struct radiant_pkt_format empty = *cc_fmt();
	uint32_t op = 1u;

	empty.body_len = 0u;

	cc_rx_req(&rx, &filt, radiant_radio_now() + 2000u, 1000u);
	rx.fmt = NULL;
	zassert_equal(radiant_radio_rx(&rx, &op), RADIANT_RADIO_EINVAL);
	zassert_equal(op, 0u);
	rx.fmt = &empty;
	zassert_equal(radiant_radio_rx(&rx, &op), RADIANT_RADIO_EINVAL);

	cc_tx_req(&tx, body8, radiant_radio_now() + 2000u);
	tx.fmt = NULL;
	zassert_equal(radiant_radio_tx(&tx, &op), RADIANT_RADIO_EINVAL);
	tx.fmt = &empty;
	tx.body_len = 0u;
	zassert_equal(radiant_radio_tx(&tx, &op), RADIANT_RADIO_EINVAL);
	zassert_equal(cc_kind(), 0);
	zassert_is_null(fake_rf_last(), "nothing posted");
}

/* A window longer than a non-zero caps.max_window_us is ENOTSUP, refused
 * before anything reaches the RF driver's scheduler. Only the coex build
 * advertises a ceiling; the plain build takes the same window. */
ZTEST(radiant_backend_cc26xx_smoke, test_window_over_the_ceiling)
{
	struct radiant_rx_req req;
	struct radiant_rx_filter filt;
	const uint32_t max = radiant_radio_caps_get()->max_window_us;
	const uint32_t posted = fake_rf.n_cmds;
	uint32_t op = 1u;

#if defined(BACKEND_COEX)
	zassert_equal(max, 20000u);
	cc_rx_req(&req, &filt, radiant_radio_now() + 3000u, max + 1u);
	zassert_equal(radiant_radio_rx(&req, &op), RADIANT_RADIO_ENOTSUP);
	zassert_equal(op, 0u);
	zassert_equal(fake_rf.n_cmds, posted, "the over-long window was posted");
	zassert_equal(cc_kind(), 0);
	cc_rx_req(&req, &filt, radiant_radio_now() + 3000u, max);
	zassert_equal(radiant_radio_rx(&req, &op), RADIANT_RADIO_OK_RC);
#else
	zassert_equal(max, 0u);
	ARG_UNUSED(posted);
	cc_rx_req(&req, &filt, radiant_radio_now() + 3000u, 50000u);
	zassert_equal(radiant_radio_rx(&req, &op), RADIANT_RADIO_OK_RC);
#endif
}
```
