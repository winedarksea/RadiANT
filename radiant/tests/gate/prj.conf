## CMakeLists.txt
```
# SPDX-License-Identifier: Apache-2.0
#
# The MPSL gate unit-test application.
#
# ── Why this is a third application ──────────────────────────────────────────
#
# radiant/src/radiant_radio_nrf_gate_mpsl.c had no test coverage of any
# kind, and it is the one file in the project whose failure mode is PERMANENT
# AND SILENT: a skipped radiant_nrf_gate_on_grant_end() leaves the 802.15.4
# driver's write-once SUBSCRIBE_RXEN swapped out for the rest of the boot.
#
# It cannot be a suite in ../src. That application selects
# CONFIG_RADIANT_BACKEND_NONE and compiles ../fake_radio.c as the HAL, and
# the gate is part of the NRF backend - so putting it there would mean either
# building the whole nRF backend (which defines the same eight HAL entry points
# fake_radio.c does, a duplicate-symbol link error) or compiling the gate beside
# a backend it is a seam inside of. This application does neither: it compiles
# the gate against fakes for MPSL and for the five radiant_nrf_gate_* callbacks,
# so the gate is the only production code in the image.
#
# The parent's glob does not reach in here and this one does not reach out
# there, which is what keeps the three link images separate. CI's
# `twister -T app/radiant/tests` walks subdirectories, so testcase.yaml
# here is picked up with no workflow edit, and scripts\run_ztest_hw.ps1 derives
# its build directory from the application's leaf name, so
# `-App radiant\tests\gate` needs no script edit either.

cmake_minimum_required(VERSION 3.20.0)

# Two levels up: the module root is radiant/, this is radiant/tests/gate.
list(APPEND ZEPHYR_EXTRA_MODULES "${CMAKE_CURRENT_SOURCE_DIR}/../..")

find_package(Zephyr REQUIRED HINTS $ENV{ZEPHYR_BASE})
project(radiant_gate_tests)

# Same glob rule as the other two applications: a new suite is a new file in
# src/ and this file does not change.
file(GLOB suite_sources CONFIGURE_DEPENDS "${CMAKE_CURRENT_SOURCE_DIR}/src/*.c")
target_sources(app PRIVATE ${suite_sources})

# ── The file under test ─────────────────────────────────────────────────────
#
# NOT radiant_radio_nrf_gate_mpsl.c directly. gate_under_test.c #includes it, so
# that the suite can read the static counters the invariant is carried by -
# g.hw_held and stats.late_disarm are the whole of A1 and A2 and neither has any
# other observable. See the header of gate_under_test.c for why that is better
# than an accessor behind #ifdef CONFIG_ZTEST in the production file.
#
# It must stay the ONLY translation unit that includes it, or the statics exist
# twice and the suites silently test two different gates.
target_sources(app PRIVATE "${CMAKE_CURRENT_SOURCE_DIR}/gate_under_test.c")

# The arbiter and the backend, both fake. See fake_mpsl.h.
target_sources(app PRIVATE "${CMAKE_CURRENT_SOURCE_DIR}/fake_mpsl.c")

# The software-interrupt trampoline, also fake. The gate defers through it
# instead of calling k_work_submit()/k_timer_start() itself (bug 27), so without
# this the image does not link - which is the point: a future edit that reaches
# for the kernel directly from the signal callback has to delete a fake to do
# it. src/radiant_swi.c is not compiled here; it claims a real NVIC line.
target_sources(app PRIVATE "${CMAKE_CURRENT_SOURCE_DIR}/fake_swi.c")

# The mock radio, shared with the other two applications rather than copied. It
# is the HAL implementation for this image, and here it serves one further
# purpose: radiant_radio_now() is the gate's timebase and radiant_radio_abort()
# is what SIGNAL_EXTEND_FAILED calls, so the mock's counters are how the suite
# proves that path aborted the armed operation rather than only claiming to.
target_sources(app PRIVATE "${CMAKE_CURRENT_SOURCE_DIR}/../fake_radio.c")

# ── The fake headers, and the one thing to know about them ──────────────────
#
# fakes/ is listed FIRST and it SHADOWS three system headers for this target:
# <mpsl_timeslot.h>, <mpsl_hwres.h>, <nrf_errno.h> and <hal/nrf_timer.h>. That
# is deliberate and it is contained: CMake places a target's own include
# directories ahead of those it inherits from linked libraries, and the
# radiant module is a separate CMake target that never sees this directory.
# Nothing outside this application compiles against these headers.
#
# The shadow of hal/nrf_timer.h is the one that earns its keep: MPSL_TIMER0
# becomes a register model in RAM whose counter a test can move, which is what
# makes BUG 9's race - the counter overtaking the compare between the write and
# the re-read - a two-line setup instead of a coin toss.
target_include_directories(app BEFORE PRIVATE
  "${CMAKE_CURRENT_SOURCE_DIR}/fakes")

# This directory for fake_mpsl.h / gate_probe.h, and the parent for
# fake_radio.h - the same spelling the other two applications' suites use.
#
# ../../src is radiant/src, for radiant_radio_nrf_gate.h. The module's own
# zephyr_include_directories() puts radiant/include and the APPLICATION's
# src/ on the path, not its own - the gate interface is internal to the module
# by design (see its header: no MPSL type or symbol appears above the backend),
# so a consumer would have no business including it and this application is not
# a consumer.
target_include_directories(app PRIVATE
  "${CMAKE_CURRENT_SOURCE_DIR}"
  "${CMAKE_CURRENT_SOURCE_DIR}/.."
  "${CMAKE_CURRENT_SOURCE_DIR}/../../src")
```

## prj.conf
```kconfig
# SPDX-License-Identifier: Apache-2.0
#
# Configuration for the MPSL gate unit-test application.
#
# Deliberately minimal, and in particular there is NO CONFIG_MPSL here. The
# whole point of this application is that the gate is compiled against
# radiant/tests/gate/fakes/mpsl_timeslot.h and driven signal by signal from
# a test; a real MPSL in the image would bring a real arbiter, a real timeslot
# session and a real TIMER, and the signal sequences this suite exists to inject
# would be whatever the arbiter felt like producing.

CONFIG_ZTEST=y

# The module, consumed as a module. BACKEND_NONE because ../fake_radio.c is the
# HAL implementation for this image - the gate is a seam inside the NRF backend,
# and building that backend here would be a second definition of all eight HAL
# entry points. No CONFIG_RADIANT_ANTR_API line, for the same reason
# ../prj.conf gives.
CONFIG_RADIANT=y
CONFIG_RADIANT_BACKEND_NONE=y

# The gate registers a log module and logs its session_open rc, which is the one
# diagnostic that names the CONFIG_MPSL_TIMESLOT_SESSION_COUNT=0 trap. Kept at
# WRN so the run's own output is ztest's and not the gate's.
CONFIG_LOG=y
CONFIG_RADIANT_LOG_LEVEL_WRN=y

# Nothing here turns on a periodic log instrument: in a run whose output is
# parsed for ztest's own lines it is noise. (The gate dump this note used to
# name went with the SWEEP_DEBUG instrument when P3/P4 concluded.)

# The suite drives the gate from the ztest thread and the gate defers every MPSL
# call and every call into the core to a work queue, so both threads are real.
CONFIG_MAIN_STACK_SIZE=4096
CONFIG_ZTEST_STACK_SIZE=4096

# ADR 0018 candidate (d2), two timeslot sessions: on, as on every MPSL build.
# The fake arbiter grants one session unless a test asks for two
# (fake_mpsl_set_max_sessions()), so every case in test_gate.c runs against the
# d2 gate's single-session fallback - master's gate - and test_gate_d2.c runs
# the two-session paths.
CONFIG_RADIANT_GATE_MPSL_D2=y
# The suite reads the bench counters (gate_probe).
CONFIG_RADIANT_GATE_MPSL_STATS=y
```

## src/test_gate_ext_skip.c
```c
/* SPDX-License-Identifier: Apache-2.0 */
/*
 * The gate stops asking for extensions the arbiter keeps refusing (ADR 0021,
 * decision 3). MPSL ASSERT 69:108 has only ever followed an EXTEND_FAILED
 * beside a Thread stack, so the gate takes that request away once it is plainly
 * not going to be granted.
 *
 * What these pin:
 *   - after three refusals in a row the next grants end at their first compare,
 *     with no ACTION_EXTEND, and the skip lapses after a fixed number of grants;
 *   - one granted extension breaks a run of refusals;
 *   - a grant placed while skipping asks only for the fixed end margin, and
 *     that margin is the grant's own: it can never reach ACTION_EXTEND, even if
 *     the skip lapses while it runs;
 *   - gate_init() forgets the whole thing.
 *
 * Every case runs on one session: the skip is not tied to the booking design.
 */

#include <stdbool.h>
#include <stdint.h>

#include <zephyr/kernel.h>
#include <zephyr/ztest.h>

#include <mpsl_timeslot.h>

#include "radiant_radio_nrf_gate.h"

#include "../../fake_radio.h"
#include "../fake_mpsl.h"
#include "../fake_swi.h"
#include "../gate_probe.h"

#define WORK_MS 20

#define LEAD_US  500000u
#define SHORT_US 5000u
#define CHUNK_US 40000u

/* Pinned, as test_gate.c pins them. A 5 ms elastic window's request is
 * head 250 + window 5000 + tail 250 + end margin: 7500 with the extension
 * margin, 6250 with the fixed one. A chunk long enough to be clamped asks for
 * the first bite, and its compare sits one margin before the end of it. */
#define SHORT_EXTEND_LEN_US 7500u
#define SHORT_FIXED_LEN_US  6250u
#define BITE_US             10000u
#define BITE_EXTEND_CC_US   8000u
#define BITE_FIXED_CC_US    9250u

/* The policy, pinned: how many refusals switch it on and how long it lasts. */
#define RUN_OFF     3u
#define SKIP_GRANTS 64u

static struct gate_probe p;

static void init_gate(void)
{
	zassert_equal(RADIANT_RADIO_OK_RC, gate_init(), "gate_init failed");
	zassert_true(fake_mpsl_is_open(), "no session was opened");
	k_msleep(WORK_MS);
	zassert_equal(MPSL_TIMESLOT_SIGNAL_ACTION_END,
		      fake_mpsl_signal(MPSL_TIMESLOT_SIGNAL_START),
		      "the bootstrap slot was not handed straight back");
}

static void before(void *fixture)
{
	ARG_UNUSED(fixture);

	gate_shutdown();
	k_msleep(WORK_MS);
	fake_radio_bring_up();
	fake_mpsl_reset();
	fake_backend_reset();
	fake_swi_reset();
	gate_probe_reset_elastic();
	init_gate();
}

static void after(void *fixture)
{
	ARG_UNUSED(fixture);
	gate_shutdown();
	k_msleep(WORK_MS);
}

ZTEST_SUITE(radiant_gate_ext_skip, NULL, NULL, before, after, NULL);

static void assert_invariant(void)
{
	gate_probe_read(&p);
	zassert_equal(p.granted, p.grant_end_calls, "a hand-back was missed");
	zassert_false(p.hw_held, "the radio is still on loan");
	zassert_equal(0u, fake_mpsl_viol_end_when_ended(), "ended twice");
	zassert_equal(0u, fake_mpsl_viol_action_no_slot(), "action outside a slot");
	zassert_equal(0u, fake_mpsl_viol_low_prio_action(), "action from low priority");
}

/* Place an elastic window and take the grant. Returns the length asked for. */
static uint32_t elastic_grant(uint32_t win_us)
{
	radiant_time_t from = radiant_radio_now() + LEAD_US;

	zassert_equal(GATE_PENDING,
		      gate_acquire(GATE_OP_RX, from, from + win_us, 0u,
				   RADIANT_GATE_PRIO_NORMAL),
		      "the window was refused");
	k_msleep(WORK_MS);
	zassert_equal(MPSL_TIMESLOT_SIGNAL_ACTION_NONE,
		      fake_mpsl_signal(MPSL_TIMESLOT_SIGNAL_START), NULL);
	return fake_mpsl_last_request()->params.normal.length_us;
}

/* One grant whose extension is refused. */
static void refused_grant(void)
{
	(void)elastic_grant(CHUNK_US);
	zassert_equal(MPSL_TIMESLOT_SIGNAL_ACTION_EXTEND,
		      fake_mpsl_signal(MPSL_TIMESLOT_SIGNAL_TIMER0),
		      "the chain should still be asking");
	zassert_equal(MPSL_TIMESLOT_SIGNAL_ACTION_END,
		      fake_mpsl_signal(MPSL_TIMESLOT_SIGNAL_EXTEND_FAILED), NULL);
	k_msleep(WORK_MS);
}

static void refused_run(void)
{
	for (uint32_t i = 0u; i < RUN_OFF; i++) {
		refused_grant();
	}
}

/* A grant the gate must end at its first compare without asking. */
static void skipped_grant(uint32_t i)
{
	(void)elastic_grant(CHUNK_US);
	zassert_equal(MPSL_TIMESLOT_SIGNAL_ACTION_END,
		      fake_mpsl_signal(MPSL_TIMESLOT_SIGNAL_TIMER0),
		      "skipped grant %u asked for an extension", i);
	k_msleep(WORK_MS);
}

ZTEST(radiant_gate_ext_skip, test_a_run_of_refusals_stops_the_asking)
{
	refused_run();
	skipped_grant(0u);
	gate_probe_read(&p);
	zassert_equal(RUN_OFF, p.extends_failed,
		      "a skipped grant was counted as a refusal");
	assert_invariant();
}

ZTEST(radiant_gate_ext_skip, test_the_skip_lapses_after_its_grants)
{
	refused_run();
	/* Every one of them, the last included: a grant sized for no extension
	 * must not ask for one because the skip ran out while it was live. */
	for (uint32_t i = 0u; i < SKIP_GRANTS; i++) {
		skipped_grant(i);
	}
	(void)elastic_grant(CHUNK_US);
	zassert_equal(MPSL_TIMESLOT_SIGNAL_ACTION_EXTEND,
		      fake_mpsl_signal(MPSL_TIMESLOT_SIGNAL_TIMER0),
		      "the gate did not ask again once the skip lapsed");
	zassert_equal(MPSL_TIMESLOT_SIGNAL_ACTION_END,
		      fake_mpsl_signal(MPSL_TIMESLOT_SIGNAL_EXTEND_FAILED), NULL);
	k_msleep(WORK_MS);
	assert_invariant();
}

ZTEST(radiant_gate_ext_skip, test_a_granted_extension_breaks_the_run)
{
	refused_grant();
	refused_grant();

	(void)elastic_grant(CHUNK_US);
	zassert_equal(MPSL_TIMESLOT_SIGNAL_ACTION_EXTEND,
		      fake_mpsl_signal(MPSL_TIMESLOT_SIGNAL_TIMER0), NULL);
	zassert_equal(MPSL_TIMESLOT_SIGNAL_ACTION_NONE,
		      fake_mpsl_signal(MPSL_TIMESLOT_SIGNAL_EXTEND_SUCCEEDED), NULL);
	gate_release();
	zassert_equal(MPSL_TIMESLOT_SIGNAL_ACTION_END,
		      fake_mpsl_signal(MPSL_TIMESLOT_SIGNAL_TIMER0), NULL);
	k_msleep(WORK_MS);

	refused_grant();
	(void)elastic_grant(CHUNK_US);
	zassert_equal(MPSL_TIMESLOT_SIGNAL_ACTION_EXTEND,
		      fake_mpsl_signal(MPSL_TIMESLOT_SIGNAL_TIMER0),
		      "a granted extension did not break the run of refusals");
	zassert_equal(MPSL_TIMESLOT_SIGNAL_ACTION_END,
		      fake_mpsl_signal(MPSL_TIMESLOT_SIGNAL_EXTEND_FAILED), NULL);
	k_msleep(WORK_MS);
	assert_invariant();
}

ZTEST(radiant_gate_ext_skip, test_a_skipped_grant_asks_for_the_fixed_margin)
{
	uint32_t len;

	len = elastic_grant(SHORT_US);
	zassert_equal(SHORT_EXTEND_LEN_US, len,
		      "an elastic window outside a skip lost its extension margin");
	gate_release();
	zassert_equal(MPSL_TIMESLOT_SIGNAL_ACTION_END,
		      fake_mpsl_signal(MPSL_TIMESLOT_SIGNAL_TIMER0), NULL);
	k_msleep(WORK_MS);

	refused_run();

	len = elastic_grant(SHORT_US);
	zassert_equal(SHORT_FIXED_LEN_US, len,
		      "a grant that will never extend paid the extension margin");
	gate_probe_read(&p);
	zassert_equal(750u, p.end_margin_us, NULL);
	gate_release();
	zassert_equal(MPSL_TIMESLOT_SIGNAL_ACTION_END,
		      fake_mpsl_signal(MPSL_TIMESLOT_SIGNAL_TIMER0), NULL);
	k_msleep(WORK_MS);
	assert_invariant();
}

ZTEST(radiant_gate_ext_skip, test_a_skipped_grant_keeps_listening_to_its_own_margin)
{
	uint32_t len;

	len = elastic_grant(CHUNK_US);
	zassert_equal(BITE_US, len, NULL);
	zassert_equal(BITE_EXTEND_CC_US, fake_mpsl_timer0.cc[0],
		      "the extendable grant's compare moved");
	zassert_equal(MPSL_TIMESLOT_SIGNAL_ACTION_EXTEND,
		      fake_mpsl_signal(MPSL_TIMESLOT_SIGNAL_TIMER0), NULL);
	zassert_equal(MPSL_TIMESLOT_SIGNAL_ACTION_END,
		      fake_mpsl_signal(MPSL_TIMESLOT_SIGNAL_EXTEND_FAILED), NULL);
	k_msleep(WORK_MS);
	refused_grant();
	refused_grant();

	len = elastic_grant(CHUNK_US);
	zassert_equal(BITE_US, len, NULL);
	zassert_equal(BITE_FIXED_CC_US, fake_mpsl_timer0.cc[0],
		      "a skipped grant's compare is not its own margin");
	zassert_equal(MPSL_TIMESLOT_SIGNAL_ACTION_END,
		      fake_mpsl_signal(MPSL_TIMESLOT_SIGNAL_TIMER0), NULL);
	k_msleep(WORK_MS);
	assert_invariant();
}

ZTEST(radiant_gate_ext_skip, test_gate_init_forgets_the_skip)
{
	refused_run();

	gate_shutdown();
	k_msleep(WORK_MS);
	fake_mpsl_reset();
	fake_backend_reset();
	init_gate();

	(void)elastic_grant(CHUNK_US);
	zassert_equal(MPSL_TIMESLOT_SIGNAL_ACTION_EXTEND,
		      fake_mpsl_signal(MPSL_TIMESLOT_SIGNAL_TIMER0),
		      "the skip survived gate_init()");
	zassert_equal(MPSL_TIMESLOT_SIGNAL_ACTION_END,
		      fake_mpsl_signal(MPSL_TIMESLOT_SIGNAL_EXTEND_FAILED), NULL);
	k_msleep(WORK_MS);
	assert_invariant();
}
```

## src/test_gate_signal_context.c
```c
/* SPDX-License-Identifier: Apache-2.0 */
/*
 * gate_in_signal() means "this is the zero-latency callback". A low-priority
 * signal runs in MPSL's cooperative thread, so a completion raised while one is
 * running must not be routed to the single-producer ring: that context is a
 * second producer, and the trampoline can preempt it and see the flag set.
 */

#include <stdbool.h>
#include <stdint.h>

#include <zephyr/kernel.h>
#include <zephyr/ztest.h>

#include <mpsl_timeslot.h>
#include <nrf_errno.h>

#include "radiant_radio_nrf_gate.h"

#include "../../fake_radio.h"
#include "../fake_mpsl.h"
#include "../fake_swi.h"

#define WORK_MS 20

static void before(void *fixture)
{
	ARG_UNUSED(fixture);

	gate_shutdown();
	k_msleep(WORK_MS);
	fake_radio_bring_up();
	fake_mpsl_reset();
	fake_backend_reset();
	fake_swi_reset();
	zassert_equal(RADIANT_RADIO_OK_RC, gate_init(), NULL);
	k_msleep(WORK_MS);
	zassert_equal(MPSL_TIMESLOT_SIGNAL_ACTION_END,
		      fake_mpsl_signal(MPSL_TIMESLOT_SIGNAL_START), NULL);
	k_msleep(WORK_MS);
	fake_swi_reset();
}

static void after(void *fixture)
{
	ARG_UNUSED(fixture);
	gate_shutdown();
	k_msleep(WORK_MS);
}

ZTEST_SUITE(radiant_gate_signal_context, NULL, NULL, before, after, NULL);

static void place(void)
{
	radiant_time_t from = radiant_radio_now() + 500000u;

	zassert_equal(GATE_PENDING,
		      gate_acquire(GATE_OP_RX, from, from + 1000u, 0u,
				   RADIANT_GATE_PRIO_HIGH), NULL);
	k_msleep(WORK_MS);
	fake_swi_reset();
}

ZTEST(radiant_gate_signal_context, test_a_high_priority_signal_is_the_signal_context)
{
	place();
	(void)fake_mpsl_signal(MPSL_TIMESLOT_SIGNAL_START);
	zassert_true(fake_swi()->pends_in_signal > 0u,
		     "START pended nothing from inside the signal context");
	gate_release();
	(void)fake_mpsl_signal(MPSL_TIMESLOT_SIGNAL_TIMER0);
	k_msleep(WORK_MS);
}

ZTEST(radiant_gate_signal_context, test_a_refusal_is_not_the_signal_context)
{
	place();
	(void)fake_mpsl_signal(MPSL_TIMESLOT_SIGNAL_BLOCKED);
	zassert_true(fake_swi()->pends > 0u, "BLOCKED pended no denial");
	zassert_equal(0u, fake_swi()->pends_in_signal,
		      "a low-priority signal claimed the zero-latency context");
	k_msleep(WORK_MS);
}

ZTEST(radiant_gate_signal_context, test_session_idle_is_not_the_signal_context)
{
	/* A deferred request is what SESSION_IDLE re-pends. */
	fake_mpsl_force_request_rc(-NRF_EAGAIN, 1u);
	place();
	(void)fake_mpsl_signal(MPSL_TIMESLOT_SIGNAL_SESSION_IDLE);
	zassert_true(fake_swi()->pends > 0u, "SESSION_IDLE re-pended nothing");
	zassert_equal(0u, fake_swi()->pends_in_signal,
		      "a low-priority signal claimed the zero-latency context");
	k_msleep(WORK_MS);
}
```
