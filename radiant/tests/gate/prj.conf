## CMakeLists.txt
```
# SPDX-License-Identifier: Apache-2.0
#
# The MPSL gate unit-test application.
#
# ── Why this is a third application ──────────────────────────────────────────
#
# radiant/src/radiant_radio_nrf_gate_mpsl.c had no test coverage of any
# kind, and it is the one file in the project whose failure mode is PERMANENT
# AND SILENT: a skipped radiant_nrf_gate_on_grant_end() leaves the 802.15.4
# driver's write-once SUBSCRIBE_RXEN swapped out for the rest of the boot.
#
# It cannot be a suite in ../src. That application selects
# CONFIG_RADIANT_BACKEND_NONE and compiles ../fake_radio.c as the HAL, and
# the gate is part of the NRF backend - so putting it there would mean either
# building the whole nRF backend (which defines the same eight HAL entry points
# fake_radio.c does, a duplicate-symbol link error) or compiling the gate beside
# a backend it is a seam inside of. This application does neither: it compiles
# the gate against fakes for MPSL and for the five radiant_nrf_gate_* callbacks,
# so the gate is the only production code in the image.
#
# The parent's glob does not reach in here and this one does not reach out
# there, which is what keeps the three link images separate. CI's
# `twister -T app/radiant/tests` walks subdirectories, so testcase.yaml
# here is picked up with no workflow edit, and scripts\run_ztest_hw.ps1 derives
# its build directory from the application's leaf name, so
# `-App radiant\tests\gate` needs no script edit either.

cmake_minimum_required(VERSION 3.20.0)

# Two levels up: the module root is radiant/, this is radiant/tests/gate.
list(APPEND ZEPHYR_EXTRA_MODULES "${CMAKE_CURRENT_SOURCE_DIR}/../..")

find_package(Zephyr REQUIRED HINTS $ENV{ZEPHYR_BASE})
project(radiant_gate_tests)

# Same glob rule as the other two applications: a new suite is a new file in
# src/ and this file does not change.
file(GLOB suite_sources CONFIGURE_DEPENDS "${CMAKE_CURRENT_SOURCE_DIR}/src/*.c")
target_sources(app PRIVATE ${suite_sources})

# ── The file under test ─────────────────────────────────────────────────────
#
# NOT radiant_radio_nrf_gate_mpsl.c directly. gate_under_test.c #includes it, so
# that the suite can read the static counters the invariant is carried by -
# g.hw_held and stats.late_disarm are the whole of A1 and A2 and neither has any
# other observable. See the header of gate_under_test.c for why that is better
# than an accessor behind #ifdef CONFIG_ZTEST in the production file.
#
# It must stay the ONLY translation unit that includes it, or the statics exist
# twice and the suites silently test two different gates.
target_sources(app PRIVATE "${CMAKE_CURRENT_SOURCE_DIR}/gate_under_test.c")

# -DGATE_LP=1 (scenario radiant.gate.lp): the same gate with
# CONFIG_RADIANT_NRF_LOW_POWER defined for this application's sources only
# (the gate, the fakes, the suites), so its two low-power hooks are compiled
# in and the fake backend records them (power plan pass B6). Every other
# suite runs against that build too. Not a Kconfig line: the symbol depends
# on a real nRF backend, which this image does not have.
if(GATE_LP)
  target_compile_definitions(app PRIVATE CONFIG_RADIANT_NRF_LOW_POWER=1 GATE_LP=1)
endif()

# The arbiter and the backend, both fake. See fake_mpsl.h.
target_sources(app PRIVATE "${CMAKE_CURRENT_SOURCE_DIR}/fake_mpsl.c")

# The software-interrupt trampoline, also fake. The gate defers through it
# instead of calling k_work_submit()/k_timer_start() itself (bug 27), so without
# this the image does not link - which is the point: a future edit that reaches
# for the kernel directly from the signal callback has to delete a fake to do
# it. src/radiant_swi.c is not compiled here; it claims a real NVIC line.
target_sources(app PRIVATE "${CMAKE_CURRENT_SOURCE_DIR}/fake_swi.c")

# The mock radio, shared with the other two applications rather than copied. It
# is the HAL implementation for this image, and here it serves one further
# purpose: radiant_radio_now() is the gate's timebase and radiant_radio_abort()
# is what SIGNAL_EXTEND_FAILED calls, so the mock's counters are how the suite
# proves that path aborted the armed operation rather than only claiming to.
target_sources(app PRIVATE "${CMAKE_CURRENT_SOURCE_DIR}/../fake_radio.c")

# ── The fake headers, and the one thing to know about them ──────────────────
#
# fakes/ is listed FIRST and it SHADOWS three system headers for this target:
# <mpsl_timeslot.h>, <mpsl_hwres.h>, <nrf_errno.h> and <hal/nrf_timer.h>. That
# is deliberate and it is contained: CMake places a target's own include
# directories ahead of those it inherits from linked libraries, and the
# radiant module is a separate CMake target that never sees this directory.
# Nothing outside this application compiles against these headers.
#
# The shadow of hal/nrf_timer.h is the one that earns its keep: MPSL_TIMER0
# becomes a register model in RAM whose counter a test can move, which is what
# makes BUG 9's race - the counter overtaking the compare between the write and
# the re-read - a two-line setup instead of a coin toss.
target_include_directories(app BEFORE PRIVATE
  "${CMAKE_CURRENT_SOURCE_DIR}/fakes")

# This directory for fake_mpsl.h / gate_probe.h, and the parent for
# fake_radio.h - the same spelling the other two applications' suites use.
#
# ../../src is radiant/src, for radiant_radio_nrf_gate.h. The module's own
# zephyr_include_directories() puts radiant/include and the APPLICATION's
# src/ on the path, not its own - the gate interface is internal to the module
# by design (see its header: no MPSL type or symbol appears above the backend),
# so a consumer would have no business including it and this application is not
# a consumer.
target_include_directories(app PRIVATE
  "${CMAKE_CURRENT_SOURCE_DIR}"
  "${CMAKE_CURRENT_SOURCE_DIR}/.."
  "${CMAKE_CURRENT_SOURCE_DIR}/../../src")
```

## prj.conf
```kconfig
# SPDX-License-Identifier: Apache-2.0
#
# Configuration for the MPSL gate unit-test application.
#
# Deliberately minimal, and in particular there is NO CONFIG_MPSL here. The
# whole point of this application is that the gate is compiled against
# radiant/tests/gate/fakes/mpsl_timeslot.h and driven signal by signal from
# a test; a real MPSL in the image would bring a real arbiter, a real timeslot
# session and a real TIMER, and the signal sequences this suite exists to inject
# would be whatever the arbiter felt like producing.

CONFIG_ZTEST=y

# The module, consumed as a module. BACKEND_NONE because ../fake_radio.c is the
# HAL implementation for this image - the gate is a seam inside the NRF backend,
# and building that backend here would be a second definition of all eight HAL
# entry points. No CONFIG_RADIANT_ANT_API line, for the same reason
# ../prj.conf gives.
CONFIG_RADIANT=y
CONFIG_RADIANT_BACKEND_NONE=y

# The gate registers a log module and logs its session_open rc, which is the one
# diagnostic that names the CONFIG_MPSL_TIMESLOT_SESSION_COUNT=0 trap. Kept at
# WRN so the run's own output is ztest's and not the gate's.
CONFIG_LOG=y
CONFIG_RADIANT_LOG_LEVEL_WRN=y

# Nothing here turns on a periodic log instrument: in a run whose output is
# parsed for ztest's own lines it is noise. (The gate dump this note used to
# name went with the SWEEP_DEBUG instrument when P3/P4 concluded.)

# The suite drives the gate from the ztest thread and the gate defers every MPSL
# call and every call into the core to a work queue, so both threads are real.
CONFIG_MAIN_STACK_SIZE=4096
CONFIG_ZTEST_STACK_SIZE=4096

# ADR 0018 candidate (d2), two timeslot sessions: on, as on every MPSL build.
# The fake arbiter grants one session unless a test asks for two
# (fake_mpsl_set_max_sessions()), so every case in test_gate.c runs against the
# d2 gate's single-session fallback - master's gate - and test_gate_d2.c runs
# the two-session paths.
CONFIG_RADIANT_GATE_MPSL_D2=y
# The suite reads the bench counters (gate_probe).
CONFIG_RADIANT_GATE_MPSL_STATS=y
```

## src/test_gate_caps_parity.c
```c
/* SPDX-License-Identifier: Apache-2.0 */
/*
 * The MPSL gate's share of the nRF caps (its placement lead and window
 * ceiling) equals radiant/tests/common/caps_presets.h, which the backend's
 * own parity test (radiant/tests/backend/src/test_caps_parity.c) composes
 * with the hardware lead. TODO "Backend drift" item 7.
 */

#include <zephyr/ztest.h>

#include "radiant_radio_nrf_gate.h"

#include "../../common/caps_presets.h"

ZTEST_SUITE(radiant_gate_caps_parity, NULL, NULL, NULL, NULL, NULL);

ZTEST(radiant_gate_caps_parity, test_gate_lead_and_window_match_the_preset_table)
{
	zassert_equal(CAPS_PRESET_MPSL_GATE_LEAD_US, gate_min_arm_lead_us());
	zassert_equal(CAPS_PRESET_MPSL_MAX_WINDOW_US, gate_max_window_us());
}
```

## src/test_gate_ext_skip.c
```c
/* SPDX-License-Identifier: Apache-2.0 */
/*
 * The gate stops asking for extensions the arbiter keeps refusing (ADR 0021,
 * decision 3). MPSL ASSERT 69:108 has only ever followed an EXTEND_FAILED
 * beside a Thread stack, so the gate takes that request away once it is plainly
 * not going to be granted.
 *
 * What these pin:
 *   - after three refusals in a row the next grants end at their first compare,
 *     with no ACTION_EXTEND, and the skip lapses after a fixed number of grants;
 *   - one granted extension breaks a run of refusals;
 *   - a grant placed while skipping asks only for the fixed end margin, and
 *     that margin is the grant's own: it can never reach ACTION_EXTEND, even if
 *     the skip lapses while it runs;
 *   - gate_init() forgets the whole thing.
 *
 * Every case runs on one session: the skip is not tied to the booking design.
 */

#include <stdbool.h>
#include <stdint.h>

#include <zephyr/kernel.h>
#include <zephyr/ztest.h>

#include <mpsl_timeslot.h>

#include "radiant_radio_nrf_gate.h"

#include "../../fake_radio.h"
#include "../fake_mpsl.h"
#include "../fake_swi.h"
#include "../gate_probe.h"

#define WORK_MS 20

#define LEAD_US  500000u
#define SHORT_US 5000u
#define CHUNK_US 40000u

/* Pinned, as test_gate.c pins them. A 5 ms elastic window's request is
 * head 250 + window 5000 + tail 250 + end margin: 7500 with the extension
 * margin, 6250 with the fixed one. A chunk long enough to be clamped asks for
 * the first bite, and its compare sits one margin before the end of it. */
#define SHORT_EXTEND_LEN_US 7500u
#define SHORT_FIXED_LEN_US  6250u
#define BITE_US             10000u
#define BITE_EXTEND_CC_US   8000u
#define BITE_FIXED_CC_US    9250u

/* The policy, pinned: how many refusals switch it on and how long it lasts. */
#define RUN_OFF     3u
#define SKIP_GRANTS 64u

static struct gate_probe p;

static void init_gate(void)
{
	zassert_equal(RADIANT_RADIO_OK_RC, gate_init(), "gate_init failed");
	zassert_true(fake_mpsl_is_open(), "no session was opened");
	k_msleep(WORK_MS);
	zassert_equal(MPSL_TIMESLOT_SIGNAL_ACTION_END,
		      fake_mpsl_signal(MPSL_TIMESLOT_SIGNAL_START),
		      "the bootstrap slot was not handed straight back");
}

static void before(void *fixture)
{
	ARG_UNUSED(fixture);

	gate_shutdown();
	k_msleep(WORK_MS);
	fake_radio_bring_up();
	fake_mpsl_reset();
	fake_backend_reset();
	fake_swi_reset();
	gate_probe_reset_elastic();
	init_gate();
}

static void after(void *fixture)
{
	ARG_UNUSED(fixture);
	gate_shutdown();
	k_msleep(WORK_MS);
}

ZTEST_SUITE(radiant_gate_ext_skip, NULL, NULL, before, after, NULL);

static void assert_invariant(void)
{
	gate_probe_read(&p);
	zassert_equal(p.granted, p.grant_end_calls, "a hand-back was missed");
	zassert_false(p.hw_held, "the radio is still on loan");
	zassert_equal(0u, fake_mpsl_viol_end_when_ended(), "ended twice");
	zassert_equal(0u, fake_mpsl_viol_action_no_slot(), "action outside a slot");
	zassert_equal(0u, fake_mpsl_viol_low_prio_action(), "action from low priority");
}

/* Place an elastic window and take the grant. Returns the length asked for. */
static uint32_t elastic_grant(uint32_t win_us)
{
	radiant_time_t from = radiant_radio_now() + LEAD_US;

	zassert_equal(GATE_PENDING,
		      gate_acquire(GATE_OP_RX, from, from + win_us, 0u,
				   RADIANT_GATE_PRIO_NORMAL),
		      "the window was refused");
	k_msleep(WORK_MS);
	zassert_equal(MPSL_TIMESLOT_SIGNAL_ACTION_NONE,
		      fake_mpsl_signal(MPSL_TIMESLOT_SIGNAL_START), NULL);
	return fake_mpsl_last_request()->params.normal.length_us;
}

/* One grant whose extension is refused. */
static void refused_grant(void)
{
	(void)elastic_grant(CHUNK_US);
	zassert_equal(MPSL_TIMESLOT_SIGNAL_ACTION_EXTEND,
		      fake_mpsl_signal(MPSL_TIMESLOT_SIGNAL_TIMER0),
		      "the chain should still be asking");
	zassert_equal(MPSL_TIMESLOT_SIGNAL_ACTION_END,
		      fake_mpsl_signal(MPSL_TIMESLOT_SIGNAL_EXTEND_FAILED), NULL);
	k_msleep(WORK_MS);
}

static void refused_run(void)
{
	for (uint32_t i = 0u; i < RUN_OFF; i++) {
		refused_grant();
	}
}

/* A grant the gate must end at its first compare without asking. */
static void skipped_grant(uint32_t i)
{
	(void)elastic_grant(CHUNK_US);
	zassert_equal(MPSL_TIMESLOT_SIGNAL_ACTION_END,
		      fake_mpsl_signal(MPSL_TIMESLOT_SIGNAL_TIMER0),
		      "skipped grant %u asked for an extension", i);
	k_msleep(WORK_MS);
}

ZTEST(radiant_gate_ext_skip, test_a_run_of_refusals_stops_the_asking)
{
	refused_run();
	skipped_grant(0u);
	gate_probe_read(&p);
	zassert_equal(RUN_OFF, p.extends_failed,
		      "a skipped grant was counted as a refusal");
	assert_invariant();
}

ZTEST(radiant_gate_ext_skip, test_the_skip_lapses_after_its_grants)
{
	refused_run();
	/* Every one of them, the last included: a grant sized for no extension
	 * must not ask for one because the skip ran out while it was live. */
	for (uint32_t i = 0u; i < SKIP_GRANTS; i++) {
		skipped_grant(i);
	}
	(void)elastic_grant(CHUNK_US);
	zassert_equal(MPSL_TIMESLOT_SIGNAL_ACTION_EXTEND,
		      fake_mpsl_signal(MPSL_TIMESLOT_SIGNAL_TIMER0),
		      "the gate did not ask again once the skip lapsed");
	zassert_equal(MPSL_TIMESLOT_SIGNAL_ACTION_END,
		      fake_mpsl_signal(MPSL_TIMESLOT_SIGNAL_EXTEND_FAILED), NULL);
	k_msleep(WORK_MS);
	assert_invariant();
}

ZTEST(radiant_gate_ext_skip, test_a_granted_extension_breaks_the_run)
{
	refused_grant();
	refused_grant();

	(void)elastic_grant(CHUNK_US);
	zassert_equal(MPSL_TIMESLOT_SIGNAL_ACTION_EXTEND,
		      fake_mpsl_signal(MPSL_TIMESLOT_SIGNAL_TIMER0), NULL);
	zassert_equal(MPSL_TIMESLOT_SIGNAL_ACTION_NONE,
		      fake_mpsl_signal(MPSL_TIMESLOT_SIGNAL_EXTEND_SUCCEEDED), NULL);
	gate_release();
	zassert_equal(MPSL_TIMESLOT_SIGNAL_ACTION_END,
		      fake_mpsl_signal(MPSL_TIMESLOT_SIGNAL_TIMER0), NULL);
	k_msleep(WORK_MS);

	refused_grant();
	(void)elastic_grant(CHUNK_US);
	zassert_equal(MPSL_TIMESLOT_SIGNAL_ACTION_EXTEND,
		      fake_mpsl_signal(MPSL_TIMESLOT_SIGNAL_TIMER0),
		      "a granted extension did not break the run of refusals");
	zassert_equal(MPSL_TIMESLOT_SIGNAL_ACTION_END,
		      fake_mpsl_signal(MPSL_TIMESLOT_SIGNAL_EXTEND_FAILED), NULL);
	k_msleep(WORK_MS);
	assert_invariant();
}

ZTEST(radiant_gate_ext_skip, test_a_skipped_grant_asks_for_the_fixed_margin)
{
	uint32_t len;

	len = elastic_grant(SHORT_US);
	zassert_equal(SHORT_EXTEND_LEN_US, len,
		      "an elastic window outside a skip lost its extension margin");
	gate_release();
	zassert_equal(MPSL_TIMESLOT_SIGNAL_ACTION_END,
		      fake_mpsl_signal(MPSL_TIMESLOT_SIGNAL_TIMER0), NULL);
	k_msleep(WORK_MS);

	refused_run();

	len = elastic_grant(SHORT_US);
	zassert_equal(SHORT_FIXED_LEN_US, len,
		      "a grant that will never extend paid the extension margin");
	gate_probe_read(&p);
	zassert_equal(750u, p.end_margin_us, NULL);
	gate_release();
	zassert_equal(MPSL_TIMESLOT_SIGNAL_ACTION_END,
		      fake_mpsl_signal(MPSL_TIMESLOT_SIGNAL_TIMER0), NULL);
	k_msleep(WORK_MS);
	assert_invariant();
}

ZTEST(radiant_gate_ext_skip, test_a_skipped_grant_keeps_listening_to_its_own_margin)
{
	uint32_t len;

	len = elastic_grant(CHUNK_US);
	zassert_equal(BITE_US, len, NULL);
	zassert_equal(BITE_EXTEND_CC_US, fake_mpsl_timer0.cc[0],
		      "the extendable grant's compare moved");
	zassert_equal(MPSL_TIMESLOT_SIGNAL_ACTION_EXTEND,
		      fake_mpsl_signal(MPSL_TIMESLOT_SIGNAL_TIMER0), NULL);
	zassert_equal(MPSL_TIMESLOT_SIGNAL_ACTION_END,
		      fake_mpsl_signal(MPSL_TIMESLOT_SIGNAL_EXTEND_FAILED), NULL);
	k_msleep(WORK_MS);
	refused_grant();
	refused_grant();

	len = elastic_grant(CHUNK_US);
	zassert_equal(BITE_US, len, NULL);
	zassert_equal(BITE_FIXED_CC_US, fake_mpsl_timer0.cc[0],
		      "a skipped grant's compare is not its own margin");
	zassert_equal(MPSL_TIMESLOT_SIGNAL_ACTION_END,
		      fake_mpsl_signal(MPSL_TIMESLOT_SIGNAL_TIMER0), NULL);
	k_msleep(WORK_MS);
	assert_invariant();
}

ZTEST(radiant_gate_ext_skip, test_gate_init_forgets_the_skip)
{
	refused_run();

	gate_shutdown();
	k_msleep(WORK_MS);
	fake_mpsl_reset();
	fake_backend_reset();
	init_gate();

	(void)elastic_grant(CHUNK_US);
	zassert_equal(MPSL_TIMESLOT_SIGNAL_ACTION_EXTEND,
		      fake_mpsl_signal(MPSL_TIMESLOT_SIGNAL_TIMER0),
		      "the skip survived gate_init()");
	zassert_equal(MPSL_TIMESLOT_SIGNAL_ACTION_END,
		      fake_mpsl_signal(MPSL_TIMESLOT_SIGNAL_EXTEND_FAILED), NULL);
	k_msleep(WORK_MS);
	assert_invariant();
}
```

## src/test_gate_grant_gen.c
```c
/* SPDX-License-Identifier: Apache-2.0 */
/*
 * The grant generation (gate_grant_gen()): the gate's half of AN ARM
 * PREEMPTED BY THE GRANT'S END (radiant_radio_nrf.c, ARM_SLOT_GUARD). The
 * backend records it at an arm's claim and refuses, with nothing written, an
 * arm whose span finds it changed or over. That is sound only if:
 *
 *   - every SIGNAL_START makes it live (odd) and new, before on_grant() or
 *     anything else can programme the radio;
 *   - every end of the loan makes it over (even) before the backend's
 *     on_grant_end() - each ACTION_END path, gate_release()'s early hand-back,
 *     and the low-priority backstops;
 *   - an extension changes nothing (the loan goes on).
 *
 * assert_invariant() in test_gate.c checks the first two on every radiant.gate
 * path through the fake backend's counters; this suite names the paths.
 */

#include <stdbool.h>
#include <stdint.h>

#include <zephyr/kernel.h>
#include <zephyr/ztest.h>

#include <mpsl_timeslot.h>

#include "radiant_radio_nrf_gate.h"

#include "../../fake_radio.h"
#include "../fake_mpsl.h"
#include "../fake_swi.h"
#include "../gate_probe.h"

#define WORK_MS  20
#define LEAD_US  500000u
#define WIN_US   5000u
#define CHUNK_US 40000u

static void before(void *fixture)
{
	ARG_UNUSED(fixture);

	gate_shutdown();
	k_msleep(WORK_MS);
	fake_radio_bring_up();
	fake_mpsl_reset();
	fake_backend_reset();
	fake_swi_reset();
	gate_probe_reset_elastic();
	zassert_equal(RADIANT_RADIO_OK_RC, gate_init(), NULL);
	k_msleep(WORK_MS);
	/* The bootstrap: a START and its immediate ACTION_END. */
	zassert_equal(MPSL_TIMESLOT_SIGNAL_ACTION_END,
		      fake_mpsl_signal(MPSL_TIMESLOT_SIGNAL_START), NULL);
	k_msleep(WORK_MS);
}

static void after(void *fixture)
{
	ARG_UNUSED(fixture);
	gate_shutdown();
	k_msleep(WORK_MS);
	gate_probe_reset_elastic();
}

ZTEST_SUITE(radiant_gate_grant_gen, NULL, NULL, before, after, NULL);

/* Place a window and take its grant; returns the generation on_grant() saw. */
static uint32_t take_grant(uint8_t prio, uint32_t win_us)
{
	radiant_time_t from = radiant_radio_now() + LEAD_US;
	const uint32_t grants = fake_backend()->on_grant;

	zassert_equal(GATE_PENDING, gate_acquire(GATE_OP_RX, from, from + win_us, 0u, prio),
		      "the window was refused");
	k_msleep(WORK_MS);
	zassert_equal(MPSL_TIMESLOT_SIGNAL_ACTION_NONE,
		      fake_mpsl_signal(MPSL_TIMESLOT_SIGNAL_START), NULL);
	zassert_equal(grants + 1u, fake_backend()->on_grant, "on_grant() was not called");
	zassert_true(GATE_GEN_LIVE(fake_backend()->gen_at_grant),
		     "on_grant() ran before the generation went live");
	zassert_equal(fake_backend()->gen_at_grant, gate_grant_gen(), NULL);
	return fake_backend()->gen_at_grant;
}

static void assert_over(const char *what)
{
	zassert_false(GATE_GEN_LIVE(gate_grant_gen()), "%s left the generation live", what);
	zassert_false(GATE_GEN_LIVE(fake_backend()->gen_at_grant_end),
		      "%s: on_grant_end() ran with the generation live", what);
	zassert_equal(0u, fake_backend()->gen_dead_at_grant, NULL);
	zassert_equal(0u, fake_backend()->gen_live_at_grant_end, NULL);
	zassert_equal(0u, fake_mpsl_viol_end_when_ended(), NULL);
	zassert_equal(0u, fake_mpsl_viol_action_no_slot(), NULL);
	zassert_equal(0u, fake_mpsl_viol_low_prio_action(), NULL);
}

/*
 * Risk: an arm claimed between two timeslots, or under the bootstrap, reads a
 * generation a later grant reuses, and programmes a RADIO that is not ours.
 */
ZTEST(radiant_gate_grant_gen, test_bootstrap_ends_over_and_every_grant_is_new)
{
	uint32_t last;

	assert_over("the bootstrap");
	last = gate_grant_gen();
	for (int i = 0; i < 4; i++) {
		uint32_t g = take_grant(RADIANT_GATE_PRIO_HIGH, WIN_US);

		zassert_true((int32_t)(g - last) > 0, "grant %d reused a generation", i);
		last = g;
		gate_release();
		zassert_equal(MPSL_TIMESLOT_SIGNAL_ACTION_END,
			      fake_mpsl_signal(MPSL_TIMESLOT_SIGNAL_TIMER0), NULL);
		assert_over("release + TIMER0");
		k_msleep(WORK_MS);
	}
	zassert_equal(0u, fake_backend()->gen_grant_reused, NULL);
}

/*
 * Risk: gate_release() hands the RADIO back at once but leaves the timeslot
 * running until its TIMER0 compare; an arm resumed in that gap must already
 * find the loan over, not wait for the ACTION_END.
 */
ZTEST(radiant_gate_grant_gen, test_release_ends_the_generation_at_once)
{
	(void)take_grant(RADIANT_GATE_PRIO_HIGH, WIN_US);
	gate_release();
	zassert_true(fake_mpsl_in_timeslot(), "the timeslot is still running");
	assert_over("gate_release()");
	zassert_equal(MPSL_TIMESLOT_SIGNAL_ACTION_END,
		      fake_mpsl_signal(MPSL_TIMESLOT_SIGNAL_TIMER0), NULL);
	assert_over("its TIMER0 end");
}

/* Risk: the grant's own TIMER0 end (no release) leaves the generation live. */
ZTEST(radiant_gate_grant_gen, test_timer0_end)
{
	(void)take_grant(RADIANT_GATE_PRIO_HIGH, WIN_US);
	zassert_equal(MPSL_TIMESLOT_SIGNAL_ACTION_END,
		      fake_mpsl_signal(MPSL_TIMESLOT_SIGNAL_TIMER0), NULL);
	assert_over("TIMER0");
}

/* Risk: the RADIO signal's own end (the operation completed in the signal). */
ZTEST(radiant_gate_grant_gen, test_radio_signal_end)
{
	(void)take_grant(RADIANT_GATE_PRIO_HIGH, WIN_US);
	fake_backend_release_in_radio_irq(true);
	zassert_equal(MPSL_TIMESLOT_SIGNAL_ACTION_END,
		      fake_mpsl_signal(MPSL_TIMESLOT_SIGNAL_RADIO), NULL);
	fake_backend_release_in_radio_irq(false);
	assert_over("SIGNAL_RADIO");
}

/* Risk: a grant released from inside on_grant() (a synchronous completion,
 * or a failed programme) ends the timeslot from SIGNAL_START itself. */
ZTEST(radiant_gate_grant_gen, test_release_in_grant)
{
	radiant_time_t from = radiant_radio_now() + LEAD_US;

	fake_backend_release_in_grant(true);
	zassert_equal(GATE_PENDING,
		      gate_acquire(GATE_OP_RX, from, from + WIN_US, 0u, RADIANT_GATE_PRIO_HIGH),
		      NULL);
	k_msleep(WORK_MS);
	zassert_equal(MPSL_TIMESLOT_SIGNAL_ACTION_END,
		      fake_mpsl_signal(MPSL_TIMESLOT_SIGNAL_START), NULL);
	fake_backend_release_in_grant(false);
	zassert_true(GATE_GEN_LIVE(fake_backend()->gen_at_grant), NULL);
	assert_over("a release inside on_grant()");
}

/*
 * Risk: an elastic grant's extension ends the generation (failing a live
 * follow-on), or EXTEND_FAILED - which hands back and then aborts from the
 * signal - leaves it live, so an arm under it resumes into the other stack's
 * RADIO.
 */
ZTEST(radiant_gate_grant_gen, test_extension_keeps_and_extend_failed_ends)
{
	uint32_t g = take_grant(RADIANT_GATE_PRIO_NORMAL, CHUNK_US);

	zassert_equal(MPSL_TIMESLOT_SIGNAL_ACTION_EXTEND,
		      fake_mpsl_signal(MPSL_TIMESLOT_SIGNAL_TIMER0), "no extension asked");
	zassert_equal(MPSL_TIMESLOT_SIGNAL_ACTION_NONE,
		      fake_mpsl_signal(MPSL_TIMESLOT_SIGNAL_EXTEND_SUCCEEDED), NULL);
	zassert_equal(g, gate_grant_gen(), "an extension moved the generation");
	zassert_equal(MPSL_TIMESLOT_SIGNAL_ACTION_EXTEND,
		      fake_mpsl_signal(MPSL_TIMESLOT_SIGNAL_TIMER0), NULL);
	zassert_equal(MPSL_TIMESLOT_SIGNAL_ACTION_END,
		      fake_mpsl_signal(MPSL_TIMESLOT_SIGNAL_EXTEND_FAILED), NULL);
	assert_over("EXTEND_FAILED");
}

/* Risk: the low-priority backstops (a loan MPSL ended by expiry) return the
 * radio with the generation still live. */
static void backstop(uint32_t signal)
{
	struct gate_probe p;

	(void)take_grant(RADIANT_GATE_PRIO_HIGH, WIN_US);
	zassert_equal(MPSL_TIMESLOT_SIGNAL_ACTION_NONE, fake_mpsl_signal(signal), NULL);
	gate_probe_read(&p);
	zassert_false(p.hw_held, "signal %u kept the radio", signal);
	assert_over("a low-priority backstop");
}

ZTEST(radiant_gate_grant_gen, test_session_idle_backstop)
{
	backstop(MPSL_TIMESLOT_SIGNAL_SESSION_IDLE);
}

ZTEST(radiant_gate_grant_gen, test_blocked_backstop)
{
	backstop(MPSL_TIMESLOT_SIGNAL_BLOCKED);
}

ZTEST(radiant_gate_grant_gen, test_session_closed_backstop)
{
	backstop(MPSL_TIMESLOT_SIGNAL_SESSION_CLOSED);
}

/* Risk: gate_shutdown() with a loan running leaves the generation live into
 * the next session. */
ZTEST(radiant_gate_grant_gen, test_shutdown_ends_a_live_loan)
{
	(void)take_grant(RADIANT_GATE_PRIO_HIGH, WIN_US);
	gate_shutdown();
	assert_over("gate_shutdown()");
}
```

## src/test_gate_hardening.c
```c
/* SPDX-License-Identifier: Apache-2.0 */
/*
 * Three hardenings from the 69:108 review, each pinned here:
 *
 *   (a) A low-priority signal returns a struct the zero-latency invocation
 *       for the same session never writes. MPSL reads the returned struct
 *       after the callback returns; if it were the session's own rv, a
 *       zero-latency END or EXTEND written in between would be handed to MPSL
 *       as the low-priority signal's action, which asserts.
 *   (b) Whether a timeslot took the radio is forgotten at every SIGNAL_START,
 *       so a timeslot that ended without our high-priority END cannot make a
 *       later bootstrap or orphan timeslot clear the RADIO vector.
 *   (c) Outside a high-priority signal, MPSL_TIMER0 is written only while a
 *       compare we armed is still armed: a low-priority backstop after a normal
 *       END leaves MPSL's timer alone, while a lost release compare is still
 *       disarmed.
 */

#include <stdbool.h>
#include <stdint.h>

#include <zephyr/kernel.h>
#include <zephyr/ztest.h>

#include <mpsl_timeslot.h>
#include <nrf_errno.h>

#include "radiant_radio_nrf_gate.h"

#include "../../fake_radio.h"
#include "../fake_mpsl.h"
#include "../fake_swi.h"

#define WORK_MS 20
#define LEAD_US 500000u
#define WIN_US  5000u

static void before(void *fixture)
{
	ARG_UNUSED(fixture);

	gate_shutdown();
	k_msleep(WORK_MS);
	fake_radio_bring_up();
	fake_mpsl_reset();
	fake_backend_reset();
	fake_swi_reset();
	zassert_equal(RADIANT_RADIO_OK_RC, gate_init(), NULL);
	k_msleep(WORK_MS);
	zassert_equal(MPSL_TIMESLOT_SIGNAL_ACTION_END,
		      fake_mpsl_signal(MPSL_TIMESLOT_SIGNAL_START), NULL);
	k_msleep(WORK_MS);
	fake_backend_reset();
}

static void after(void *fixture)
{
	ARG_UNUSED(fixture);
	gate_shutdown();
	k_msleep(WORK_MS);
}

ZTEST_SUITE(radiant_gate_hardening, NULL, NULL, before, after, NULL);

static void place(void)
{
	radiant_time_t from = radiant_radio_now() + LEAD_US;

	zassert_equal(GATE_PENDING,
		      gate_acquire(GATE_OP_RX, from, from + WIN_US, 0u,
				   RADIANT_GATE_PRIO_HIGH),
		      "the window was refused");
	k_msleep(WORK_MS);
}

/* A grant whose on_grant() took the radio, with its compare armed. */
static void take_grant(void)
{
	place();
	zassert_equal(MPSL_TIMESLOT_SIGNAL_ACTION_NONE,
		      fake_mpsl_signal(MPSL_TIMESLOT_SIGNAL_START), NULL);
	zassert_true((fake_mpsl_timer0.inten & NRF_TIMER_INT_COMPARE0_MASK) != 0u,
		     "the grant's compare was not armed");
}

/* (a) ------------------------------------------------------------------ */

ZTEST(radiant_gate_hardening, test_a_low_priority_return_survives_a_zero_latency_end)
{
	const mpsl_timeslot_signal_return_param_t *hi;
	const mpsl_timeslot_signal_return_param_t *lo;

	take_grant();
	hi = fake_mpsl_last_return();

	/* A low-priority signal for the same session. MPSL has its pointer
	 * but has not read it yet ... */
	zassert_equal(MPSL_TIMESLOT_SIGNAL_ACTION_NONE,
		      fake_mpsl_signal(MPSL_TIMESLOT_SIGNAL_SESSION_IDLE), NULL);
	lo = fake_mpsl_last_return();

	/* ... when the zero-latency callback for the same session ends the
	 * timeslot and writes END into its own return struct. */
	zassert_equal(MPSL_TIMESLOT_SIGNAL_ACTION_END,
		      fake_mpsl_signal(MPSL_TIMESLOT_SIGNAL_TIMER0), NULL);

	zassert_not_equal(hi, lo,
			  "a low-priority signal returned the session's own rv");
	zassert_equal(MPSL_TIMESLOT_SIGNAL_ACTION_NONE, lo->callback_action,
		      "the low-priority signal's return now carries a "
		      "zero-latency action, which MPSL asserts on");
	k_msleep(WORK_MS);
}

/* (b) ------------------------------------------------------------------ */

ZTEST(radiant_gate_hardening, test_b_a_slot_without_our_end_does_not_lend_the_next)
{
	/* A timeslot that took the radio and ended without our high-priority
	 * END: SESSION_IDLE is the backstop that hands it back. */
	take_grant();
	zassert_equal(MPSL_TIMESLOT_SIGNAL_ACTION_NONE,
		      fake_mpsl_signal(MPSL_TIMESLOT_SIGNAL_SESSION_IDLE), NULL);
	k_msleep(WORK_MS);

	/* The next timeslot is an orphan that never takes the radio. A
	 * pending RADIO interrupt then is not ours and must survive. */
	place();
	gate_forget_pending();
	fake_backend_radio_irq_pend();
	zassert_equal(MPSL_TIMESLOT_SIGNAL_ACTION_END,
		      fake_mpsl_signal(MPSL_TIMESLOT_SIGNAL_START), NULL);
	zassert_true(fake_backend()->slot_start > 0u,
		     "SIGNAL_START did not tell the backend a timeslot began");
	zassert_true(fake_backend_radio_irq_pending(),
		     "a stale 'radio taken' from an earlier timeslot cleared a "
		     "RADIO interrupt in one that never took the radio");
	k_msleep(WORK_MS);
}

/* (c) ------------------------------------------------------------------ */

/* End a grant normally: release, then the compare's TIMER0 END. */
static void normal_end(void)
{
	take_grant();
	gate_release();
	zassert_equal(MPSL_TIMESLOT_SIGNAL_ACTION_END,
		      fake_mpsl_signal(MPSL_TIMESLOT_SIGNAL_TIMER0), NULL);
	zassert_true((fake_mpsl_timer0.inten & NRF_TIMER_INT_COMPARE0_MASK) == 0u,
		     NULL);
}

static void backstop_leaves_timer0(uint32_t signal)
{
	uint32_t disables;

	normal_end();
	/* The timer is MPSL's again: model MPSL arming its own compare. */
	fake_mpsl_timer0.inten |= NRF_TIMER_INT_COMPARE0_MASK;
	fake_mpsl_timer0.event_compare[0] = true;
	disables = fake_mpsl_timer0.int_disables;

	zassert_equal(MPSL_TIMESLOT_SIGNAL_ACTION_NONE, fake_mpsl_signal(signal),
		      NULL);

	zassert_equal(disables, fake_mpsl_timer0.int_disables,
		      "a low-priority backstop wrote MPSL_TIMER0 with no compare "
		      "of ours armed");
	zassert_true((fake_mpsl_timer0.inten & NRF_TIMER_INT_COMPARE0_MASK) != 0u,
		     "MPSL's own compare interrupt was disabled");
	zassert_true(fake_mpsl_timer0.event_compare[0],
		     "MPSL's own compare event was cleared");
	k_msleep(WORK_MS);
}

ZTEST(radiant_gate_hardening, test_c_session_idle_after_end_leaves_timer0)
{
	backstop_leaves_timer0(MPSL_TIMESLOT_SIGNAL_SESSION_IDLE);
}

ZTEST(radiant_gate_hardening, test_c_session_closed_after_end_leaves_timer0)
{
	backstop_leaves_timer0(MPSL_TIMESLOT_SIGNAL_SESSION_CLOSED);
}

ZTEST(radiant_gate_hardening, test_c_a_lost_release_compare_is_still_disarmed)
{
	/* The case the backstop was written for: gate_release() armed the
	 * compare and returned the radio, and the compare never fired. */
	take_grant();
	gate_release();
	zassert_true((fake_mpsl_timer0.inten & NRF_TIMER_INT_COMPARE0_MASK) != 0u,
		     NULL);
	fake_mpsl_timer0.int_disable_zli_depth = 0u;

	zassert_equal(MPSL_TIMESLOT_SIGNAL_ACTION_NONE,
		      fake_mpsl_signal(MPSL_TIMESLOT_SIGNAL_SESSION_IDLE), NULL);

	zassert_true((fake_mpsl_timer0.inten & NRF_TIMER_INT_COMPARE0_MASK) == 0u,
		     "SESSION_IDLE left a lost compare of ours armed");
	zassert_true(fake_mpsl_timer0.int_disable_zli_depth > 0u,
		     "the disarm was not masked against the zero-latency callback");
	k_msleep(WORK_MS);
}

ZTEST(radiant_gate_hardening, test_c_a_high_priority_end_still_disarms_unconditionally)
{
	uint32_t disables = fake_mpsl_timer0.int_disables;

	/* An orphan timeslot never arms a compare, yet inside our timeslot the
	 * timer is ours, so the hand-back still clears COMPARE0 as before. */
	place();
	gate_forget_pending();
	zassert_equal(MPSL_TIMESLOT_SIGNAL_ACTION_END,
		      fake_mpsl_signal(MPSL_TIMESLOT_SIGNAL_START), NULL);
	zassert_equal(disables + 1u, fake_mpsl_timer0.int_disables,
		      "the in-timeslot disarm no longer runs");
	k_msleep(WORK_MS);
}
```

## src/test_gate_lp.c
```c
/* SPDX-License-Identifier: Apache-2.0 */
/*
 * CONFIG_RADIANT_NRF_LOW_POWER on the MPSL build (power plan pass B6): the
 * gate's half. The backend stops its radio TIMER between timeslots and starts
 * it from the GRTC at each SIGNAL_START, which is sound only because MPSL
 * guarantees the crystal there and only if the gate calls it at the right
 * moments. The contract this suite pins:
 *
 *   - every request asks for MPSL_TIMESLOT_HFCLK_CFG_XTAL_GUARANTEED
 *     (radiant_gate_hfclk, compiled in both gate scenarios: the guarantee
 *     matters to every MPSL build, not only this one);
 *   - every SIGNAL_START calls radiant_nrf_gate_lp_slot_start() once, before
 *     on_grant() programmes anything, with the requested start for a timed
 *     request and 0 for the bootstrap and the elastic class;
 *   - every ACTION_END calls radiant_nrf_gate_lp_slot_end(false) once, inside
 *     the timeslot, as the very last backend call - after the hand-back, every
 *     radiant_radio_abort() and the RADIO vector clear, since
 *     radio_disable_now() is a no-op on a stopped TIMER;
 *   - an extension does not end anything;
 *   - the low-priority hand-backs (BLOCKED, SESSION_IDLE, SESSION_CLOSED) and
 *     gate_shutdown() call it with backstop true, which stops a TIMER an
 *     expiry-ended timeslot left running and is a no-op otherwise.
 *
 * radiant.backend.lp_mpsl tests what the backend does with the calls.
 */

#include <stdbool.h>
#include <stdint.h>

#include <zephyr/kernel.h>
#include <zephyr/ztest.h>

#include <mpsl_timeslot.h>
#include <nrf_errno.h>

#include "radiant_radio_nrf_gate.h"

#include "../../fake_radio.h"
#include "../fake_mpsl.h"
#include "../fake_swi.h"
#include "../gate_probe.h"

#define WORK_MS  20
#define LEAD_US  500000u
#define WIN_US   5000u
#define CHUNK_US 40000u
#define RUN_OFF  3u

static void before(void *fixture)
{
	ARG_UNUSED(fixture);

	gate_shutdown();
	k_msleep(WORK_MS);
	fake_radio_bring_up();
	fake_mpsl_reset();
	fake_backend_reset();
	fake_swi_reset();
	gate_probe_reset_elastic();
	zassert_equal(RADIANT_RADIO_OK_RC, gate_init(), NULL);
	k_msleep(WORK_MS);
}

static void after(void *fixture)
{
	ARG_UNUSED(fixture);
	gate_shutdown();
	k_msleep(WORK_MS);
	gate_probe_reset_elastic();
}

static void bootstrap(void)
{
	zassert_equal(MPSL_TIMESLOT_SIGNAL_ACTION_END,
		      fake_mpsl_signal(MPSL_TIMESLOT_SIGNAL_START), NULL);
	k_msleep(WORK_MS);
}

static void place(uint8_t prio, uint32_t win_us)
{
	radiant_time_t from = radiant_radio_now() + LEAD_US;

	zassert_equal(GATE_PENDING,
		      gate_acquire(GATE_OP_RX, from, from + win_us, 0u, prio),
		      "the window was refused");
	k_msleep(WORK_MS);
}

/* ---- The HFCLK configuration: both gate scenarios ---- */

ZTEST_SUITE(radiant_gate_hfclk, NULL, NULL, before, after, NULL);

/*
 * Risk: a request placed with a weaker HFCLK configuration (DEFAULT, which
 * lets MPSL start the timeslot on HFINT): the radio loses bit sync in that
 * timeslot, and with the low-power option the backend's TIMER is started on
 * an unsettled clock with nothing to say so.
 */
ZTEST(radiant_gate_hfclk, test_every_request_is_xtal_guaranteed)
{
	const mpsl_timeslot_request_t *rq = fake_mpsl_last_request();

	zassert_equal(MPSL_TIMESLOT_REQ_TYPE_EARLIEST, rq->request_type,
		      "the bootstrap is EARLIEST");
	zassert_equal(MPSL_TIMESLOT_HFCLK_CFG_XTAL_GUARANTEED,
		      rq->params.earliest.hfclk, "bootstrap");
	bootstrap();
	place(RADIANT_GATE_PRIO_HIGH, WIN_US);
	rq = fake_mpsl_last_request();
	zassert_equal(MPSL_TIMESLOT_REQ_TYPE_NORMAL, rq->request_type, NULL);
	zassert_equal(MPSL_TIMESLOT_HFCLK_CFG_XTAL_GUARANTEED,
		      rq->params.normal.hfclk, "tracked window");
	/* Answer it (one request per session), then place the elastic class. */
	zassert_equal(MPSL_TIMESLOT_SIGNAL_ACTION_NONE,
		      fake_mpsl_signal(MPSL_TIMESLOT_SIGNAL_START), NULL);
	gate_release();
	zassert_equal(MPSL_TIMESLOT_SIGNAL_ACTION_END,
		      fake_mpsl_signal(MPSL_TIMESLOT_SIGNAL_TIMER0), NULL);
	k_msleep(WORK_MS);
	place(RADIANT_GATE_PRIO_NORMAL, CHUNK_US);
	rq = fake_mpsl_last_request();
	zassert_equal(MPSL_TIMESLOT_REQ_TYPE_NORMAL, rq->request_type, NULL);
	zassert_equal(MPSL_TIMESLOT_HFCLK_CFG_XTAL_GUARANTEED,
		      rq->params.normal.hfclk, "elastic chunk");
}

#if defined(GATE_LP)

/* ---- The low-power hooks: radiant.gate.lp only ---- */

ZTEST_SUITE(radiant_gate_lp, NULL, NULL, before, after, NULL);

/* A grant whose on_grant() took the radio. */
static void take_grant(uint8_t prio, uint32_t win_us)
{
	place(prio, win_us);
	zassert_equal(MPSL_TIMESLOT_SIGNAL_ACTION_NONE,
		      fake_mpsl_signal(MPSL_TIMESLOT_SIGNAL_START), NULL);
	zassert_true(fake_backend()->on_grant > 0u, "on_grant() was not called");
}

/* Deliver a high-priority signal that ends the timeslot and check the
 * release came once, last, inside it. */
static void end_and_check(uint32_t signal, bool aborts, const char *what)
{
	const struct fake_backend_counts *b = fake_backend();
	const uint32_t ends = b->lp_end;
	const uint32_t aborts_before = fake_radio_abort_calls();

	zassert_true(b->lp_awake, "%s: the TIMER was not running", what);
	zassert_equal(MPSL_TIMESLOT_SIGNAL_ACTION_END, fake_mpsl_signal(signal),
		      "%s did not end the timeslot", what);
	zassert_equal(ends + 1u, b->lp_end, "%s: slot_end not called once", what);
	zassert_equal(0u, b->lp_end_backstop, "%s: a funnel end is no backstop", what);
	zassert_equal(0u, b->lp_end_outside, "%s: slot_end outside the timeslot", what);
	zassert_false(b->lp_awake, "%s left the TIMER running", what);
	zassert_equal(b->lp_start, b->lp_releases,
		      "%s: STARTs %u, releases %u", what, b->lp_start, b->lp_releases);
	zassert_true(b->lp_end_seq > b->unpend_seq,
		     "%s stopped the TIMER before the RADIO vector clear", what);
	zassert_true(b->lp_end_seq > b->grant_end_seq,
		     "%s stopped the TIMER before the hand-back", what);
	zassert_equal(fake_radio_abort_calls(), b->lp_end_abort_calls,
		      "%s aborted after the TIMER stopped", what);
	if (aborts) {
		zassert_true(b->lp_end_abort_calls > aborts_before,
			     "%s did not abort", what);
	}
	zassert_equal(0u, b->lp_start_awake, "%s: a START found the TIMER running", what);
	zassert_equal(0u, fake_mpsl_viol_end_when_ended(), NULL);
	zassert_equal(0u, fake_mpsl_viol_action_no_slot(), NULL);
	zassert_equal(0u, fake_mpsl_viol_low_prio_action(), NULL);
	k_msleep(WORK_MS);
}

/*
 * Risk: the bootstrap timeslot, which never takes the radio, still has its
 * START and END bracket the TIMER; if either were skipped the pairing every
 * later timeslot relies on would be off by one from boot.
 */
ZTEST(radiant_gate_lp, test_bootstrap_is_bracketed_and_untimed)
{
	const struct fake_backend_counts *b = fake_backend();

	bootstrap();
	zassert_equal(1u, b->lp_start, NULL);
	zassert_equal(0u, b->lp_last_r_start, "the bootstrap has no requested start");
	zassert_equal(1u, b->lp_releases, NULL);
	zassert_false(b->lp_awake, NULL);
	zassert_equal(0u, b->on_grant, NULL);
}

/*
 * Risk: the TIMER started after on_grant() programmed the radio against it,
 * or with the wrong start for the cross-check.
 */
ZTEST(radiant_gate_lp, test_timed_start_wakes_before_grant)
{
	const struct fake_backend_counts *b = fake_backend();
	struct gate_probe p;

	bootstrap();
	place(RADIANT_GATE_PRIO_HIGH, WIN_US);
	gate_probe_read(&p);
	zassert_equal(MPSL_TIMESLOT_SIGNAL_ACTION_NONE,
		      fake_mpsl_signal(MPSL_TIMESLOT_SIGNAL_START), NULL);
	zassert_equal(2u, b->lp_start, NULL);
	zassert_true(b->lp_awake, NULL);
	zassert_not_equal(0u, b->lp_last_r_start, NULL);
	zassert_equal(p.r_start, b->lp_last_r_start,
		      "the cross-check gets the start the gate asked for");
	zassert_true(b->lp_start_seq < b->grant_seq,
		     "the TIMER started after on_grant() programmed against it");
	gate_release();
	end_and_check(MPSL_TIMESLOT_SIGNAL_TIMER0, false, "TIMER0 after a release");
}

/* Risk: the elastic class, whose placement is skewed and grown, is
 * cross-checked as if its start were a promise. */
ZTEST(radiant_gate_lp, test_elastic_start_is_untimed)
{
	const struct fake_backend_counts *b = fake_backend();

	bootstrap();
	place(RADIANT_GATE_PRIO_NORMAL, CHUNK_US);
	zassert_equal(MPSL_TIMESLOT_SIGNAL_ACTION_NONE,
		      fake_mpsl_signal(MPSL_TIMESLOT_SIGNAL_START), NULL);
	zassert_equal(0u, b->lp_last_r_start, NULL);
	zassert_true(b->lp_awake, NULL);
	gate_release();
	end_and_check(MPSL_TIMESLOT_SIGNAL_TIMER0, false, "elastic TIMER0 after a release");
}

/* Risk: one of the ACTION_END paths misses the funnel, so the TIMER keeps
 * running into the gap on whatever clock MPSL leaves. */
ZTEST(radiant_gate_lp, test_every_end_path_releases_last)
{
	bootstrap();
	take_grant(RADIANT_GATE_PRIO_HIGH, WIN_US);
	end_and_check(MPSL_TIMESLOT_SIGNAL_TIMER0, false, "the TIMER0 backstop");

	take_grant(RADIANT_GATE_PRIO_HIGH, WIN_US);
	fake_backend_release_in_radio_irq(true);
	end_and_check(MPSL_TIMESLOT_SIGNAL_RADIO, false, "the RADIO signal");
	fake_backend_release_in_radio_irq(false);

	place(RADIANT_GATE_PRIO_HIGH, WIN_US);
	fake_backend_release_in_grant(true);
	{
		/* START ends its own timeslot: its START is the wake. */
		const struct fake_backend_counts *b = fake_backend();
		const uint32_t ends = b->lp_end;

		zassert_equal(MPSL_TIMESLOT_SIGNAL_ACTION_END,
			      fake_mpsl_signal(MPSL_TIMESLOT_SIGNAL_START), NULL);
		zassert_equal(ends + 1u, b->lp_end, NULL);
		zassert_false(b->lp_awake, NULL);
		zassert_true(b->lp_end_seq > b->unpend_seq, NULL);
		zassert_equal(b->lp_start, b->lp_releases, NULL);
		k_msleep(WORK_MS);
	}
	fake_backend_release_in_grant(false);

	/* An orphan: the operation forgotten before its START. */
	place(RADIANT_GATE_PRIO_HIGH, WIN_US);
	gate_forget_pending();
	zassert_equal(MPSL_TIMESLOT_SIGNAL_ACTION_END,
		      fake_mpsl_signal(MPSL_TIMESLOT_SIGNAL_START), NULL);
	zassert_false(fake_backend()->lp_awake, "the orphan's TIMER left running");
	zassert_equal(fake_backend()->lp_start, fake_backend()->lp_releases, NULL);
	k_msleep(WORK_MS);
}

/*
 * Risk: an extension (the elastic class grows a step at a time) is taken as an
 * end and stops the TIMER under a live scan; and EXTEND_FAILED, which aborts,
 * stops it before the abort's radio_disable_now() has run.
 */
ZTEST(radiant_gate_lp, test_extension_keeps_awake_and_failure_releases_after_abort)
{
	const struct fake_backend_counts *b = fake_backend();

	bootstrap();
	take_grant(RADIANT_GATE_PRIO_NORMAL, CHUNK_US);
	zassert_equal(MPSL_TIMESLOT_SIGNAL_ACTION_EXTEND,
		      fake_mpsl_signal(MPSL_TIMESLOT_SIGNAL_TIMER0), NULL);
	zassert_true(b->lp_awake, "an extension is not an end");
	zassert_equal(MPSL_TIMESLOT_SIGNAL_ACTION_NONE,
		      fake_mpsl_signal(MPSL_TIMESLOT_SIGNAL_EXTEND_SUCCEEDED), NULL);
	zassert_true(b->lp_awake, NULL);
	zassert_equal(MPSL_TIMESLOT_SIGNAL_ACTION_EXTEND,
		      fake_mpsl_signal(MPSL_TIMESLOT_SIGNAL_TIMER0), NULL);
	end_and_check(MPSL_TIMESLOT_SIGNAL_EXTEND_FAILED, true, "EXTEND_FAILED");

	/* A run of refusals turns the skip on: TIMER0 then ends without asking,
	 * and aborts. */
	for (uint32_t i = 1u; i < RUN_OFF; i++) {
		take_grant(RADIANT_GATE_PRIO_NORMAL, CHUNK_US);
		zassert_equal(MPSL_TIMESLOT_SIGNAL_ACTION_EXTEND,
			      fake_mpsl_signal(MPSL_TIMESLOT_SIGNAL_TIMER0), NULL);
		end_and_check(MPSL_TIMESLOT_SIGNAL_EXTEND_FAILED, true, "EXTEND_FAILED");
	}
	take_grant(RADIANT_GATE_PRIO_NORMAL, CHUNK_US);
	end_and_check(MPSL_TIMESLOT_SIGNAL_TIMER0, true, "the ext-skip TIMER0");
}

/* The low-priority hand-backs and gate_shutdown(), with the timeslot's own
 * ACTION_END never returned (an expiry-ended timeslot). */
static void backstop_releases(uint32_t signal, const char *what)
{
	const struct fake_backend_counts *b = fake_backend();

	bootstrap();
	take_grant(RADIANT_GATE_PRIO_HIGH, WIN_US);
	if (signal == UINT32_MAX) {
		gate_shutdown();
	} else {
		zassert_equal(MPSL_TIMESLOT_SIGNAL_ACTION_NONE,
			      fake_mpsl_signal(signal), NULL);
	}
	zassert_true(b->lp_end_backstop > 0u, "%s: no backstop call", what);
	zassert_equal(1u, b->lp_backstop_releases,
		      "%s: the left-running TIMER was not stopped", what);
	zassert_false(b->lp_awake, NULL);
	zassert_equal(b->lp_start, b->lp_releases, NULL);
	k_msleep(WORK_MS);
}

/*
 * Risk: a timeslot that ended by expiry, past the ACTION_END funnel, leaves
 * the TIMER running until the next START, timing the gap on a clock MPSL may
 * have dropped. Each backstop path stops it.
 */
ZTEST(radiant_gate_lp, test_blocked_backstop_releases)
{
	backstop_releases(MPSL_TIMESLOT_SIGNAL_BLOCKED, "BLOCKED");
}

ZTEST(radiant_gate_lp, test_session_idle_backstop_releases)
{
	backstop_releases(MPSL_TIMESLOT_SIGNAL_SESSION_IDLE, "SESSION_IDLE");
}

ZTEST(radiant_gate_lp, test_session_closed_backstop_releases)
{
	backstop_releases(MPSL_TIMESLOT_SIGNAL_SESSION_CLOSED, "SESSION_CLOSED");
}

ZTEST(radiant_gate_lp, test_shutdown_backstop_releases)
{
	backstop_releases(UINT32_MAX, "gate_shutdown()");
}

/* Risk: the backstop after a normal END (SESSION_IDLE follows nearly every
 * timeslot) is counted as a missed release. */
ZTEST(radiant_gate_lp, test_idle_after_a_normal_end_releases_nothing)
{
	const struct fake_backend_counts *b = fake_backend();

	bootstrap();
	take_grant(RADIANT_GATE_PRIO_HIGH, WIN_US);
	gate_release();
	end_and_check(MPSL_TIMESLOT_SIGNAL_TIMER0, false, "TIMER0 after a release");
	zassert_equal(MPSL_TIMESLOT_SIGNAL_ACTION_NONE,
		      fake_mpsl_signal(MPSL_TIMESLOT_SIGNAL_SESSION_IDLE), NULL);
	zassert_true(b->lp_end_backstop > 0u, NULL);
	zassert_equal(0u, b->lp_backstop_releases, NULL);
}

#endif /* GATE_LP */
```

## src/test_gate_signal_context.c
```c
/* SPDX-License-Identifier: Apache-2.0 */
/*
 * gate_in_signal() means "this is the zero-latency callback". A low-priority
 * signal runs in MPSL's cooperative thread, so a completion raised while one is
 * running must not be routed to the single-producer ring: that context is a
 * second producer, and the trampoline can preempt it and see the flag set.
 */

#include <stdbool.h>
#include <stdint.h>

#include <zephyr/kernel.h>
#include <zephyr/ztest.h>

#include <mpsl_timeslot.h>
#include <nrf_errno.h>

#include "radiant_radio_nrf_gate.h"

#include "../../fake_radio.h"
#include "../fake_mpsl.h"
#include "../fake_swi.h"

#define WORK_MS 20

static void before(void *fixture)
{
	ARG_UNUSED(fixture);

	gate_shutdown();
	k_msleep(WORK_MS);
	fake_radio_bring_up();
	fake_mpsl_reset();
	fake_backend_reset();
	fake_swi_reset();
	zassert_equal(RADIANT_RADIO_OK_RC, gate_init(), NULL);
	k_msleep(WORK_MS);
	zassert_equal(MPSL_TIMESLOT_SIGNAL_ACTION_END,
		      fake_mpsl_signal(MPSL_TIMESLOT_SIGNAL_START), NULL);
	k_msleep(WORK_MS);
	fake_swi_reset();
}

static void after(void *fixture)
{
	ARG_UNUSED(fixture);
	gate_shutdown();
	k_msleep(WORK_MS);
}

ZTEST_SUITE(radiant_gate_signal_context, NULL, NULL, before, after, NULL);

static void place(void)
{
	radiant_time_t from = radiant_radio_now() + 500000u;

	zassert_equal(GATE_PENDING,
		      gate_acquire(GATE_OP_RX, from, from + 1000u, 0u,
				   RADIANT_GATE_PRIO_HIGH), NULL);
	k_msleep(WORK_MS);
	fake_swi_reset();
}

ZTEST(radiant_gate_signal_context, test_a_high_priority_signal_is_the_signal_context)
{
	place();
	(void)fake_mpsl_signal(MPSL_TIMESLOT_SIGNAL_START);
	zassert_true(fake_swi()->pends_in_signal > 0u,
		     "START pended nothing from inside the signal context");
	gate_release();
	(void)fake_mpsl_signal(MPSL_TIMESLOT_SIGNAL_TIMER0);
	k_msleep(WORK_MS);
}

ZTEST(radiant_gate_signal_context, test_a_refusal_is_not_the_signal_context)
{
	place();
	(void)fake_mpsl_signal(MPSL_TIMESLOT_SIGNAL_BLOCKED);
	zassert_true(fake_swi()->pends > 0u, "BLOCKED pended no denial");
	zassert_equal(0u, fake_swi()->pends_in_signal,
		      "a low-priority signal claimed the zero-latency context");
	k_msleep(WORK_MS);
}

ZTEST(radiant_gate_signal_context, test_session_idle_is_not_the_signal_context)
{
	/* A deferred request is what SESSION_IDLE re-pends. */
	fake_mpsl_force_request_rc(-NRF_EAGAIN, 1u);
	place();
	(void)fake_mpsl_signal(MPSL_TIMESLOT_SIGNAL_SESSION_IDLE);
	zassert_true(fake_swi()->pends > 0u, "SESSION_IDLE re-pended nothing");
	zassert_equal(0u, fake_swi()->pends_in_signal,
		      "a low-priority signal claimed the zero-latency context");
	k_msleep(WORK_MS);
}
```
