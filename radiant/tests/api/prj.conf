## CMakeLists.txt
```
# SPDX-License-Identifier: Apache-2.0
#
# The radiant_api composition test application.
#
# ── Why this is a second application and not a suite in ../src ───────────────
#
# radiant/src/ant_api/radiant_ant.c (radiant_api.c, before it moved out of radiant -
# see radiant/include/radiant/radiant_msg.h for why) is the only
# module in radiant's orbit with no ztest coverage, and the whole
# master-exchange path lives in it: every module underneath is tested and the
# composition is not. That gap is where the "a master answers the first slave
# exchange and none after it" bug lived, and closing it turns a two-board
# human-gated experiment into a 40-second run.
#
# The obvious move - add it to the parent application's own suite - does not
# link. radiant_event_crit_enter(), radiant_event_crit_exit() and
# radiant_event_wakeup() are port hooks, and ../src/test_event.c defines its own
# versions of all three; ../src/test_channel.c likewise defines
# radiant_channel_event_out(). radiant_ant.c defines the production
# versions of the same four symbols (plus radiant_on_message()), so the two
# would collide at link - and if the collision were resolved in
# radiant_ant.c's favour it would change what those 187 tests assert,
# which is worse than a link error because it is quiet.
#
# So: a sibling application, sharing ../fake_radio.c and the module itself, with
# ../src/ deliberately out of the glob. Nothing in the existing suite changes,
# and CI's `twister -T app/radiant/tests` walks subdirectories, so
# testcase.yaml here is picked up with no workflow edit.

cmake_minimum_required(VERSION 3.20.0)

# Two levels up: the module root is radiant/, this is radiant/tests/api.
list(APPEND ZEPHYR_EXTRA_MODULES "${CMAKE_CURRENT_SOURCE_DIR}/../..")

find_package(Zephyr REQUIRED HINTS $ENV{ZEPHYR_BASE})
project(radiant_api_tests)

# Same glob rule as the parent application: a new suite is a new file in src/
# and this file does not change. The parent's glob does not reach in here and
# this one does not reach out there, which is what keeps the two link images
# separate.
file(GLOB suite_sources CONFIGURE_DEPENDS "${CMAKE_CURRENT_SOURCE_DIR}/src/*.c")
target_sources(app PRIVATE ${suite_sources})

# The mock radio, shared with the parent application rather than copied. It is
# the HAL implementation for this image too - prj.conf selects
# CONFIG_RADIANT_BACKEND_NONE for the same reason.
target_sources(app PRIVATE "${CMAKE_CURRENT_SOURCE_DIR}/../fake_radio.c")

# The adapter under test is compiled by the module, through
# CONFIG_RADIANT_ANT_API=y in prj.conf - the same door a real application uses.

# ../ so a suite writes #include "fake_radio.h", the same spelling the parent's
# suites use. ../../src/ant_api is for the adapter's private headers; the public
# ones come from the module's own zephyr_include_directories().
target_include_directories(app PRIVATE
  "${CMAKE_CURRENT_SOURCE_DIR}/.."
  "${CMAKE_CURRENT_SOURCE_DIR}/../../src/ant_api")
```

## Kconfig
```
# SPDX-License-Identifier: Apache-2.0
#
# prj.conf turns CONFIG_RADIANT_ANT_API on, which is what compiles the adapter
# under test. Any scenario that enables CONFIG_RADIANT_SEC gets the host
# messages too, matching the applications.
config RADIANT_SEC_HOST_MESSAGES
	default y if RADIANT_ANT_API && RADIANT_SEC

# The bridge thread's stack size, so the 0xF5-on-the-bridge-stack test runs on
# exactly the stack the dongle images give that thread.
#
# orsource, not rsource: CI's import-isolation job builds this application from
# a `git archive` of radiant/ alone, where apps/ does not exist. In this
# repository the apps' definition is sourced first, so its default wins and the
# test tracks the images; in the isolated copy only the fallback below exists.
# Keep the fallback equal to apps/common/Kconfig.bridge's default. (Not
# osource: that resolves against $srctree, so it silently finds nothing.)
orsource "../../../apps/common/Kconfig.bridge"

config ANT_DONGLE_BRIDGE_STACK_SIZE
	int
	default 2048

source "Kconfig.zephyr"
```

## prj.conf
```kconfig
# SPDX-License-Identifier: Apache-2.0
#
# Configuration for the radiant_api composition test application.
#
# The difference from ../prj.conf is CONFIG_RADIANT_ANT_API=y below, which is
# the reason this is a separate application - see the CMakeLists here for why it
# cannot simply be added to the parent's suite.

CONFIG_ZTEST=y

CONFIG_RADIANT=y
# fake_radio.c is the HAL implementation for this image; a second one would be a
# duplicate-symbol link error.
CONFIG_RADIANT_BACKEND_NONE=y
# The adapter under test: the module compiles radiant/src/ant_api/ when this is on.
CONFIG_RADIANT_ANT_API=y

# The bounded-denial escape. It defaults from RADIANT_BACKEND_NRF_GATE_MPSL,
# which this image cannot select (it builds the null backend against
# fake_radio.c), so it has to be asked for here - and it is asked for rather
# than the tests being #if-guarded, so that losing the symbol breaks the build
# instead of silently deleting the two tests that defend the fix.
CONFIG_RADIANT_SEARCH_DENIAL_ESCAPE=y

# radiant_api.c runs a real Zephyr thread and a real mutex, so this application
# needs both to exist. The suite drives the radio from the ztest thread and
# leans on the event thread only where it is the subject - the housekeeping
# watchdog - so nothing here waits on it otherwise.
CONFIG_MAIN_STACK_SIZE=4096
CONFIG_ZTEST_STACK_SIZE=4096

# LOG_DBG in radiant_api.c is what a bring-up session is read on. Off by
# default here: a suite that runs eight periods per test would emit a line per
# window, and ztest's own output is the thing being parsed.
CONFIG_LOG=y
CONFIG_RADIANT_LOG_LEVEL_WRN=y
```

## src/test_api_sec_compat.c
```c
/* SPDX-License-Identifier: Apache-2.0 */
/*
 * A compat context goes with its channel. radiant_ant_channel_unassign() and
 * radiant_ant_stack_reset() (SYSTEM_RESET) used to release only the radiant_sec
 * context, so a compat context on an unassigned channel stayed installed with
 * its epoch. radiant_sec_compat_live_twin() then kept reporting it, and
 * radiant_node_ident_arm_compat() refused every later arm under the same root and
 * base device number with RADIANT_NODE_IDENT_EBUSY until reboot (review 2026-11-15).
 *
 * Compiled only into scenarios with CONFIG_RADIANT_SEC_COMPAT (sec_host).
 */

#include <zephyr/kernel.h>

#if defined(CONFIG_RADIANT_SEC_COMPAT)

#include <zephyr/ztest.h>

#include <radiant/radiant_ant.h>
#include <radiant/radiant_wire.h>
#include <radiant/radiant_sec.h>
#include <radiant/radiant_sec_compat.h>

/* test_api.c: the api suite's end-of-case violation check. */
void api_assert_no_viol(void);

#define CA      0u
#define CB      1u
#define DEVNUM  0x3A17u
#define PERIOD  8070u

static const uint8_t root[16] = {
	0x10, 0x21, 0x32, 0x43, 0x54, 0x65, 0x76, 0x87,
	0x98, 0xa9, 0xba, 0xcb, 0xdc, 0xed, 0xfe, 0x0f,
};

static const uint8_t net_key[8] = {
	0xB9, 0xA5, 0x21, 0xFB, 0xBD, 0x72, 0xC3, 0x45,
};

static void assign(uint8_t ch)
{
	zassert_equal((radiant_ant_err_t)RADIANT_WIRE_RESPONSE_NO_ERROR,
		      radiant_ant_channel_assign(ch,
					  (uint8_t)RADIANT_WIRE_CHANNEL_TYPE_MASTER,
					  0u, 0u));
}

/* Both channels keyed under one root and one base number, A running. Starts
 * from no compat state at all, so a leak from the other test (with one of the
 * two releases reverted) fails only the test that covers that release. */
static void key_both_run_a(void)
{
	radiant_sec_compat_reset();
	zassert_equal(RADIANT_SEC_OK,
		      radiant_sec_compat_set_key(CA, root, 128u, DEVNUM));
	zassert_equal(RADIANT_SEC_OK,
		      radiant_sec_compat_set_key(CB, root, 128u, DEVNUM));
	zassert_equal(RADIANT_SEC_OK,
		      radiant_sec_compat_set_epoch(CA, 7u, 0u, 0u, PERIOD));
	zassert_true(radiant_sec_compat_live_twin(CB),
		     "precondition: A running under B's root and number is "
		     "B's live twin");
}

ZTEST(api, test_sec_compat_unassign_releases_the_compat_context)
{
	zassert_equal((radiant_ant_err_t)RADIANT_WIRE_RESPONSE_NO_ERROR,
		      radiant_ant_network_address_set(0u, net_key));
	assign(CA);
	assign(CB);
	key_both_run_a();

	zassert_equal((radiant_ant_err_t)RADIANT_WIRE_RESPONSE_NO_ERROR,
		      radiant_ant_channel_unassign(CA));

	zassert_false(radiant_sec_compat_live_twin(CB),
		      "an unassigned channel's compat context still counts as "
		      "a live twin: node_ident's next arm is EBUSY until reboot");
	zassert_equal(RADIANT_SEC_ENOKEY,
		      radiant_sec_compat_set_epoch(CA, 8u, 0u, 0u, PERIOD),
		      "the compat key outlived radiant_ant_channel_unassign()");

	(void)radiant_ant_channel_unassign(CB);

	api_assert_no_viol();
}

ZTEST(api, test_sec_compat_system_reset_releases_every_compat_context)
{
	zassert_equal((radiant_ant_err_t)RADIANT_WIRE_RESPONSE_NO_ERROR,
		      radiant_ant_network_address_set(0u, net_key));
	assign(CA);
	assign(CB);
	key_both_run_a();

	zassert_equal((radiant_ant_err_t)RADIANT_WIRE_RESPONSE_NO_ERROR, radiant_ant_stack_reset());

	zassert_equal(RADIANT_SEC_ENOKEY,
		      radiant_sec_compat_set_epoch(CA, 8u, 0u, 0u, PERIOD),
		      "channel A's compat key outlived SYSTEM_RESET");
	zassert_equal(RADIANT_SEC_ENOKEY,
		      radiant_sec_compat_set_epoch(CB, 8u, 0u, 0u, PERIOD),
		      "channel B's compat key outlived SYSTEM_RESET");

	api_assert_no_viol();
}

#endif /* CONFIG_RADIANT_SEC_COMPAT */
```
