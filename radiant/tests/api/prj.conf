## CMakeLists.txt
```
# SPDX-License-Identifier: Apache-2.0
#
# The radiant_api composition test application.
#
# ── Why this is a second application and not a suite in ../src ───────────────
#
# radiant/src/antr/ant_radio_radiant.c (radiant_api.c, before it moved out of radiant -
# see radiant/include/radiant/radiant_msg.h for why) is the only
# module in radiant's orbit with no ztest coverage, and the whole
# master-exchange path lives in it: every module underneath is tested and the
# composition is not. That gap is where the "a master answers the first slave
# exchange and none after it" bug lived, and closing it turns a two-board
# human-gated experiment into a 40-second run.
#
# The obvious move - add it to the parent application's own suite - does not
# link. radiant_event_crit_enter(), radiant_event_crit_exit() and
# radiant_event_wakeup() are port hooks, and ../src/test_event.c defines its own
# versions of all three; ../src/test_channel.c likewise defines
# radiant_channel_event_out(). ant_radio_radiant.c defines the production
# versions of the same four symbols (plus radiant_on_message()), so the two
# would collide at link - and if the collision were resolved in
# ant_radio_radiant.c's favour it would change what those 187 tests assert,
# which is worse than a link error because it is quiet.
#
# So: a sibling application, sharing ../fake_radio.c and the module itself, with
# ../src/ deliberately out of the glob. Nothing in the existing suite changes,
# and CI's `twister -T app/radiant/tests` walks subdirectories, so
# testcase.yaml here is picked up with no workflow edit.

cmake_minimum_required(VERSION 3.20.0)

# Two levels up: the module root is radiant/, this is radiant/tests/api.
list(APPEND ZEPHYR_EXTRA_MODULES "${CMAKE_CURRENT_SOURCE_DIR}/../..")

find_package(Zephyr REQUIRED HINTS $ENV{ZEPHYR_BASE})
project(radiant_api_tests)

# Same glob rule as the parent application: a new suite is a new file in src/
# and this file does not change. The parent's glob does not reach in here and
# this one does not reach out there, which is what keeps the two link images
# separate.
file(GLOB suite_sources CONFIGURE_DEPENDS "${CMAKE_CURRENT_SOURCE_DIR}/src/*.c")
target_sources(app PRIVATE ${suite_sources})

# The mock radio, shared with the parent application rather than copied. It is
# the HAL implementation for this image too - prj.conf selects
# CONFIG_RADIANT_BACKEND_NONE for the same reason.
target_sources(app PRIVATE "${CMAKE_CURRENT_SOURCE_DIR}/../fake_radio.c")

# The adapter under test is compiled by the module, through
# CONFIG_RADIANT_ANTR_API=y in prj.conf - the same door a real application uses.

# ../ so a suite writes #include "fake_radio.h", the same spelling the parent's
# suites use. ../../src/antr is for the adapter's private headers; the public
# ones come from the module's own zephyr_include_directories().
target_include_directories(app PRIVATE
  "${CMAKE_CURRENT_SOURCE_DIR}/.."
  "${CMAKE_CURRENT_SOURCE_DIR}/../../src/antr")
```

## Kconfig
```
# SPDX-License-Identifier: Apache-2.0
#
# prj.conf turns CONFIG_RADIANT_ANTR_API on, which is what compiles the adapter
# under test. Any scenario that enables CONFIG_RADIANT_SEC gets the host
# messages too, matching the applications.
config RADIANT_SEC_HOST_MESSAGES
	default y if RADIANT_ANTR_API && RADIANT_SEC

source "Kconfig.zephyr"
```

## prj.conf
```kconfig
# SPDX-License-Identifier: Apache-2.0
#
# Configuration for the radiant_api composition test application.
#
# The difference from ../prj.conf is CONFIG_RADIANT_ANTR_API=y below, which is
# the reason this is a separate application - see the CMakeLists here for why it
# cannot simply be added to the parent's suite.

CONFIG_ZTEST=y

CONFIG_RADIANT=y
# fake_radio.c is the HAL implementation for this image; a second one would be a
# duplicate-symbol link error.
CONFIG_RADIANT_BACKEND_NONE=y
# The adapter under test: the module compiles radiant/src/antr/ when this is on.
CONFIG_RADIANT_ANTR_API=y

# The bounded-denial escape. It defaults from RADIANT_BACKEND_NRF_GATE_MPSL,
# which this image cannot select (it builds the null backend against
# fake_radio.c), so it has to be asked for here - and it is asked for rather
# than the tests being #if-guarded, so that losing the symbol breaks the build
# instead of silently deleting the two tests that defend the fix.
CONFIG_RADIANT_SEARCH_DENIAL_ESCAPE=y

# radiant_api.c runs a real Zephyr thread and a real mutex, so this application
# needs both to exist. The suite drives the radio from the ztest thread and
# leans on the event thread only where it is the subject - the housekeeping
# watchdog - so nothing here waits on it otherwise.
CONFIG_MAIN_STACK_SIZE=4096
CONFIG_ZTEST_STACK_SIZE=4096

# LOG_DBG in radiant_api.c is what a bring-up session is read on. Off by
# default here: a suite that runs eight periods per test would emit a line per
# window, and ztest's own output is the thing being parsed.
CONFIG_LOG=y
CONFIG_RADIANT_LOG_LEVEL_WRN=y
```

## src/test_api_sec.c
```c
/* SPDX-License-Identifier: Apache-2.0 */
/*
 * The on-air half of the zero-cost claim. The `zero-cost` CI job compares
 * section sizes and symbol sets, but can't see the air; this file checks
 * that with CONFIG_RADIANT_SEC compiled in and every switch off at runtime,
 * fake_radio TX bodies and addresses are identical to without it.
 *
 * Joins the `api` suite (rather than its own) to inherit its setup and run
 * in both twister scenarios - feature absent and present - which is what
 * catches "the transform ran when nothing asked it to".
 */

#include <zephyr/ztest.h>
#include <string.h>

#include <radiant/ant_radio.h>
#include <radiant/ant_wire.h>
#include "ant_radio_radiant_priv.h"

#include <radiant/radiant_channel.h>
#include <radiant/radiant_frame.h>
#include <radiant/radiant_radio_hal.h>
#include <radiant/radiant_sec.h>
#include <radiant/radiant_transfer.h>

#include "fake_radio.h"

#define SEC_CH        0u
#define SEC_DEVNUM    0x3A17u
#define SEC_DEVTYPE   0x0Bu
#define SEC_TRANSTYPE 0x05u
#define SEC_RF        57u

/*
 * A transmitted body is [trans_type][ctrl][d0..d7], so the host's payload
 * starts at body[2], not body[1] (the ANT control byte). Matters here
 * because payload byte [1] (body[3]) is what radiant_sec owns on a secured
 * channel - an off-by-one read would make that ownership look like it leaked
 * into a header field the transform must never touch.
 */
#define SEC_BODY_D0  2u
#define SEC_BODY_LEN 10u

/* Every byte distinguishable from a zero, a counter, or a tag byte. Byte [0]
 * is 0x05, inside the default secured page range (0x01..0x0F) - matters for
 * the acknowledgement test below, which needs a page the transform actually
 * touches (0x10 would be one past the range). */
static const uint8_t sec_payload[8] = {
	0x05, 0xA5, 0xC3, 0x5A, 0x77, 0x18, 0x2B, 0x9E,
};

/* The ANT+ network key derives address A6 C5 (what radiant_frame_addr()
 * takes and what goes on air) - the key's own first two bytes (B9 A5) never
 * appear in a frame; confusing the two breaks address assertions for the
 * wrong reason. */
static const uint8_t sec_net_key[8] = {
	0xB9, 0xA5, 0x21, 0xFB, 0xBD, 0x72, 0xC3, 0x45,
};

static const uint8_t sec_net_addr[RADIANT_NET_ADDR_LEN] = {
	RADIANT_NET_ADDR_ANT_PLUS_0,
	RADIANT_NET_ADDR_ANT_PLUS_1,
};

static void sec_open(uint8_t type)
{
	zassert_equal((antr_err_t)ANTW_RESPONSE_NO_ERROR,
		      antr_network_address_set(0u, sec_net_key));
	zassert_equal((antr_err_t)ANTW_RESPONSE_NO_ERROR,
		      antr_channel_assign(SEC_CH, type, 0u, 0u));
	zassert_equal((antr_err_t)ANTW_RESPONSE_NO_ERROR,
		      antr_channel_id_set(SEC_CH, SEC_DEVNUM, SEC_DEVTYPE,
					  SEC_TRANSTYPE));
	zassert_equal((antr_err_t)ANTW_RESPONSE_NO_ERROR,
		      antr_channel_period_set(SEC_CH,
					      RADIANT_CHANNEL_PERIOD_ANT_PLUS));
	zassert_equal((antr_err_t)ANTW_RESPONSE_NO_ERROR,
		      antr_channel_radio_freq_set(SEC_CH, SEC_RF));
	zassert_equal((antr_err_t)ANTW_RESPONSE_NO_ERROR,
		      antr_channel_open(SEC_CH));
}

static void sec_close(void)
{
	(void)antr_channel_close(SEC_CH);
	(void)antr_channel_unassign(SEC_CH);
}

static const struct fake_radio_arm *sec_last_tx(void)
{
	uint32_t i = fake_radio_arm_count();

	while (i-- > 0u) {
		const struct fake_radio_arm *a = fake_radio_arm(i);

		if (a != NULL && a->kind == FAKE_RADIO_ARM_TX &&
		    a->rc == RADIANT_RADIO_OK_RC) {
			return a;
		}
	}
	return NULL;
}

/* A master's own broadcast is 0x0A and its acknowledgement is 0xF2, so the
 * control byte is how the two are told apart in the arm log. */
static const struct fake_radio_arm *sec_last_tx_with_ctrl(uint8_t ctrl)
{
	uint32_t i = fake_radio_arm_count();

	while (i-- > 0u) {
		const struct fake_radio_arm *a = fake_radio_arm(i);

		if (a != NULL && a->kind == FAKE_RADIO_ARM_TX &&
		    a->rc == RADIANT_RADIO_OK_RC && a->body[1] == ctrl) {
			return a;
		}
	}
	return NULL;
}

static void sec_write(void)
{
	uint8_t buf[8];

	memcpy(buf, sec_payload, sizeof(buf));
	zassert_equal((antr_err_t)ANTW_RESPONSE_NO_ERROR,
		      antr_broadcast_message_tx(SEC_CH, 8u, buf));
}

/* Run the armed master slot out, then its turnaround: api_pump_locked()
 * skips a channel whose scheduler slot is still pending, and the turnaround
 * IS that slot until it closes. A reduced copy of test_api.c's
 * run_one_quiet_period() - separate because the two files test different
 * things about the same sequence. */
static void sec_run_slot(void)
{
	const struct fake_radio_arm *tx = sec_last_tx();
	radiant_time_t               t_sync;

	zassert_not_null(tx, "no master slot was armed");
	t_sync = tx->t_sync_at;

	fake_radio_advance_to(t_sync + 1u);
	zassert_true(tx->terminated, "the master's slot did not complete");
	fake_radio_advance_to(t_sync + RADIANT_TRANSFER_SLOT_REPLY_US +
			      RADIANT_TRANSFER_ACK_GUARD_US + 10u);
}

/*
 * Get the channel to a slot that actually carries the host's payload. A
 * master's first slot after open carries zeros by design -
 * api_post_master_tx() transmits from the first slot regardless, since a
 * master waiting for a write would deadlock every host library. The write
 * lands on the SECOND slot; inspecting the first would read an unwritten
 * buffer and call the zeros a transform.
 */
static const struct fake_radio_arm *sec_slot_with_payload(void)
{
	sec_write();
	sec_run_slot();
	sec_write();
	return sec_last_tx();
}

ZTEST(api, test_sec_a_masters_body_is_the_hosts_payload_when_nothing_is_on)
{
	const struct fake_radio_arm *tx;

	sec_open((uint8_t)ANTW_CHANNEL_TYPE_MASTER);
	tx = sec_slot_with_payload();
	zassert_not_null(tx, "the master armed no transmit");

	/* The assertion: body is [trans_type][ctrl][8 payload bytes], byte for
	 * byte the host's. With SEC=n this is a regression guard; with =y
	 * it's the claim - an unkeyed, unconfigured channel transmits exactly
	 * what it would without the transform compiled in. */
	zassert_equal(SEC_BODY_LEN, tx->body_len, "body is %u bytes, not %u",
		      (unsigned)tx->body_len, (unsigned)SEC_BODY_LEN);
	zassert_equal(SEC_TRANSTYPE, tx->body[0], "the header moved");
	zassert_mem_equal(&tx->body[SEC_BODY_D0], sec_payload, 8u,
			  "a channel with no key and no switches changed the "
			  "bytes on the air");
	sec_close();
}

ZTEST(api, test_sec_a_retransmission_is_byte_identical)
{
	const struct fake_radio_arm *tx;
	uint8_t                      first[8];
	uint8_t                      i;

	/* A master retransmits its current body every slot regardless of new
	 * writes. If a transform wrote through to the host's buffer instead
	 * of a copy, the second slot would encrypt already-encrypted bytes -
	 * a receiver would decode only the first slot, looking like a range
	 * problem. */
	sec_open((uint8_t)ANTW_CHANNEL_TYPE_MASTER);
	tx = sec_slot_with_payload();
	zassert_not_null(tx);
	memcpy(first, &tx->body[SEC_BODY_D0], sizeof(first));
	zassert_mem_equal(first, sec_payload, 8u, "the first slot already "
			  "differs; the wrong slot is being inspected");

	for (i = 0u; i < 4u; i++) {
		sec_run_slot();
		tx = sec_last_tx();
		zassert_not_null(tx);
		zassert_mem_equal(&tx->body[SEC_BODY_D0], first, 8u,
				  "slot %u differs from the first without the "
				  "host writing anything", (unsigned)i);
	}
	sec_close();
}

ZTEST(api, test_sec_the_on_air_address_is_the_one_the_channel_id_derives)
{
	struct radiant_channel_id id = {
		.device_number = SEC_DEVNUM,
		.device_type = SEC_DEVTYPE,
		.trans_type = SEC_TRANSTYPE,
	};
	const struct fake_radio_arm *tx;
	uint8_t                      want[RADIANT_RADIO_ADDR_MAX];

	/* The address path is untouched by design - v1 is payload transforms
	 * only. Asserting on a master's own transmit rather than a slave's
	 * receive filters avoids dragging in whatever frame config the search
	 * happens to be sweeping with. */
	zassert_equal((int)RADIANT_FRAME_ADDR_LEN_TRACKING,
		      radiant_frame_addr(RADIANT_FRAME_CFG_TRACKING,
					 sec_net_addr, &id, want,
					 sizeof(want)));

	sec_open((uint8_t)ANTW_CHANNEL_TYPE_MASTER);
	tx = sec_slot_with_payload();
	zassert_not_null(tx);

	zassert_equal(RADIANT_FRAME_ADDR_LEN_TRACKING, tx->addr_len,
		      "the transmit changed address length");
	zassert_mem_equal(tx->addr, want, RADIANT_FRAME_ADDR_LEN_TRACKING,
			  "the address on the air is not the one the channel "
			  "ID derives; a payload transform must not touch the "
			  "address path");
	sec_close();
}

/* The peer's frame, hand-assembled from docs/ant-radio-link.md rather than
 * via the encoder under test:
 *     A6 C5 | dl dh | dtype | ttype | ctrl | d0..d7
 */
#define SEC_AIR_LEN 15u

static void sec_build_peer_frame(uint8_t *out, uint8_t ctrl)
{
	out[0] = RADIANT_NET_ADDR_ANT_PLUS_0;
	out[1] = RADIANT_NET_ADDR_ANT_PLUS_1;
	out[2] = (uint8_t)(SEC_DEVNUM & 0xFFu);
	out[3] = (uint8_t)(SEC_DEVNUM >> 8);
	out[4] = SEC_DEVTYPE;
	out[5] = SEC_TRANSTYPE;
	out[6] = ctrl;
	memset(&out[7], 0x5Au, 8u);
}

ZTEST(api, test_sec_an_acknowledgement_carries_what_the_broadcast_put_on_air)
{
	const struct fake_radio_arm *bcast;
	const struct fake_radio_arm *reply;
	uint8_t                      on_air[8];
	uint8_t                      frame[SEC_AIR_LEN];
	radiant_time_t               t_tx;

	/*
	 * The acknowledgement path is the one that leaks. A master answers
	 * acknowledged data with its own broadcast buffer - the host's
	 * plaintext. Sent verbatim under X_CONF, that hands a passive
	 * listener the plaintext of the ciphertext it heard 1560 us earlier -
	 * a voluntary two-time pad. The fix answers with the ciphertext
	 * already built for the current counter, byte-for-byte identical to
	 * the broadcast slot. That equality is true in both twister scenarios
	 * (both plaintext without the feature, both ciphertext with it),
	 * unlike "the reply is not the plaintext" which only runs one way.
	 */
	sec_open((uint8_t)ANTW_CHANNEL_TYPE_MASTER);

#if defined(CONFIG_RADIANT_SEC)
	{
		static const uint8_t root[16] = {
			0x00, 0x11, 0x22, 0x33, 0x44, 0x55, 0x66, 0x77,
			0x88, 0x99, 0xaa, 0xbb, 0xcc, 0xdd, 0xee, 0xff,
		};

		/* Keyed through radiant_sec directly (the host surface is P6)
		 * since this assertion is about the air, not key delivery. */
		int rc[4];

		/* Under api_lock, as every real caller is. */
		k_mutex_lock(&api_lock, K_FOREVER);
		rc[0] = radiant_sec_set_key(SEC_CH, root, 128, SEC_DEVNUM);
		rc[1] = radiant_sec_set_devnum(SEC_CH, SEC_DEVNUM);
		rc[2] = radiant_sec_configure(SEC_CH, RADIANT_SEC_SW_CONF, 2u,
					      RADIANT_SEC_PAGE_LO_DEFAULT,
					      RADIANT_SEC_PAGE_HI_DEFAULT);
		rc[3] = radiant_sec_set_epoch(SEC_CH, 1u, 0u, 8182u);
		k_mutex_unlock(&api_lock);
		for (int i = 0; i < 4; i++) {
			zassert_equal(RADIANT_SEC_OK, rc[i], "setup step %d", i);
		}
		zassert_true(radiant_sec_channel_is_secured(SEC_CH),
			     "the channel did not arm; the rest of this test "
			     "would assert nothing");
	}
#endif

	sec_write();
	sec_run_slot();
	sec_write();

	bcast = sec_last_tx();
	zassert_not_null(bcast);
	t_tx = bcast->t_sync_at;
	memcpy(on_air, &bcast->body[SEC_BODY_D0], sizeof(on_air));

#if defined(CONFIG_RADIANT_SEC)
	/* sec_payload[0] is inside the default secured range, so this is a
	 * transformed page rather than one that only looks untouched. */
	zassert_true(memcmp(&on_air[2], &sec_payload[2], 5u) != 0,
		     "the broadcast went out in the clear; the exchange below "
		     "would then prove nothing");
#endif

	/* Let the master's own slot and its turnaround exist, then speak into
	 * the turnaround as a slave sending acknowledged data. */
	fake_radio_advance_to(t_tx + 1u);
	sec_build_peer_frame(frame, RADIANT_CTRL_BURST_LAST_SEQ0);
	zassert_equal(RADIANT_RADIO_OK_RC,
		      fake_radio_air_frame(t_tx + RADIANT_TRANSFER_SLOT_REPLY_US,
					   frame, SEC_AIR_LEN));
	fake_radio_advance_to(t_tx + RADIANT_TRANSFER_SLOT_REPLY_US +
			      RADIANT_TRANSFER_REPLY_US + 10u);

	reply = sec_last_tx_with_ctrl(RADIANT_CTRL_ACK_LAST_SEQ1);
	zassert_not_null(reply, "the master did not answer 0xA2 with 0xF2");
	zassert_mem_equal(&reply->body[SEC_BODY_D0], on_air, sizeof(on_air),
			  "the acknowledgement did not carry the bytes the "
			  "broadcast slot put on the air");
	sec_close();
}

#if defined(CONFIG_RADIANT_SEC) && defined(CONFIG_RADIANT_SEC_LOCK_CHECK)
/*
 * TODO security item 8 follow-up. A secured master's re-post after a MISSED,
 * DENIED or completed slot used to be made from api_sched_done(), the
 * scheduler's terminal callback (the radio ISR on a direct build, the SWI
 * under MPSL), where radiant_sec_tx_transform() ran without api_lock: the one
 * shared AES key schedule rewritten under whatever thread held it. Now the
 * callback leaves a secured master to the pump, which posts under api_lock.
 * This image's fake radio runs the callback on the test thread without the
 * lock, so the old path counts a violation (and halts a CONFIG_ASSERT build)
 * exactly as the real one would be wrong; the new one counts none, and the
 * denied master still comes back.
 */
ZTEST(api, test_sec_a_denied_secured_master_slot_is_posted_by_the_pump_under_the_lock)
{
	static const uint8_t root[16] = {
		0x00, 0x11, 0x22, 0x33, 0x44, 0x55, 0x66, 0x77,
		0x88, 0x99, 0xaa, 0xbb, 0xcc, 0xdd, 0xee, 0xff,
	};
	const uint32_t period = (uint32_t)radiant_channel_counts_to_us(
		RADIANT_CHANNEL_PERIOD_ANT_PLUS);
	uint32_t       base;
	uint32_t       tx_before;
	int            rc[4];

	sec_open((uint8_t)ANTW_CHANNEL_TYPE_MASTER);
	k_mutex_lock(&api_lock, K_FOREVER);
	rc[0] = radiant_sec_set_key(SEC_CH, root, 128, SEC_DEVNUM);
	rc[1] = radiant_sec_set_devnum(SEC_CH, SEC_DEVNUM);
	rc[2] = radiant_sec_configure(SEC_CH, RADIANT_SEC_SW_CONF, 2u,
				      RADIANT_SEC_PAGE_LO_DEFAULT,
				      RADIANT_SEC_PAGE_HI_DEFAULT);
	rc[3] = radiant_sec_set_epoch(SEC_CH, 1u, 0u, 8182u);
	k_mutex_unlock(&api_lock);
	for (int i = 0; i < 4; i++) {
		zassert_equal(RADIANT_SEC_OK, rc[i], "setup step %d", i);
	}
	zassert_true(radiant_sec_channel_is_secured(SEC_CH));

	/* From here, so the completion of the very first slot counts: that
	 * terminal is where the old code re-posted the master. */
	base = antr_api_lock_violations;
	sec_write();
	sec_run_slot();
	sec_write();
	tx_before = fake_radio_stats()->arms_tx;
	zassert_true(tx_before > 0u, "setup: nothing was ever transmitted");

	/* The arbiter accepts the next slots and then never grants them: the
	 * DENIED terminal arrives in the radio callback (here, inside
	 * fake_radio_advance_to()), which is where the old code re-posted. Then
	 * it gives the air back; the host keeps writing, as a real one does
	 * every period. */
	fake_radio_force_terminal_repeat(RADIANT_RADIO_STATUS_DENIED, 3u);
	for (int i = 0; i < 6; i++) {
		fake_radio_advance_to(radiant_radio_now() + period);
		sec_write();
	}

	zassert_equal(base, antr_api_lock_violations,
		      "a secured master was re-posted outside api_lock (the "
		      "scheduler's terminal callback)");
	/* Three denied arms plus at least one that went out once the air came
	 * back: only the pump can post those, so a master it stops posting
	 * after a denial falls short. */
	zassert_true(fake_radio_stats()->arms_tx >= tx_before + 4u,
		     "the denied secured master never transmitted again "
		     "(%u arms after %u)", fake_radio_stats()->arms_tx,
		     tx_before);
	sec_close();
}
#endif

ZTEST(api, test_sec_an_unsecured_channel_reports_clear)
{
	/* "Clear" is the honest word for a channel with no transform on it, and
	 * it is a different statement from "unverified". A host that cannot
	 * tell those apart cannot act on either. */
	zassert_equal(RADIANT_SEC_VERDICT_CLEAR,
		      radiant_sec_last_verdict(SEC_CH));
	zassert_false(radiant_sec_channel_is_secured(SEC_CH));
}
```

## src/test_api_sec_host.c
```c
/* SPDX-License-Identifier: Apache-2.0 */
/*
 * The 0xF1-0xF4 adapter: antr_sec_config(), antr_sec_key_set(),
 * antr_sec_epoch_set(), antr_sec_status_get(). Tests the ADAPTER, not the
 * transforms (radiant_sec's own suite covers those): the two ordering
 * rules, the refusals, and the status encoding.
 *
 * Ordering rules: a channel needs its ID before its key (the device number
 * is bound into the KDF and read from the channel, not the wire) and its
 * period before its epoch (period turns a phase into a packet index).
 * Neither fails loudly if skipped - keys under device 0 verify against
 * nothing, a counter from the wrong period drifts like clock error - so
 * both are refused with ANTW_CHANNEL_IN_WRONG_STATE.
 *
 * Compiled only into the radiant.api.sec_host scenario, the only one
 * that links the adapter.
 */

#include <zephyr/kernel.h>

/* The whole file is behind the symbol because CMakeLists.txt globs every
 * `.c` under `src/` into every scenario and two of three don't link the adapter; the
 * antr_sec_* declarations are behind the same #ifdef in src/ant_radio.h so
 * the two halves appear and disappear together. */
#if defined(CONFIG_RADIANT_SEC_HOST_MESSAGES)

#include <zephyr/ztest.h>
#include <string.h>

#include <radiant/ant_radio.h>
#include <radiant/ant_wire.h>
#include "ant_radio_radiant_priv.h"

#include <radiant/radiant_channel.h>
#include <radiant/radiant_sec.h>
#if defined(CONFIG_IRQ_OFFLOAD)
#include <zephyr/irq_offload.h>
#endif

#define HOST_CH     0u
#define HOST_DEVNUM 0x3A17u
#define HOST_DEVTYPE 0x0Bu
#define HOST_TRANS  0x05u
#define HOST_RF     57u

static const uint8_t host_key[16] = {
	0x00, 0x11, 0x22, 0x33, 0x44, 0x55, 0x66, 0x77,
	0x88, 0x99, 0xaa, 0xbb, 0xcc, 0xdd, 0xee, 0xff,
};

static const uint8_t host_net_key[8] = {
	0xB9, 0xA5, 0x21, 0xFB, 0xBD, 0x72, 0xC3, 0x45,
};

/* Assign and identify a channel, without opening it: none of these tests need
 * the radio, and an open channel would leave one armed for the next test. */
static void host_assign(bool with_id, bool with_period)
{
	zassert_equal((antr_err_t)ANTW_RESPONSE_NO_ERROR,
		      antr_network_address_set(0u, host_net_key));
	zassert_equal((antr_err_t)ANTW_RESPONSE_NO_ERROR,
		      antr_channel_assign(HOST_CH,
					  (uint8_t)ANTW_CHANNEL_TYPE_MASTER,
					  0u, 0u));
	if (with_id) {
		zassert_equal((antr_err_t)ANTW_RESPONSE_NO_ERROR,
			      antr_channel_id_set(HOST_CH, HOST_DEVNUM,
						  HOST_DEVTYPE, HOST_TRANS));
	}
	if (with_period) {
		zassert_equal(
			(antr_err_t)ANTW_RESPONSE_NO_ERROR,
			antr_channel_period_set(
				HOST_CH, RADIANT_CHANNEL_PERIOD_ANT_PLUS));
	}
	zassert_equal((antr_err_t)ANTW_RESPONSE_NO_ERROR,
		      antr_channel_radio_freq_set(HOST_CH, HOST_RF));
}

static void host_done(void)
{
	(void)antr_channel_unassign(HOST_CH);
}

static uint16_t rd16(const uint8_t *p)
{
	return (uint16_t)((uint16_t)p[0] | ((uint16_t)p[1] << 8));
}

static uint32_t rd32(const uint8_t *p)
{
	return (uint32_t)p[0] | ((uint32_t)p[1] << 8) |
	       ((uint32_t)p[2] << 16) | ((uint32_t)p[3] << 24);
}

ZTEST(api, test_sec_host_a_key_needs_a_channel_id_first)
{
	host_assign(false, true);

	/*
	 * WRONG STATE, not INVALID_PARAMETER. The key is fine; it arrived too
	 * early. A host that cannot tell those apart retries the wrong thing -
	 * it re-sends the key rather than sending the channel ID.
	 */
	zassert_equal((antr_err_t)ANTW_CHANNEL_IN_WRONG_STATE,
		      antr_sec_key_set(HOST_CH, 128u, host_key),
		      "a key was accepted on a channel with no ID; the KDF "
		      "would have bound device number 0");

	zassert_equal((antr_err_t)ANTW_RESPONSE_NO_ERROR,
		      antr_channel_id_set(HOST_CH, HOST_DEVNUM, HOST_DEVTYPE,
					  HOST_TRANS));
	zassert_equal((antr_err_t)ANTW_RESPONSE_NO_ERROR,
		      antr_sec_key_set(HOST_CH, 128u, host_key));
	host_done();
}

ZTEST(api, test_sec_host_only_a_128_bit_key_is_taken)
{
	host_assign(true, true);

	zassert_equal((antr_err_t)ANTW_INVALID_PARAMETER_PROVIDED,
		      antr_sec_key_set(HOST_CH, 192u, host_key));
	zassert_equal((antr_err_t)ANTW_INVALID_PARAMETER_PROVIDED,
		      antr_sec_key_set(HOST_CH, 64u, host_key));
	zassert_equal((antr_err_t)ANTW_RESPONSE_NO_ERROR,
		      antr_sec_key_set(HOST_CH, 128u, host_key));
	host_done();
}

ZTEST(api, test_sec_host_a_reserved_switch_bit_is_refused_not_masked)
{
	uint8_t bit;

	host_assign(true, true);
	zassert_equal((antr_err_t)ANTW_RESPONSE_NO_ERROR,
		      antr_sec_key_set(HOST_CH, 128u, host_key));

	/*
	 * Masking would enable the switches this version understands and
	 * silently drop the one it does not - so a host asking for a later
	 * switch would be told "yes" and get something weaker than it asked
	 * for, which is the one answer a security surface must never give.
	 */
	for (bit = 0x10u; bit != 0u; bit = (uint8_t)(bit << 1)) {
		zassert_equal((antr_err_t)ANTW_INVALID_PARAMETER_PROVIDED,
			      antr_sec_config(HOST_CH,
					      (uint8_t)(RADIANT_SEC_SW_AUTH |
							bit),
					      2u, 0x01u, 0x0Fu),
			      "reserved bit 0x%02X was accepted",
			      (unsigned)bit);
	}

	zassert_equal((antr_err_t)ANTW_RESPONSE_NO_ERROR,
		      antr_sec_config(HOST_CH, RADIANT_SEC_SW_AUTH, 2u, 0x01u,
				      0x0Fu));
	host_done();
}

ZTEST(api, test_sec_host_the_config_refusals_reach_the_host)
{
	host_assign(true, true);
	zassert_equal((antr_err_t)ANTW_RESPONSE_NO_ERROR,
		      antr_sec_key_set(HOST_CH, 128u, host_key));

	/* W must divide 256 and 65536. */
	zassert_equal((antr_err_t)ANTW_INVALID_PARAMETER_PROVIDED,
		      antr_sec_config(HOST_CH, RADIANT_SEC_SW_AUTH, 3u, 0x01u,
				      0x0Fu));
	/* 0x00 is the descriptor: securing it makes the node undiscoverable. */
	zassert_equal((antr_err_t)ANTW_INVALID_PARAMETER_PROVIDED,
		      antr_sec_config(HOST_CH, RADIANT_SEC_SW_AUTH, 2u, 0x00u,
				      0x0Fu));
	/* 0x50 is common page 80, which every ANT+ receiver understands. */
	zassert_equal((antr_err_t)ANTW_INVALID_PARAMETER_PROVIDED,
		      antr_sec_config(HOST_CH, RADIANT_SEC_SW_AUTH, 2u, 0x01u,
				      0x50u));
	/* The descriptor has no counter and therefore no nonce. */
	zassert_equal((antr_err_t)ANTW_INVALID_PARAMETER_PROVIDED,
		      antr_sec_config(HOST_CH,
				      RADIANT_SEC_SW_CONF |
					      RADIANT_SEC_SW_DESC_CONF,
				      2u, 0x01u, 0x0Fu));
	host_done();
}

ZTEST(api, test_sec_host_an_epoch_needs_a_key_and_only_moves_forwards)
{
	host_assign(true, true);

	/* No key yet: the epoch has nothing to anchor. */
	zassert_equal((antr_err_t)ANTW_CHANNEL_IN_WRONG_STATE,
		      antr_sec_epoch_set(HOST_CH, 0u, 10u, 0u));

	zassert_equal((antr_err_t)ANTW_RESPONSE_NO_ERROR,
		      antr_sec_key_set(HOST_CH, 128u, host_key));
	zassert_equal((antr_err_t)ANTW_RESPONSE_NO_ERROR,
		      antr_sec_config(HOST_CH, RADIANT_SEC_SW_AUTH, 2u, 0x01u,
				      0x0Fu));
	zassert_equal((antr_err_t)ANTW_RESPONSE_NO_ERROR,
		      antr_sec_epoch_set(HOST_CH, 0u, 10u, 0u));

	/*
	 * D3. A reboot that restarted the counter under an unchanged epoch is a
	 * two-time pad for X_CONF and a full session replay against X_AUTH, so
	 * the same epoch twice is refused rather than treated as idempotent.
	 */
	zassert_equal((antr_err_t)ANTW_INVALID_PARAMETER_PROVIDED,
		      antr_sec_epoch_set(HOST_CH, 0u, 10u, 0u));
	zassert_equal((antr_err_t)ANTW_INVALID_PARAMETER_PROVIDED,
		      antr_sec_epoch_set(HOST_CH, 0u, 9u, 0u));
	zassert_equal((antr_err_t)ANTW_RESPONSE_NO_ERROR,
		      antr_sec_epoch_set(HOST_CH, 0u, 11u, 0u));

	/* The top of the range is reserved so a counter wrap has room. */
	zassert_equal((antr_err_t)ANTW_INVALID_PARAMETER_PROVIDED,
		      antr_sec_epoch_set(HOST_CH, 0u, 0xFFFFFFFFu, 0u));

	/* Reserved flag bits. */
	zassert_equal((antr_err_t)ANTW_INVALID_PARAMETER_PROVIDED,
		      antr_sec_epoch_set(HOST_CH, 0x02u, 12u, 0u));
	host_done();
}

ZTEST(api, test_sec_host_status_reports_enrolments)
{
	uint8_t st[ANTR_SEC_STATUS_LEN];

	host_assign(true, true);
	zassert_equal((antr_err_t)ANTW_RESPONSE_NO_ERROR,
		      antr_sec_key_set(HOST_CH, 128u, host_key));

	memset(st, 0xEE, sizeof(st));
	zassert_equal((antr_err_t)ANTW_RESPONSE_NO_ERROR,
		      antr_sec_status_get(HOST_CH, st, sizeof(st)));
	zassert_equal(0u, rd16(&st[24]),
		      "a freshly keyed channel reports enrolments");

	/*
	 * Driven through the internal hook rather than a real pairing: this
	 * tests the ADAPTER's encoding of the counter, and test_profile_enrol.c
	 * already covers which pairings bump it. An enrolment the owner did not
	 * perform is the attack, so the counter has to reach the host at all.
	 */
	k_mutex_lock(&api_lock, K_FOREVER);
	radiant_sec_stat_enrolment(HOST_CH);
	radiant_sec_stat_enrolment(HOST_CH);
	k_mutex_unlock(&api_lock);

	memset(st, 0xEE, sizeof(st));
	zassert_equal((antr_err_t)ANTW_RESPONSE_NO_ERROR,
		      antr_sec_status_get(HOST_CH, st, sizeof(st)));
	zassert_equal((uint8_t)ANTR_SEC_STATUS_VERSION, st[1]);
	zassert_equal(2u, rd16(&st[24]),
		      "enrolments is not little-endian at [24..25]");
	host_done();
}

ZTEST(api, test_sec_host_status_reports_what_was_configured)
{
	uint8_t st[ANTR_SEC_STATUS_LEN];

	host_assign(true, true);
	zassert_equal((antr_err_t)ANTW_RESPONSE_NO_ERROR,
		      antr_sec_key_set(HOST_CH, 128u, host_key));
	zassert_equal((antr_err_t)ANTW_RESPONSE_NO_ERROR,
		      antr_sec_config(HOST_CH,
				      RADIANT_SEC_SW_AUTH | RADIANT_SEC_SW_CONF,
				      4u, 0x02u, 0x1Fu));
	zassert_equal((antr_err_t)ANTW_RESPONSE_NO_ERROR,
		      antr_sec_epoch_set(HOST_CH, 0u, 0x00ABCDEFu, 0u));

	memset(st, 0xEE, sizeof(st));
	zassert_equal((antr_err_t)ANTW_RESPONSE_NO_ERROR,
		      antr_sec_status_get(HOST_CH, st, sizeof(st)));

	zassert_equal(HOST_CH, st[0]);
	zassert_equal(1u, st[1], "0xF4 is not structure version 1");
	zassert_equal(RADIANT_SEC_SW_AUTH | RADIANT_SEC_SW_CONF, st[2]);
	zassert_equal(4u, st[3]);
	zassert_equal(0x02u, st[4]);
	zassert_equal(0x1Fu, st[5]);
	zassert_equal(0x00ABCDEFu, rd32(&st[6]),
		      "the epoch is not little-endian at [6..9]");
	zassert_equal(0u, rd16(&st[12]), "nothing has verified yet");
	zassert_equal((uint8_t)RADIANT_SEC_VERDICT_CLEAR, st[23]);
	zassert_equal(0u, rd16(&st[24]), "nothing has enrolled");
	host_done();
}

ZTEST(api, test_sec_host_an_unkeyed_channel_reads_as_zeros_not_as_an_error)
{
	uint8_t st[ANTR_SEC_STATUS_LEN];

	/*
	 * "No security on this channel" is a state a host must be able to read.
	 * Making it an error would force a host to treat every ordinary channel
	 * as a fault, and a host that learns to ignore one error learns to
	 * ignore them all.
	 */
	memset(st, 0xEE, sizeof(st));
	zassert_equal((antr_err_t)ANTW_RESPONSE_NO_ERROR,
		      antr_sec_status_get(HOST_CH, st, sizeof(st)));

	zassert_equal(HOST_CH, st[0]);
	/* The version describes the layout, not the channel, so it is set
	 * even here: a reader must never see version 0. */
	zassert_equal(1u, st[1], "0xF4 is not structure version 1");
	zassert_equal(0u, st[2], "an unkeyed channel reports switches on");
	zassert_equal((uint8_t)RADIANT_SEC_VERDICT_CLEAR, st[23]);
	zassert_equal(0u, rd16(&st[24]));
}

ZTEST(api, test_sec_host_a_short_status_buffer_is_refused)
{
	uint8_t st[ANTR_SEC_STATUS_LEN];

	/* Refused rather than truncated: a short reply on the wire would be
	 * parsed by field offset and would misreport every counter after the
	 * cut. */
	zassert_equal((antr_err_t)ANTW_INVALID_MESSAGE,
		      antr_sec_status_get(HOST_CH, st,
					  ANTR_SEC_STATUS_LEN - 1u));
	zassert_equal((antr_err_t)ANTW_INVALID_MESSAGE,
		      antr_sec_status_get(HOST_CH, NULL, sizeof(st)));
}

ZTEST(api, test_sec_host_a_channel_out_of_range_is_refused_everywhere)
{
	uint8_t st[ANTR_SEC_STATUS_LEN];
	uint8_t bad = (uint8_t)RADIANT_CHANNEL_COUNT;

	zassert_equal((antr_err_t)ANTW_INVALID_MESSAGE,
		      antr_sec_config(bad, RADIANT_SEC_SW_AUTH, 2u, 0x01u,
				      0x0Fu));
	zassert_equal((antr_err_t)ANTW_INVALID_MESSAGE,
		      antr_sec_key_set(bad, 128u, host_key));
	zassert_equal((antr_err_t)ANTW_INVALID_MESSAGE,
		      antr_sec_epoch_set(bad, 0u, 1u, 0u));
	zassert_equal((antr_err_t)ANTW_INVALID_MESSAGE,
		      antr_sec_status_get(bad, st, sizeof(st)));
}

#if defined(CONFIG_RADIANT_SEC_LOCK_CHECK)

/*
 * TODO security item 8: the 0xF1-0xF5 commands take api_lock. The check is
 * the port hook in ant_radio_radiant.c, counted rather than asserted here
 * (this image builds without CONFIG_ASSERT). Without the lock in
 * ant_sec_host.c every call below counts a violation.
 */
ZTEST(api, test_sec_host_commands_hold_api_lock)
{
	uint8_t  st[ANTR_SEC_STATUS_LEN];
	uint32_t base;

	host_assign(true, true);
	base = antr_api_lock_violations;

	zassert_equal((antr_err_t)ANTW_RESPONSE_NO_ERROR,
		      antr_sec_key_set(HOST_CH, 128u, host_key));
	zassert_equal((antr_err_t)ANTW_RESPONSE_NO_ERROR,
		      antr_sec_config(HOST_CH, RADIANT_SEC_SW_AUTH, 2u, 0x01u,
				      0x0Fu));
	zassert_equal((antr_err_t)ANTW_RESPONSE_NO_ERROR,
		      antr_sec_epoch_set(HOST_CH, 0u, 1u, 0u));
	zassert_equal((antr_err_t)ANTW_RESPONSE_NO_ERROR,
		      antr_sec_status_get(HOST_CH, st, sizeof(st)));
	zassert_equal(base, antr_api_lock_violations,
		      "a 0xF1-0xF4 command reached radiant_sec without "
		      "api_lock");

	host_done();
}

/* The instrument itself: a call that really is unlocked must be counted, or
 * the test above passes on a hook that never fires. The counter is put back
 * so the suite's after-check does not see the deliberate violation. */
ZTEST(api, test_sec_host_the_lock_check_sees_an_unlocked_call)
{
	struct radiant_sec_state state;
	uint32_t                 base = antr_api_lock_violations;

	/* With CONFIG_ASSERT the unlocked call below halts the image, which is
	 * the check working and not something a test can survive: skip, and run
	 * this in the ASSERT-off scenario (the unit is the counter). */
	if (IS_ENABLED(CONFIG_ASSERT)) {
		ztest_test_skip();
	}

	zassert_false(antr_api_lock_held());
	radiant_sec_get_state(HOST_CH, &state);
	zassert_equal(base + 1u, antr_api_lock_violations,
		      "an unlocked radiant_sec call was not counted");

	k_mutex_lock(&api_lock, K_FOREVER);
	zassert_true(antr_api_lock_held());
	radiant_sec_get_state(HOST_CH, &state);
	k_mutex_unlock(&api_lock);
	zassert_equal(base + 1u, antr_api_lock_violations,
		      "a locked call was counted as a violation");

	antr_api_lock_violations = base;
}

#if defined(CONFIG_IRQ_OFFLOAD)
struct isr_probe_result {
	bool held;
	bool ran;
};

static void isr_probe(const void *arg)
{
	struct isr_probe_result *r = (struct isr_probe_result *)arg;

	r->held = antr_api_lock_held();
	radiant_sec_port_lock_check("isr_probe");
	r->ran = true;
}

/* The ISR half of antr_api_lock_held(): an interrupt that lands while the
 * test thread owns api_lock sees that thread as k_current_get(), so the
 * owner check alone would pass it. Only the k_is_in_isr() term refuses it. */
ZTEST(api, test_sec_host_the_lock_check_refuses_an_isr_inside_the_lock)
{
	struct isr_probe_result r = { 0 };
	uint32_t                base = antr_api_lock_violations;

	/* Same reason as the test above: with CONFIG_ASSERT the counted
	 * violation halts the image. */
	if (IS_ENABLED(CONFIG_ASSERT)) {
		ztest_test_skip();
	}

	k_mutex_lock(&api_lock, K_FOREVER);
	zassert_true(antr_api_lock_held());
	irq_offload(isr_probe, &r);
	k_mutex_unlock(&api_lock);

	zassert_true(r.ran, "irq_offload did not run the probe");
	zassert_false(r.held,
		      "an ISR interrupting the lock's owner counted as holding "
		      "api_lock");
	zassert_equal(base + 1u, antr_api_lock_violations,
		      "a radiant_sec check from an ISR was not counted");

	antr_api_lock_violations = base;
}
#endif /* CONFIG_IRQ_OFFLOAD */

#if defined(CONFIG_RADIANT_SEC_PAIRING_X25519)
/*
 * How long a pairing command holds api_lock. Each X25519 is a full scalar
 * multiplication on this build's software implementation; the number printed
 * is the figure to read against the RX thread (which needs api_lock for the
 * pump and the scheduler). Asserts only that the exchange works under the
 * lock and takes under a second.
 */
ZTEST(api, test_sec_host_pairing_holds_api_lock_and_its_hold_time)
{
	static const uint8_t scalar[RADIANT_SEC_X25519_BYTES] = {
		0x77, 0x07, 0x6d, 0x0a, 0x73, 0x18, 0xa5, 0x7d,
		0x3c, 0x16, 0xc1, 0x72, 0x51, 0xb2, 0x66, 0x45,
		0xdf, 0x4c, 0x2f, 0x87, 0xeb, 0xc0, 0x99, 0x2a,
		0xb1, 0x77, 0xfb, 0xa5, 0x1d, 0xb9, 0x2c, 0x2a,
	};
	uint8_t  reply[2 + RADIANT_SEC_X25519_BYTES];
	uint8_t  rlen = 0u;
	uint32_t base;
	uint32_t t0, t_scalar, t_exchange;

	host_assign(true, true);
	base = antr_api_lock_violations;

	zassert_equal((antr_err_t)ANTW_RESPONSE_NO_ERROR,
		      antr_sec_pair(HOST_CH, ANTW_RADIANT_PAIR_ENTER, NULL, 0u,
				    reply, sizeof(reply), &rlen));
	t0 = k_cycle_get_32();
	zassert_equal((antr_err_t)ANTW_RESPONSE_NO_ERROR,
		      antr_sec_pair(HOST_CH, ANTW_RADIANT_PAIR_SCALAR, scalar,
				    sizeof(scalar), reply, sizeof(reply),
				    &rlen));
	t_scalar = k_cycle_get_32() - t0;
	zassert_equal(2u + RADIANT_SEC_X25519_BYTES, rlen);

	/* The peer's public key is the one just produced: a valid, non-
	 * degenerate point, so the exchange runs to the end. */
	uint8_t peer[RADIANT_SEC_X25519_BYTES];

	memcpy(peer, &reply[2], sizeof(peer));
	t0 = k_cycle_get_32();
	zassert_equal((antr_err_t)ANTW_RESPONSE_NO_ERROR,
		      antr_sec_pair(HOST_CH, ANTW_RADIANT_PAIR_EXCHANGE, peer,
				    sizeof(peer), reply, sizeof(reply), &rlen));
	t_exchange = k_cycle_get_32() - t0;

	zassert_equal(base, antr_api_lock_violations,
		      "a 0xF5 command reached radiant_sec without api_lock");

	uint32_t us_scalar = (uint32_t)(((uint64_t)t_scalar * 1000000u) /
					sys_clock_hw_cycles_per_sec());
	uint32_t us_exchange = (uint32_t)(((uint64_t)t_exchange * 1000000u) /
					  sys_clock_hw_cycles_per_sec());

	printk("X25519 api_lock hold: SCALAR %u us, EXCHANGE %u us\n",
	       us_scalar, us_exchange);
	zassert_true(us_scalar < 1000000u && us_exchange < 1000000u);

	(void)antr_sec_pair(HOST_CH, ANTW_RADIANT_PAIR_LEAVE, NULL, 0u, reply,
			    sizeof(reply), &rlen);
	host_done();
}
#endif /* CONFIG_RADIANT_SEC_PAIRING_X25519 */

#endif /* CONFIG_RADIANT_SEC_LOCK_CHECK */

#endif /* CONFIG_RADIANT_SEC_HOST_MESSAGES */
```
