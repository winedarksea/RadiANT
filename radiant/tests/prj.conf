## CMakeLists.txt
```
# SPDX-License-Identifier: Apache-2.0
#
# The radiant unit-test application.
#
# This is a standalone Zephyr application, deliberately not a subdirectory of
# the dongle build: it never includes the top-level CMakeLists.txt, so it has
# no sdk-ant dependency of any kind and the CI job that runs it needs no
# secret. That is the whole point - CI is the one place every C assertion in
# this project runs on every change, and it has to run on forks and on every
# pull request or the parallel core work has no gate at all. Locally,
# native_sim needs Linux (it does not build on Windows); see docs/testing.md.

cmake_minimum_required(VERSION 3.20.0)

# radiant is consumed here exactly as any third party would consume it:
# as a Zephyr module, before find_package(Zephyr), with CONFIG_RADIANT=y
# in prj.conf doing the selecting. This application therefore contains no
# application code of its own beyond the suites and the mock radio - which is
# what earns the module claim. It also means the module owns its source list
# and this file does not duplicate it; the duplicate that used to live here
# was one line per core module and a suite that silently stopped linking the
# module it tests still passes.
list(APPEND ZEPHYR_EXTRA_MODULES "${CMAKE_CURRENT_SOURCE_DIR}/..")

find_package(Zephyr REQUIRED HINTS $ENV{ZEPHYR_BASE})
project(radiant_tests)

# ── Adding a test suite ─────────────────────────────────────────────────────
#
# Drop a .c file into src/ that declares its own ZTEST_SUITE(). Nothing else.
# The glob is CONFIGURE_DEPENDS, and twister configures from scratch on every
# run anyway, so a new file is picked up without editing this file. This is
# structured for a fan-out of parallel agents each owning one core module and
# one suite file: an explicit source list would make this file contested, and
# a contested file serialises the fan-out it exists to enable.
file(GLOB suite_sources CONFIGURE_DEPENDS "${CMAKE_CURRENT_SOURCE_DIR}/src/*.c")
# The one suite whose code is outside the module. See the end of this file.
set(RADIANT_TESTS_APPS_COMMON "${CMAKE_CURRENT_SOURCE_DIR}/../../apps/common")
if(NOT EXISTS "${RADIANT_TESTS_APPS_COMMON}/ant_rgb_led_curve.c")
  list(REMOVE_ITEM suite_sources "${CMAKE_CURRENT_SOURCE_DIR}/src/test_rgb_led_curve.c")
endif()
# Likewise, when radiant/ is built away from the rest of the repository.
if(NOT EXISTS "${RADIANT_TESTS_APPS_COMMON}/ant_health.c")
  list(REMOVE_ITEM suite_sources "${CMAKE_CURRENT_SOURCE_DIR}/src/test_ant_health.c")
endif()
# test_bridge_parser.c and test_bridge_trace*.c include
# apps/common/ant_serial_bridge.c (parser only),
# whose quoted includes resolve beside it and through the ant/ forwarders below.
if(NOT EXISTS "${RADIANT_TESTS_APPS_COMMON}/ant_serial_bridge.c")
  list(REMOVE_ITEM suite_sources "${CMAKE_CURRENT_SOURCE_DIR}/src/test_bridge_parser.c")
  list(REMOVE_ITEM suite_sources "${CMAKE_CURRENT_SOURCE_DIR}/src/test_bridge_trace.c"
                                "${CMAKE_CURRENT_SOURCE_DIR}/src/test_bridge_trace_sec.c")
endif()
target_sources(app PRIVATE ${suite_sources})

# ── The mock radio ──────────────────────────────────────────────────────────
#
# radiant/tests/fake_radio.c implements
# radiant/include/radiant/radiant_radio_hal.h against no hardware,
# and is what makes six of the seven core agents able to work in parallel
# without a board. It is the HAL implementation for this image, which is why
# prj.conf selects CONFIG_RADIANT_BACKEND_NONE: the module compiles no
# backend of its own and this file is the one definition of the eight entry
# points.
target_sources(app PRIVATE "${CMAKE_CURRENT_SOURCE_DIR}/fake_radio.c")

# ── The mock NVM ────────────────────────────────────────────────────────────
#
# The same arrangement one layer up: fake_nvm.c implements include/radiant/radiant_node_nvm.h
# against RAM, so src/node/radiant_node_ident.c is compiled unmodified and the two
# things a real backend cannot be asked to do on demand - a power cycle and a
# write that fails - are callable from a suite.
#
# src/node/radiant_node_nvm_settings.c is deliberately NOT built here. It is the
# shipping backend (the settings subsystem over NVS) and it needs a storage
# partition this test application does not have; linking both would be a
# duplicate-symbol error, which is the same guard CONFIG_RADIANT_BACKEND_
# NONE provides for the radio.
target_sources(app PRIVATE "${CMAKE_CURRENT_SOURCE_DIR}/fake_nvm.c")

# ── The mock entropy source ─────────────────────────────────────────────────
#
# And once more for radiant_sec_rng(): fake_rng.c is deterministic and can be
# told to fail, so radiant_node_ident_boot()'s first-boot provisioning (ADR 0020) is
# testable here. Conditional, unlike the two above, because the scenario with
# the fake OFF is a real configuration - every dongle, which has no entropy
# backend - and there src/radiant_sec.c's refusing radiant_sec_rng() is the
# definition, so linking this too would be a duplicate symbol.
if(CONFIG_RADIANT_TEST_FAKE_RNG)
  target_sources(app PRIVATE "${CMAKE_CURRENT_SOURCE_DIR}/fake_rng.c")
endif()

# ── src/profiles ────────────────────────────────────────────────────────────
#
# The RadiANT telemetry envelope (device type 0x60): docs/radiant-telemetry.md
# in code. Compiled into THIS APPLICATION rather than into the radiant
# module, and the directory boundary is the reason, not convenience:
# docs/decisions/0002-clean-room-policy.md draws its read-scope line at a path.
# radiant/** is strict clean-room; src/profiles/ is the pragmatic side,
# where an implementer may read a page-layout table. A profile encoder that
# linked into the link layer would erase that boundary, so it does not.
#
# (Phase E itself read no gated document at all - it is derived entirely from
# docs/radiant-telemetry.md, which is this project's own specification. The
# separation is structural, so that the next profile author inherits it.)
#
# Listed explicitly rather than globbed: unlike src/ above, this is a library
# and not a suite drop box, and a new file here is a deliberate act.
# radiant_profile_handoff.c and radiant_profile_schedule.c are the two files here that include a
# radiant header: the page codecs are pure, but applying a handoff means
# driving a channel and announcing a clock accuracy means widening one, and a
# format with no consumer would not have been worth specifying. The dependency
# still runs application -> core, which is the direction the module boundary
# permits: these files live inside radiant/src/profiles/ now (they used to
# reach here from outside the module entirely), but radiant's own
# CMakeLists.txt does not compile them into the module's library - only an
# application that lists them, as this one does, links them at all.
target_sources(app PRIVATE
  "${CMAKE_CURRENT_SOURCE_DIR}/../src/profiles/radiant_profile_bits.c"
  "${CMAKE_CURRENT_SOURCE_DIR}/../src/profiles/radiant_profile_telemetry.c"
  "${CMAKE_CURRENT_SOURCE_DIR}/../src/profiles/radiant_profile_sched.c"
  "${CMAKE_CURRENT_SOURCE_DIR}/../src/profiles/radiant_profile_handoff.c"
  "${CMAKE_CURRENT_SOURCE_DIR}/../src/profiles/radiant_profile_schedule.c"
  # The ANT+ compatibility profiles (compat-C5): heart rate 0x78 and bicycle
  # power 0x0B, the common pages they share, and the compat client that inserts
  # the RadiANT beacon and attestation pages through radiant_profile_sched.c's seam.
  #
  # radiant_profile_compat.c is the THIRD file here that includes a radiant header,
  # and it is the only one of the four that does. That is the boundary the phase
  # exists to draw: radiant_profile_hr.c and radiant_profile_power.c reach no radiant
  # header even transitively, so "the profile modules never call radiant_sec" is
  # a property of the include graph rather than a rule somebody remembers.
  "${CMAKE_CURRENT_SOURCE_DIR}/../src/profiles/radiant_profile_common.c"
  "${CMAKE_CURRENT_SOURCE_DIR}/../src/profiles/radiant_profile_compat.c"
  "${CMAKE_CURRENT_SOURCE_DIR}/../src/profiles/radiant_profile_hr.c"
  "${CMAKE_CURRENT_SOURCE_DIR}/../src/profiles/radiant_profile_power.c"
  "${CMAKE_CURRENT_SOURCE_DIR}/../src/profiles/radiant_profile_tracker.c"
  "${CMAKE_CURRENT_SOURCE_DIR}/../src/profiles/radiant_profile_controls.c"
  # Bike Radar (0x28): codecs plus a master. Listed for the reason the
  # radiant_profile_rd.c line below records - the suites are globbed and the
  # implementations are not.
  "${CMAKE_CURRENT_SOURCE_DIR}/../src/profiles/radiant_profile_radar.c"
  # Running dynamics. Listed here for the same reason as its two neighbours -
  # src/test_profile_rd.c is in this application's test sources, so leaving the
  # implementation out is a link error, not a missing test. It was exactly that
  # for a while: the RD phase added the decoder, the adapter in src/bridge and
  # the test, and the adapter's own CMake entry below, but never this line.
  "${CMAKE_CURRENT_SOURCE_DIR}/../src/profiles/radiant_profile_rd.c"
  # The Matter plan's packages A and B: the two page codecs that give the
  # derived booleans a source. radiant_profile_fec.c is Fitness Equipment (0x11), the
  # indoor-trainer path, whose page 16 carries an explicit equipment STATE -
  # a more direct "bike in use" than inferring from an accumulator.
  # radiant_profile_env.c is Environment (0x19), which is a thermometer and nothing
  # else; everything else environmental arrives on common page 84 instead,
  # which is why package C exists.
  #
  # Both are pure page codecs reaching no radiant header, the same claim
  # radiant_profile_hr.c and radiant_profile_power.c make about themselves. Listed here for
  # the reason the radiant_profile_rd.c line above records: the suites are globbed and
  # the implementations are not, so a missing line here is a link error rather
  # than a missing test, and this file has already been that once.
  "${CMAKE_CURRENT_SOURCE_DIR}/../src/profiles/radiant_profile_fec.c"
  "${CMAKE_CURRENT_SOURCE_DIR}/../src/profiles/radiant_profile_env.c"
  # The treadmill's two masters. radiant_profile_fec_tx.c is the TRANSMIT half of
  # 0x11, deliberately a separate translation unit from radiant_profile_fec.c above
  # (the same split radiant_profile_power_decode.c makes) so that a receiver links a
  # decoder and a treadmill links an encoder and neither drags in the other.
  # radiant_profile_sdm.c is Stride Based Speed and Distance, 0x7C, which had no
  # implementation anywhere in this tree before apps/treadmill.
  #
  # Both are pure page codecs plus a radiant_profile_sched client, reaching no radiant
  # header - the same claim the four files above make. Listed here for the
  # reason the radiant_profile_rd.c line records: the suites are globbed and the
  # implementations are not.
  "${CMAKE_CURRENT_SOURCE_DIR}/../src/profiles/radiant_profile_fec_tx.c"
  "${CMAKE_CURRENT_SOURCE_DIR}/../src/profiles/radiant_profile_sdm.c"
  # Light Electric Vehicle (0x14): page codecs plus a master, no suite yet.
  # Listed so the file is compiled at all - the suites are globbed and the
  # implementations are not.
  "${CMAKE_CURRENT_SOURCE_DIR}/../src/profiles/radiant_profile_lev.c"
  # Bicycle Power's page 0x10 decoder, deliberately NOT in radiant_profile_power.c -
  # see that file's own note. This application links both halves; a receiver
  # links only this one.
  "${CMAKE_CURRENT_SOURCE_DIR}/../src/profiles/radiant_profile_power_decode.c"
  # Layer D (compat-C7): the over-air enrolment window. The FOURTH file here
  # that includes a radiant header, and the second that has to - adding a
  # keyholder is a key operation. It names no page number and no frame index,
  # so the boundary radiant_profile_compat.c draws is not widened by it.
  "${CMAKE_CURRENT_SOURCE_DIR}/../src/profiles/radiant_profile_enrol.c"
  # Layer C (compat-C8): the private-mode switch. The FIFTH file here that
  # includes a radiant header and the third that has to - deriving the
  # locator needs K_id and verifying a command needs K_cmd, and both live where
  # the root key does. It names no page number of its own: the announcement is
  # two frames of the beacon page's set, which radiant_profile_compat.h already owns.
  "${CMAKE_CURRENT_SOURCE_DIR}/../src/profiles/radiant_profile_private.c"
  # Adaptive frequency (RF-7): choosing a quieter RF index from the
  # channel-quality map, and announcing the move on page 0x13 before it happens.
  # The SIXTH file here that includes a radiant header and the fourth that
  # has to - it reads radiant_chanmap.h, which is the map ADR 0012 selects from,
  # and radiant_radio_hal.h for the index range. It reaches no scheduler and no
  # search header on purpose: "discovery never moves" is a property of the
  # include graph here, not a rule somebody remembers.
  "${CMAKE_CURRENT_SOURCE_DIR}/../src/profiles/radiant_profile_freq.c"
  # Response slots and the reliable-command state machine (RF-8): section 9's
  # idempotency rule, the inline tag at both widths, and the downlink window
  # radiant_profile_schedule.c has been announcing since RF-5a. The SEVENTH file here
  # that includes a radiant header and the fifth that has to - verifying a
  # command needs a key, and arming a listen slot needs the scheduler. It adds
  # no slot kind to radiant_sched.c and reaches no search header: a response
  # slot is an ordinary bounded receive window, which is the claim
  # test_command.c exists to keep honest.
  "${CMAKE_CURRENT_SOURCE_DIR}/../src/profiles/radiant_profile_command.c"
)

# ── radiant/src/bridge ──────────────────────────────────────────────────
#
# The sample bus and sink registry (P5 of the multiprotocol plan; see
# docs/radiant-bridge.md sections 3-4). Reaches no radiant header, same
# claim radiant/src/profiles/radiant_profile_hr.c makes about itself - this is
# the layer above the profile decoder, and section 2's amended rule 3 draws
# the line there.
target_sources(app PRIVATE
  "${CMAKE_CURRENT_SOURCE_DIR}/../src/bridge/radiant_bridge.c"
  "${CMAKE_CURRENT_SOURCE_DIR}/../src/bridge/radiant_hr_adapter.c"
  # The running-dynamics adapter. It includes include/radiant/radiant_profile_rd.h for the
  # two page decoders rather than re-deriving the bit splits, which is why the
  # src/profiles include directory above is not optional for this file.
  "${CMAKE_CURRENT_SOURCE_DIR}/../src/bridge/radiant_rd_adapter.c"
  # The bike radar adapter (0x28): nearest target, threat, the 2 s
  # target-unavailable timeout. Includes radiant_profile_radar.h for the codecs.
  "${CMAKE_CURRENT_SOURCE_DIR}/../src/bridge/radiant_radar_adapter.c"
  # P6: the binding table (section 5) and the rule evaluator (section 6.1/6.2).
  # radiant_rules.c registers itself as an ordinary RADIANT_SINK_DEFINE()
  # sink, so it needs nothing from CMake beyond being compiled and linked -
  # the ITERABLE_SECTION_ROM(radiant_sink, ...) fragment below already covers
  # every sink in this application, this one included.
  "${CMAKE_CURRENT_SOURCE_DIR}/../src/bridge/radiant_binding.c"
  "${CMAKE_CURRENT_SOURCE_DIR}/../src/bridge/radiant_rules.c"
  # Section 6.3-6.5 personalisation: the zone thresholds radiant_rules.c
  # uses, prior or per-strap. src/test_hr_profile.c is its suite.
  "${CMAKE_CURRENT_SOURCE_DIR}/../src/bridge/radiant_hr_profile.c"
  # The endpoint-name formatter. A pure function over three static tables and
  # NOT a sink, which is why it needs no registration anywhere: both sinks that
  # want a name call it directly. src/test_naming.c is its suite.
  "${CMAKE_CURRENT_SOURCE_DIR}/../src/bridge/radiant_naming.c"
  # The liveness table: the only producer of RADIANT_SAMPLE_STALE, which
  # radiant_rules.c has honoured since P6 with nothing in the tree setting it.
  # Another ordinary RADIANT_SINK_DEFINE() sink, so like radiant_rules.c it
  # needs nothing from CMake beyond this line.
  "${CMAKE_CURRENT_SOURCE_DIR}/../src/bridge/radiant_liveness.c"
  # P7: the Matter plane's type map and endpoint model (section 8.1). Another
  # ordinary sink, and deliberately NOT the Matter stack - see the header.
  "${CMAKE_CURRENT_SOURCE_DIR}/../src/bridge/radiant_matter.c"
  # The Matter plan's packages A, B and C: three more profile adapters on the
  # radiant_hr_adapter.c contract. Each includes its page codec's header from
  # src/profiles rather than re-deriving the bit splits, which is why the
  # src/profiles include directory above is not optional for them either.
  #
  # radiant_common_adapter.c is the odd one and worth the sentence: it is not
  # a device-type adapter at all. ANT+ Common Data Pages Rev 3.1 Table 4-1
  # keys pages 0x40-0x5D on the channel's TRANSMISSION TYPE rather than on the
  # device type, so page 84's weather data is legal on a heart-rate strap or a
  # bike light, and this decoder therefore runs on every bound channel
  # alongside whichever profile adapter owns it. That is the one case in the
  # tree where two producers write one source, and it is why radiant_bridge.h
  # carries a field_id allocation block.
  "${CMAKE_CURRENT_SOURCE_DIR}/../src/bridge/radiant_power_adapter.c"
  "${CMAKE_CURRENT_SOURCE_DIR}/../src/bridge/radiant_env_adapter.c"
  "${CMAKE_CURRENT_SOURCE_DIR}/../src/bridge/radiant_common_adapter.c"
  # The self channels' decisions (apps/dongle_thread/src/self_channels.c keeps
  # only the radiant_ant_* calls). Pure functions; src/test_self_policy.c.
  "${CMAKE_CURRENT_SOURCE_DIR}/../src/bridge/radiant_self_policy.c"
  # mqtt_sink.c's owed-offline list. Pure; src/test_owed.c.
  "${CMAKE_CURRENT_SOURCE_DIR}/../src/bridge/radiant_owed.c"
)
# The linker fragment RADIANT_SINK_DEFINE()'s STRUCT_SECTION_ITERABLE needs -
# see the comment in radiant_bridge_sections.ld for why this is not optional.
zephyr_linker_sources(SECTIONS "${CMAKE_CURRENT_SOURCE_DIR}/../src/bridge/radiant_bridge_sections.ld")

# ── radiant/src/node ────────────────────────────────────────────────────
#
# The hostless node's identity, epoch and pairing scalar (compat-C6):
# docs/decisions/0009-hostless-node-identity.md in code.
#
# Not part of radiant's own library, for the reason the ADR gives in its
# decision 7, not for convenience: radiant is TOLD an epoch and refuses
# one that has not advanced, and putting the persistence inside its library
# would hand every consumer of the module a flash dependency and a storage
# backend to serve one class of node. So the dependency still runs
# application -> core, the same direction as before this directory moved
# inside radiant/src/ - only an application that lists radiant_node_ident.c
# itself, as this one does, links it. There is no new core entry point for a
# node-derived epoch: radiant_node_ident.c calls radiant_sec_set_epoch(), which is the
# same function the host adapter calls with a host-supplied value.
target_sources(app PRIVATE
  "${CMAKE_CURRENT_SOURCE_DIR}/../src/node/radiant_node_ident.c"
)

# This directory, so a suite writes #include "fake_radio.h" rather than
# #include "../fake_radio.h". Suites live in src/ and the mock does not, so
# without this every suite author gets the relative path wrong exactly once.
#
# Nothing else is needed: the module's own zephyr_include_directories() puts
# radiant/include - and only that, now - on the search path for this
# target too. There used to be a second entry, ../src, for <radiant/radiant_ant.h> and
# the generated radiant/include/radiant/radiant_wire.h; radiant_event.c reads radiant_msg.h and
# radiant_wire.h instead now, both inside radiant/include, so no suite
# here has ever needed the application's src/ at all.
target_include_directories(app PRIVATE "${CMAKE_CURRENT_SOURCE_DIR}")

# ── radiant/src/radiant_addr_split.c ────────────────────────────────────────
#
# The nRF backend's software address match (ADR 0019). The backend itself is
# not in this image (CONFIG_RADIANT_BACKEND_NONE), so the module does not
# compile this file here; it is pure, and src/test_addr_split.c is its suite.
# The suite includes the private header by relative path rather than putting
# all of radiant/src on the search path - see the note just above.
target_sources(app PRIVATE
  "${CMAKE_CURRENT_SOURCE_DIR}/../src/radiant_addr_split.c")

# ── apps/common: the activity indicators' arithmetic ────────────────────────
#
# The one file from apps/common this application links, and the split in
# apps/common/ant_rgb_led_curve.h exists to make exactly this possible: it
# reaches no Zephyr header and no Kconfig symbol, so it compiles here with no
# fake LED driver and no CONFIG_ANT_DONGLE_RGB_LED.
#
# BOTH its consumers are unlistable here for the same reason, which is why the
# split earns its keep twice over: ant_rgb_led.c resolves a real led_strip
# device from a `rgb-led0` alias, and ant_heartbeat_led.c a real GPIO from
# `led0`. No test image has either, and adding them here would be a build error
# rather than more coverage.
#
# Listed explicitly, like every implementation above: src/ is globbed and
# implementations are not, so a missing line here is a link error rather than a
# silently missing test.
#
# Guarded so this suite still configures when radiant/ is built on its own, away
# from the rest of the repository. CI's import-smoke job does exactly that.
if(EXISTS "${RADIANT_TESTS_APPS_COMMON}/ant_rgb_led_curve.c")
  target_sources(app PRIVATE "${RADIANT_TESTS_APPS_COMMON}/ant_rgb_led_curve.c")
  target_include_directories(app PRIVATE "${RADIANT_TESTS_APPS_COMMON}")
endif()

# ant_health.c: pulled into src/test_ant_health.c by relative include, so its
# "radiant_wire.h" resolves through the forwarding header beside it.
if(EXISTS "${RADIANT_TESTS_APPS_COMMON}/ant_health.c")
  target_include_directories(app PRIVATE "${RADIANT_TESTS_APPS_COMMON}/ant")
endif()
```

## Kconfig
```
# SPDX-License-Identifier: Apache-2.0
#
# The radiant unit-test application's own Kconfig tree.
#
# It exists for two lines. src/node/Kconfig is sourced by the node and dongle
# applications rather than by radiant/Kconfig (ADR 0009 decision 7: node
# identity lives in the application), so without the rsource below this image
# could not set CONFIG_RADIANT_NODE_IDENT at all - and
# CONFIG_RADIANT_NODE_IDENT_SELF_PROVISION, which depends on it, would compile
# to nothing in the one image that tests it. The fake entropy backend is the
# other line.

rsource "../src/node/Kconfig"

config RADIANT_TEST_FAKE_RNG
	bool "test image: radiant_sec_rng() from tests/fake_rng.c"
	default n
	depends on RADIANT_SEC && !RADIANT_SEC_RNG_PSA && !RADIANT_SEC_RNG_ENTROPY
	select RADIANT_SEC_HAS_RNG
	help
	  Compiles tests/fake_rng.c, a deterministic radiant_sec_rng() with
	  injectable failures, and reports caps.has_rng - the same seam a real
	  entropy backend fills (ADR 0009), so that radiant_node_ident_boot()'s
	  first-boot provisioning (ADR 0020) runs here against the real
	  radiant_node_ident.c. Test images only: nothing outside radiant/tests sources
	  this file.

# The rules sink's per-output switches, repeated from radiant/Kconfig.
#
# There they sit under `if RADIANT_BRIDGE_RULES`, which this image leaves off:
# it compiles radiant_rules.c directly (CMakeLists.txt) instead of through the
# module. Without these lines the symbols would not exist here, so
# radiant_rules.c would see every output as disabled, and testcase.yaml's
# radiant.unit.rules_outputs_off scenario could not assign them at all.
# Same names, same default; the help text lives in radiant/Kconfig.

config RADIANT_BRIDGE_RULES_OUT_WORN
	bool "test image: derive Worn"
	default y

config RADIANT_BRIDGE_RULES_OUT_ACTIVE
	bool "test image: derive Active"
	default y

config RADIANT_BRIDGE_RULES_OUT_AT_REST
	bool "test image: derive At Rest"
	default y

config RADIANT_BRIDGE_RULES_OUT_ZONE2
	bool "test image: derive Zone 2"
	default y

config RADIANT_BRIDGE_RULES_OUT_ZONE3
	bool "test image: derive Zone 3"
	default y

config RADIANT_BRIDGE_RULES_OUT_IN_USE
	bool "test image: derive In Use"
	default y

source "Kconfig.zephyr"
```

## prj.conf
```kconfig
# SPDX-License-Identifier: Apache-2.0
#
# Configuration for the radiant unit-test application.
#
# radiant is pure logic sitting on top of radiant_radio_hal.h, and the
# tests drive it against radiant/tests/fake_radio.c rather than a radio.
# So there is deliberately nothing here about clocks, USB or the ANT stack:
# anything that needs hardware belongs on the bench, not in this application.
#
# Keep this file minimal. Zephyr aborts the build on an assignment to an
# undefined Kconfig symbol, so every line added here is a way for one agent's
# convenience setting to break every other agent's tests.

CONFIG_ZTEST=y

# The module under test, consumed as a module. BACKEND_NONE because
# fake_radio.c in this directory is the HAL implementation for this image, and
# a second one would be a duplicate-symbol link error. CONFIG_RADIANT_ANT_API
# stays at its default of n: these suites test the modules, and they define the
# port hooks the adapter would also define. tests/api is where the adapter runs.
CONFIG_RADIANT=y
CONFIG_RADIANT_BACKEND_NONE=y

# The crypto primitives. On here and off in every product build: the feature's
# governing constraint is that it costs nothing to the overwhelming majority
# who never enable it, so src/radiant_sec_aes.c is Kconfig-gated rather than
# compiled unconditionally the way radiant_crc_repair.c is. This is the door a
# real application uses, and the suite goes through it rather than around it.
#
# No CONFIG_RADIANT_SEC_HOST_MESSAGES line: it depends on RADIANT_ANT_API,
# which is off here, so the host adapter is not part of this image.
CONFIG_RADIANT_SEC=y
# The lock-check hook (suite sec_lock_hook plays the port).
CONFIG_RADIANT_SEC_LOCK_CHECK=y

# Energy detect and the channel-quality map (RF-4). Through the same door a
# bench build uses, and for the same reason CONFIG_RADIANT_SEC is on here:
# without it src/test_ed.c compiles against the header's disabled inlines,
# every map read returns false, and the suite reports a pass for having
# asserted nothing. The scheduler's SLOT_ED branches fold away against a
# compile-time zero, so this is also the only configuration in which the
# phase's own gate - the tracked schedule being identical with ED on - is a
# comparison rather than a tautology.
CONFIG_RADIANT_ED_SCAN=y

# The per-set phase coverage counter (ADR 0018). Off in every product build
# unless an MPSL build asks for the health counters, so src/test_search.c and
# src/test_ant_health.c are the only place it runs.
CONFIG_RADIANT_SEARCH_COVERAGE=y

# ADR 0018 candidate (d2), the booking scheduler. Compiled in so its cases
# run; inert unless a test sets caps.booking, so every other case here still
# tests the scheduler every product build ships.
CONFIG_RADIANT_SCHED_BOOKING=y

# The compat attestation primitives, for the same reason and through the same
# door. Nothing in radiant calls them yet - src/test_sec_compat.c is their
# only caller anywhere - so without this line the suite would link against the
# header's disabled inlines and assert ENOTSUP at every call site while
# reporting a pass.
CONFIG_RADIANT_SEC_COMPAT=y

# Four compat contexts rather than the default two, because compat-C8's gate is
# a NODE PLUS THREE KEYED RECEIVERS: the one that sent the switch command and
# two that did not. Three is the smallest number that can catch the failure the
# private-mode switch is most likely to ship with - a handover that is clean for
# the receiver which asked and a dropout for every other one - and a bench with
# one head unit cannot see it at all.
#
# 672 bytes each, and nothing else changes: the default of two is sized for a
# node, and this image is a room.
CONFIG_RADIANT_SEC_COMPAT_MAX_CHANNELS=4

# X25519 and the pairing state machine (compat-C7).
#
# It WAS a twister-only scenario (testcase.yaml's radiant.unit.pairing),
# and that meant every pairing assertion in this repository - test_sec_pair.c,
# test_sec_x25519.c, radiant_node_ident.c's window and now the whole of Layer D -
# compiled to nothing in the run the hardware gate actually performs
# (scripts/run_ztest_hw.ps1 builds this prj.conf and nothing else). A suite that
# is empty on the gate that must pass is a suite that reports a pass for having
# said nothing, which is the exact failure mode RADIANT_ANT_API=n's comment above
# exists to prevent.
#
# The cost is the software ladder, and it is bounded: test_sec_x25519.c pins one
# X25519 at under 250 ms and the whole of pairing across this application is
# tens of ladders, against the gate's 240-second ceiling.
CONFIG_RADIANT_SEC_PAIRING_X25519=y

# The hostless node's identity, and first-boot provisioning (ADR 0020).
#
# NODE_IDENT is declared by src/node/Kconfig, which this application's own
# Kconfig sources for exactly this line; radiant_node_ident.c itself is listed in
# CMakeLists.txt. NVM_SETTINGS off because fake_nvm.c is the storage backend
# here (it defaults on with NODE_IDENT and would drag in NVS and a storage
# partition this image does not have).
#
# The fake entropy backend is ON in this file for the reason pairing is: the
# hardware gate builds prj.conf, so a test that needs caps.has_rng and is not
# reached from here is a test the gate never runs. With it on,
# CONFIG_RADIANT_NODE_IDENT_SELF_PROVISION defaults on too, which is the
# shipped hrm_ble/treadmill configuration. testcase.yaml's no_pairing scenario
# turns the fake off, and that is the configuration with no entropy and no
# self-provisioning - every dongle's - where the "unprovisioned node cannot
# boot" and "the RNG seam compiles out" cases run instead.
CONFIG_RADIANT_NODE_IDENT=y
CONFIG_RADIANT_NODE_NVM_SETTINGS=n
CONFIG_RADIANT_TEST_FAKE_RNG=y

# The suites build tables of frames and channel state on the stack, and on
# native_sim an overrun surfaces as a wrong answer rather than as a fault -
# which is the worst possible failure mode for a test harness.
CONFIG_MAIN_STACK_SIZE=4096
CONFIG_ZTEST_STACK_SIZE=4096
```

## boards/nrf5340dk_nrf5340_cpuapp.conf
```kconfig
# SPDX-License-Identifier: Apache-2.0
#
# nRF5340 DK only (scripts/run_ztest_hw.ps1). At the default
# CONFIG_ZTEST_ASSERT_VERBOSE=1 this image overflows the 1 MB app-core flash
# (5648 B over on 591174b, 2026-11-19): about 590 KB of it is stringified assert
# text, not code. Level 0 prints file:line on a failure instead (image ~51 %).
# twister on native_sim does not read this file and keeps level 1. Owner-approved
# fallback (2026-11-13) for when the assert-text trim fills again.
CONFIG_ZTEST_ASSERT_VERBOSE=0
```

## src/main.c
```c
/*
 * SPDX-License-Identifier: Apache-2.0
 *
 * Provenance: original work. Nothing here derives from sdk-ant, from an
 * ANT+ device profile document, or from disassembly of libant.a.
 *
 * The harness suite for radiant.
 *
 * These two tests assert host properties every later suite depends on but
 * that can differ between native_sim and the nRF52840/nRF54L target: if
 * either is wrong, the frame/channel/scheduler suites pass while proving
 * nothing.
 *
 * Core module suites go in sibling files under this directory, each with its
 * own ZTEST_SUITE(). Nothing needs to be added to CMakeLists.txt.
 */

#include <stddef.h>
#include <stdint.h>
#include <string.h>

#include <zephyr/toolchain.h>
#include <zephyr/ztest.h>

ZTEST_SUITE(host_abi, NULL, NULL, NULL, NULL, NULL);

/* ANT is little-endian on the wire; frame tests compare struct bytes in
 * memory against a captured frame, which is only meaningful if the host
 * orders bytes the way the target does. */
ZTEST(host_abi, test_host_is_little_endian)
{
	const uint16_t devnum = 0x1234U;
	static const uint8_t on_the_wire[] = { 0x34U, 0x12U };
	uint8_t bytes[sizeof(devnum)];

	zassert_equal(sizeof(uint8_t), 1U, "uint8_t is not one byte");
	zassert_equal(sizeof(devnum), sizeof(on_the_wire),
		      "uint16_t is not two bytes");

	memcpy(bytes, &devnum, sizeof(devnum));

	zassert_mem_equal(bytes, on_the_wire, sizeof(on_the_wire),
			  "host byte order differs from the target's; "
			  "byte-level frame tests on this host prove nothing");
}

/* The frame layer overlays packed structs on a byte buffer; a toolchain that
 * ignored __packed would insert padding and every test would silently pass
 * against a layout no real receiver would accept. */
struct wire_layout_probe {
	uint8_t sync;
	uint16_t devnum;
	uint8_t checksum;
} __packed;

ZTEST(host_abi, test_packed_structs_have_no_padding)
{
	zassert_equal(sizeof(struct wire_layout_probe), 4U,
		      "__packed had no effect: struct is %zu bytes, expected 4",
		      sizeof(struct wire_layout_probe));
	zassert_equal(offsetof(struct wire_layout_probe, devnum), 1U,
		      "__packed struct field was aligned up");
	zassert_equal(offsetof(struct wire_layout_probe, checksum), 3U,
		      "__packed struct field was aligned up");
}
```

## src/bridge_trace_cases.h
```c
/* SPDX-License-Identifier: Apache-2.0 */
/*
 * The host trace (CONFIG_ANT_DONGLE_HOST_TRACE) and the parser-buffer wipe in
 * apps/common/ant_serial_bridge.c: no key byte reaches a trace line or
 * outlives its frame in the parser buffer, whatever the security
 * configuration.
 *
 * Included by test_bridge_trace.c (security compiled out) and
 * test_bridge_trace_sec.c (host security messages and pairing compiled in),
 * after each has set its configuration. Each of those files defines its own
 * suite and one ZTEST per check below: the checks are the same in both,
 * because the redaction must not depend on the configuration.
 *
 * The bridge is included the way test_bridge_parser.c includes it, with
 * ANT_BRIDGE_PARSER_ONLY, plus the trace compiled in and its lines captured
 * through ANT_BRIDGE_TRACE_EMIT instead of logged.
 */

#include <stdarg.h>
#include <stdint.h>
#include <stdio.h>
#include <string.h>

#include <zephyr/ztest.h>
#include <zephyr/logging/log.h>

/* test_bridge_parser.c includes the bridge too and registers its log module;
 * a second registration would be a duplicate symbol. */
#undef LOG_MODULE_REGISTER
#define LOG_MODULE_REGISTER(...) LOG_MODULE_DECLARE(__VA_ARGS__)

#define ANT_BRIDGE_PARSER_ONLY 1
#define CONFIG_ANT_DONGLE_HOST_TRACE 1
#define ANT_BRIDGE_TRACE_EMIT(dir, line) trace_emit((dir), (line))
#define ANT_BRIDGE_CSUM_WRN(...) csum_emit(__VA_ARGS__)

static void trace_emit(const char *dir, const char *line);
static void csum_emit(const char *fmt, ...);
static void dispatch(uint8_t msg_id, const uint8_t *body, uint8_t len);

#include "../../../apps/common/ant_serial_bridge.c"

static char trace_line[4 * RADIANT_WIRE_MAX_FRAME_SIZE + 8];
static unsigned int n_trace;
static unsigned int n_dispatched;
static char csum_line[96];
static unsigned int n_csum;

static void trace_emit(const char *dir, const char *line)
{
	n_trace++;
	snprintf(trace_line, sizeof(trace_line), "%s %s", dir, line);
}

/* The checksum-error log line, captured instead of logged. */
static void csum_emit(const char *fmt, ...)
{
	va_list ap;

	n_csum++;
	va_start(ap, fmt);
	vsnprintf(csum_line, sizeof(csum_line), fmt, ap);
	va_end(ap);
}

static void dispatch(uint8_t msg_id, const uint8_t *body, uint8_t len)
{
	ARG_UNUSED(msg_id);
	ARG_UNUSED(body);
	ARG_UNUSED(len);
	n_dispatched++;
}

static void trace_before(void *f)
{
	ARG_UNUSED(f);
	parser_reset();
	n_trace = 0;
	n_dispatched = 0;
	trace_line[0] = '\0';
	n_csum = 0;
	csum_line[0] = '\0';
}

/* A4 len id body... xor */
static size_t trace_frame_build(uint8_t *out, uint8_t id, const uint8_t *body,
				uint8_t len)
{
	uint8_t x = RADIANT_WIRE_SYNC_TX ^ len ^ id;

	out[0] = RADIANT_WIRE_SYNC_TX;
	out[1] = len;
	out[2] = id;
	for (uint8_t i = 0; i < len; i++) {
		out[3 + i] = body[i];
		x ^= body[i];
	}
	out[3 + len] = x;
	return 4u + len;
}

static void trace_feed(const uint8_t *b, size_t n)
{
	for (size_t i = 0; i < n; i++) {
		process_byte(b[i]);
	}
}

/* "a4 13 46 00" then n_masked "xx" (the checksum among them). */
static void expect_line(const char *dir, const uint8_t *f, size_t keep,
			size_t n_masked)
{
	char want[sizeof(trace_line)];
	size_t o = (size_t)snprintf(want, sizeof(want), "%s", dir);

	for (size_t i = 0; i < keep; i++) {
		o += (size_t)snprintf(want + o, sizeof(want) - o, " %02x", f[i]);
	}
	for (size_t i = 0; i < n_masked; i++) {
		o += (size_t)snprintf(want + o, sizeof(want) - o, " xx");
	}
	zassert_str_equal(want, trace_line, "want \"%s\"", want);
}

/* A key whose every byte is recognisable in hex and none is 0x00 or 0xA4. */
static void fill_key(uint8_t *k, size_t n)
{
	for (size_t i = 0; i < n; i++) {
		k[i] = (uint8_t)(0xC1 + i);
	}
}

static bool body_is_zero(void)
{
	for (size_t i = 0; i < sizeof(parser.msg_body); i++) {
		if (parser.msg_body[i] != 0) {
			return false;
		}
	}
	return true;
}

/* 0x46 [net, key 8]: the network number shows; the key and the checksum
 * (which is the XOR of the key bytes once the header is known) do not. */
static void check_network_key_masked(void)
{
	uint8_t body[9], f[16];
	size_t n;

	body[0] = 0x00;
	fill_key(&body[1], 8);
	n = trace_frame_build(f, RADIANT_WIRE_MESG_NETWORK_KEY_ID, body, sizeof(body));
	trace_feed(f, n);
	zassert_equal(1u, n_trace);
	expect_line("H>", f, 4, 8 + 1);
}

/* 0x7E [key number, key 16]: the key number shows. */
static void check_encrypt_key_masked(void)
{
	uint8_t body[17], f[24];
	size_t n;

	body[0] = 0x03;
	fill_key(&body[1], 16);
	n = trace_frame_build(f, RADIANT_WIRE_MESG_SET_ENCRYPT_KEY_ID, body, sizeof(body));
	trace_feed(f, n);
	zassert_equal(1u, n_trace);
	expect_line("H>", f, 4, 16 + 1);
}

/* 0x76 [net, key 16] (Rev 5.1 sec 9.5.2.25): the network number shows. */
static void check_network_key_128_masked(void)
{
	uint8_t body[17], f[24];
	size_t n;

	body[0] = 0x01;
	fill_key(&body[1], 16);
	n = trace_frame_build(f, RADIANT_WIRE_MESG_SET_128BIT_NETWORK_KEY_ID, body,
			      sizeof(body));
	trace_feed(f, n);
	zassert_equal(1u, n_trace);
	expect_line("H>", f, 4, 16 + 1);
	zassert_true(body_is_zero(), "a 128-bit network key was kept");
}

/* 0x83 store [0x01, NVM index, key 16] (Rev 5.1 sec 9.5.2.36): the operation
 * and the NVM index show. A load [0x00, NVM index, volatile index] is masked
 * the same way: the operation byte does not get to decide. */
static void check_crypto_key_nvm_masked(void)
{
	uint8_t body[18], f[24];
	const uint8_t load[] = {0x00, 0x01, 0x00};
	size_t n;

	body[0] = 0x01;
	body[1] = 0x02;
	fill_key(&body[2], 16);
	n = trace_frame_build(f, RADIANT_WIRE_MESG_CRYPTO_KEY_NVM_OP_ID, body,
			      sizeof(body));
	trace_feed(f, n);
	zassert_equal(1u, n_trace);
	expect_line("H>", f, 5, 16 + 1);
	zassert_true(body_is_zero(), "an NVM crypto key was kept");

	n = trace_frame_build(f, RADIANT_WIRE_MESG_CRYPTO_KEY_NVM_OP_ID, load,
			      sizeof(load));
	trace_feed(f, n);
	zassert_equal(2u, n_trace);
	expect_line("H>", f, 5, 1 + 1);
}

/* The checksum-error log line names the message and nothing of its body:
 * with the header known, the expected checksum is the XOR of the key bytes,
 * and the received one differs from it by the line error, so neither may be
 * logged. Covers a key frame, a frame whose id byte was lost (the key number
 * read as the id), and a plain frame, whose line has the same shape. */
static void check_checksum_error_line_holds_no_checksum(void)
{
	uint8_t body[17], f[24];
	size_t n;

	body[0] = 0x00;
	fill_key(&body[1], 16);
	n = trace_frame_build(f, RADIANT_WIRE_MESG_SET_ENCRYPT_KEY_ID, body,
			      sizeof(body));
	f[n - 1] ^= 0x01;
	trace_feed(f, n);
	zassert_equal(0u, n_dispatched);
	zassert_equal(1u, n_csum);
	zassert_str_equal("Checksum err: id 0x7E len 17", csum_line, "\"%s\"",
			  csum_line);

	body[0] = 0x03;
	n = trace_frame_build(f, RADIANT_WIRE_MESG_SET_ENCRYPT_KEY_ID, body,
			      sizeof(body));
	memmove(&f[2], &f[3], n - 3);
	trace_feed(f, n - 1);
	trace_feed((const uint8_t[]){0x00}, 1);
	zassert_equal(2u, n_csum);
	zassert_str_equal("Checksum err: id 0x03 len 17", csum_line, "\"%s\"",
			  csum_line);

	n = trace_frame_build(f, RADIANT_WIRE_MESG_CHANNEL_RADIO_FREQ_ID,
			      (const uint8_t[]){0x00, 0x39}, 2);
	f[n - 1] ^= 0x01;
	trace_feed(f, n);
	zassert_equal(3u, n_csum);
	zassert_str_equal("Checksum err: id 0x45 len 2", csum_line, "\"%s\"",
			  csum_line);
	zassert_equal(0u, n_dispatched);
}

/* 0xF2 [channel, key bits, key 16]: channel and key length show. */
static void check_radiant_key_masked(void)
{
	uint8_t body[18], f[24];
	size_t n;

	body[0] = 0x01;
	body[1] = 128;
	fill_key(&body[2], 16);
	n = trace_frame_build(f, RADIANT_WIRE_MESG_RADIANT_SET_KEY_ID, body, sizeof(body));
	trace_feed(f, n);
	zassert_equal(1u, n_trace);
	expect_line("H>", f, 5, 16 + 1);
}

/* 0xF5 sub-command 0x02 [channel, 0x02, scalar 32]: nothing past the id
 * shows, not even the sub-command, so no sub-command can leak by being
 * classified wrongly. */
static void check_pairing_masked(void)
{
	uint8_t body[34], f[40];
	size_t n;

	body[0] = 0x00;
	body[1] = 0x02;
	fill_key(&body[2], 32);
	n = trace_frame_build(f, RADIANT_WIRE_MESG_RADIANT_PAIRING_ID, body, sizeof(body));
	trace_feed(f, n);
	zassert_equal(1u, n_trace);
	expect_line("H>", f, 3, 34 + 1);
}

/* The other direction goes through the same masking: a 0xF5 reply. */
static void check_outbound_pairing_masked(void)
{
	uint8_t body[34], f[40];
	size_t n;

	body[0] = 0x00;
	body[1] = 0x03;
	fill_key(&body[2], 32);
	n = trace_frame_build(f, RADIANT_WIRE_MESG_RADIANT_PAIRING_ID, body, sizeof(body));
	TRACE_TX(f, n);
	zassert_equal(1u, n_trace);
	expect_line("<D", f, 3, 34 + 1);
}

/* A frame with no key in it is traced whole, checksum included. */
static void check_plain_frame_whole(void)
{
	const uint8_t body[] = {0x00, 0x39};
	uint8_t f[8];
	size_t n = trace_frame_build(f, RADIANT_WIRE_MESG_CHANNEL_RADIO_FREQ_ID, body,
				     sizeof(body));

	trace_feed(f, n);
	zassert_equal(1u, n_trace);
	expect_line("H>", f, n, 0);
	zassert_equal(0x39, parser.msg_body[1], "a plain body was wiped");
}

/* Every key-carrying message leaves the parser buffer zeroed once its frame
 * ends, the ANT ones as well as RadiANT's. */
static void check_key_bodies_wiped(void)
{
	static const uint8_t ids[] = {
		RADIANT_WIRE_MESG_NETWORK_KEY_ID,
		RADIANT_WIRE_MESG_SET_ENCRYPT_KEY_ID,
		RADIANT_WIRE_MESG_RADIANT_SET_KEY_ID,
		RADIANT_WIRE_MESG_RADIANT_PAIRING_ID,
		RADIANT_WIRE_MESG_SET_128BIT_NETWORK_KEY_ID,
		RADIANT_WIRE_MESG_CRYPTO_KEY_NVM_OP_ID,
	};

	for (size_t k = 0; k < ARRAY_SIZE(ids); k++) {
		uint8_t body[18], f[24];
		size_t n;

		body[0] = 0x01;
		fill_key(&body[1], sizeof(body) - 1);
		n = trace_frame_build(f, ids[k], body, sizeof(body));
		trace_feed(f, n);
		zassert_equal(k + 1, n_dispatched);
		zassert_true(body_is_zero(), "0x%02x body kept", ids[k]);
	}
}

/* A key frame that fails its checksum is wiped too: it was still a key. */
static void check_bad_checksum_key_wiped(void)
{
	uint8_t body[17], f[24];
	size_t n;

	body[0] = 0x00;
	fill_key(&body[1], 16);
	n = trace_frame_build(f, RADIANT_WIRE_MESG_SET_ENCRYPT_KEY_ID, body, sizeof(body));
	f[n - 1] ^= 0x01;
	zassert_not_equal(RADIANT_WIRE_SYNC_TX, f[n - 1]);
	trace_feed(f, n);
	zassert_equal(0u, n_dispatched);
	zassert_true(body_is_zero(), "a bad-checksum key frame was kept");
}

/* A frame that fails its checksum is wiped whatever its id: a UART overrun
 * that drops the id byte of a 0x7E makes its key number the id and leaves
 * the key in the body under an id that carries none. */
static void check_bad_checksum_any_id_wiped(void)
{
	uint8_t body[17], f[24];
	size_t n;

	body[0] = 0x03;
	fill_key(&body[1], 16);
	n = trace_frame_build(f, RADIANT_WIRE_MESG_SET_ENCRYPT_KEY_ID, body, sizeof(body));
	/* Drop the id byte: LEN 0x11, then the key number read as the id. */
	memmove(&f[2], &f[3], n - 3);
	trace_feed(f, n - 1);
	trace_feed((const uint8_t[]){0x00}, 1);	/* the byte taken as checksum */
	zassert_equal(0u, n_dispatched);
	zassert_equal(0u, n_trace);
	zassert_true(body_is_zero(), "a failed frame's body was kept");
}

/* 0x7F type 0x02 is an RNG seed: the type shows, the seed does not, and it is
 * wiped. */
static void check_rng_seed_masked_and_wiped(void)
{
	uint8_t body[17], f[24];
	size_t n;

	body[0] = RADIANT_WIRE_ENCRYPTION_INFO_SET_RNG_SEED;
	fill_key(&body[1], 16);
	n = trace_frame_build(f, RADIANT_WIRE_MESG_SET_ENCRYPT_INFO_ID, body, sizeof(body));
	trace_feed(f, n);
	zassert_equal(1u, n_trace);
	expect_line("H>", f, 4, 16 + 1);
	zassert_true(body_is_zero(), "an RNG seed was kept");
}

/* Other 0x7F types are not secret: traced whole, not wiped. */
static void check_crypto_id_info_whole(void)
{
	const uint8_t body[] = {RADIANT_WIRE_ENCRYPTION_INFO_SET_CRYPTO_ID,
				0x11, 0x22, 0x33, 0x44};
	uint8_t f[12];
	size_t n = trace_frame_build(f, RADIANT_WIRE_MESG_SET_ENCRYPT_INFO_ID, body,
				     sizeof(body));

	trace_feed(f, n);
	zassert_equal(1u, n_trace);
	expect_line("H>", f, n, 0);
	zassert_equal(0x44, parser.msg_body[4]);
}
```

## src/test_ant_health.c
```c
/* SPDX-License-Identifier: Apache-2.0 */
/*
 * The 0xF6 reply's optional fields: coverage [30..31] and UART receiver
 * overruns [32..33].
 *
 * ant_health.c is the host's copy of the reply and lives in apps/common, so it
 * is pulled in here by relative include with the health symbol forced on and
 * the sweep's getter replaced. The thing under test is fill(): the body
 * length, the field, and above all that saturating this field does not set
 * the flag in [1] - one long-running counter would otherwise mark every other
 * field on the board as a floor, and that is the bug that kept the idle sweep
 * field out of this reply.
 */

#include <stdint.h>
#include <string.h>

#include <zephyr/ztest.h>

#if defined(CONFIG_RADIANT_SEARCH_COVERAGE)

#define CONFIG_ANT_DONGLE_HEALTH_COUNTERS 1

#define radiant_search_sets_uncovered_get test_sets_uncovered_get
static uint32_t test_uncovered;
uint32_t test_sets_uncovered_get(void);

/* The file under test, built into this translation unit so its statics are
 * this suite's own and the getter above is the one it calls. */
#include "../../../apps/common/ant_health.c"

uint32_t test_sets_uncovered_get(void)
{
	return test_uncovered;
}

static void health_before(void *f)
{
	ARG_UNUSED(f);
	test_uncovered = 0u;
	atomic_set(&saturated, 0);
	atomic_set(&measured, 0);
	atomic_set(&counters[ANT_HEALTH_UART_RX_OVERRUN], 0);
}

ZTEST_SUITE(ant_health_coverage, NULL, NULL, health_before, NULL, NULL);

ZTEST(ant_health_coverage, test_a_coverage_build_answers_34_bytes)
{
	uint8_t out[38];

	test_uncovered = 0x1234u;

	zassert_equal(34u, ant_health_fill(out, sizeof(out)));
	zassert_equal(1u, out[0], "the structure version stays 1");
	zassert_equal(0x34u, out[30]);
	zassert_equal(0x12u, out[31]);
}

ZTEST(ant_health_coverage, test_saturating_the_coverage_field_does_not_set_the_flag)
{
	uint8_t out[38];

	test_uncovered = 70000u;

	zassert_equal(34u, ant_health_fill(out, sizeof(out)));
	zassert_equal(0xFEu, out[30]);
	zassert_equal(0xFFu, out[31],
		      "the field clamps at 65534, one short of not-measured");
	zassert_equal(0u, out[1] & 0x01u,
		      "a long-running field set the flag every other field reads");
}

/* cap has to fit this build's body, and an undersized cap is refused rather
 * than a truncated reply being written. */
ZTEST(ant_health_coverage, test_a_buffer_too_small_for_this_build_is_refused)
{
	uint8_t out[38];

	zassert_equal(0u, ant_health_fill(out, 33u),
		      "33 bytes cannot hold the body");
	zassert_equal(34u, ant_health_fill(out, 34u));
}

/* [32..33]: not measured until the transport says it can be, and then a
 * count - never 0 for "cannot tell". */
ZTEST(ant_health_coverage, test_overrun_reads_not_measured_until_declared)
{
	uint8_t out[38];

	ant_health_note(ANT_HEALTH_UART_RX_OVERRUN);
	zassert_equal(34u, ant_health_fill(out, sizeof(out)));
	zassert_equal(0xFFu, out[32]);
	zassert_equal(0xFFu, out[33], "undeclared reads ANT_HEALTH_NOT_MEASURED");

	ant_health_measured(ANT_HEALTH_UART_RX_OVERRUN);
	ant_health_note(ANT_HEALTH_UART_RX_OVERRUN);
	zassert_equal(34u, ant_health_fill(out, sizeof(out)));
	zassert_equal(2u, out[32]);
	zassert_equal(0u, out[33]);
	zassert_equal(0u, out[1] & 0x01u);
}

ZTEST(ant_health_coverage, test_a_saturated_overrun_never_reads_as_the_sentinel)
{
	uint8_t out[38];

	ant_health_measured(ANT_HEALTH_UART_RX_OVERRUN);
	atomic_set(&counters[ANT_HEALTH_UART_RX_OVERRUN], 0xFFFF);
	zassert_equal(34u, ant_health_fill(out, sizeof(out)));
	zassert_equal(0xFEu, out[32]);
	zassert_equal(0xFFu, out[33]);
	zassert_equal(1u, out[1] & 0x01u,
		      "a saturated count sets the flag, in this same reply");
}

#endif /* CONFIG_RADIANT_SEARCH_COVERAGE */
```
