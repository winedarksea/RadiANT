## CMakeLists.txt
```
# SPDX-License-Identifier: Apache-2.0

cmake_minimum_required(VERSION 3.20.0)

# BEFORE find_package(Zephyr), because ZEPHYR_EXTRA_MODULES is read during it -
# the same ordering the root CMakeLists.txt documents at length. Appended
# unconditionally: radiant/CMakeLists.txt returns immediately when
# CONFIG_RADIANT is n, so the uncontrolled half of the A/B pays nothing for
# it, while leaving it out would make CONFIG_RADIANT an UNDEFINED symbol -
# and an undefined symbol in rx_ant.conf is a warning, not an error, so the
# contended build would quietly become the uncontended one.
list(APPEND ZEPHYR_EXTRA_MODULES "${CMAKE_CURRENT_SOURCE_DIR}/../radiant")

find_package(Zephyr REQUIRED HINTS $ENV{ZEPHYR_BASE})
project(coex154)

target_sources(app PRIVATE src/main.c)
```

## Kconfig
```
# SPDX-License-Identifier: Apache-2.0

mainmenu "coex154 - the P3.5 802.15.4 blackout measurement"

choice
	prompt "Role"
	default COEX154_ROLE_RX
	help
	  Which end of the measurement this image is. Both ends are the same
	  application on purpose: the frame layout and the sequence arithmetic
	  have to agree exactly, and two programs that agree by inspection are
	  two programs that stop agreeing.

config COEX154_ROLE_RX
	bool "Receiver - counts frames and reports exact loss"
	help
	  The DUT. Sits in promiscuous receive and tallies frames by the
	  sequence number in their payload, so loss is computed from what was
	  SENT rather than from what was expected to be sent. This is the end
	  that also runs radiant_core, and therefore the end whose radio is
	  being taken away.

config COEX154_ROLE_TX
	bool "Transmitter - the traffic generator"
	help
	  The reference end. Sends a counted, evenly-spaced stream and nothing
	  else. It must NOT run radiant_core: a generator whose own radio is
	  arbitrated cannot tell "the DUT did not hear it" from "it was never
	  sent", which is the one distinction the whole measurement rests on.

endchoice

config COEX154_CHANNEL
	int "802.15.4 channel"
	range 11 26
	default 26
	help
	  26 by default, and deliberately the top of the band: it is the
	  furthest 802.15.4 channel from the 2.4 GHz BLE advertising channels
	  (2402/2426/2480 MHz) and from most Wi-Fi. This measurement is about
	  the ARBITER taking the radio away, so ambient air must not be a
	  competing explanation for a missing frame.

config COEX154_PAN_ID
	hex "PAN id"
	default 0xca7e

config COEX154_PSDU_LEN
	int "PSDU length in bytes, including the 2-byte FCS"
	range 21 127
	default 127
	help
	  127 is the maximum, ~4.25 ms on air at 250 kbps, and it is the row
	  docs/radiant-bridge.md section 7.3a predicts 18 % (24 % with the
	  follow-on reserve) for. Set 40 for the other column of that table.

	  The floor of 21 is the header (9) plus the payload this application
	  needs to identify a frame as its own and number it (10) plus FCS (2).

config COEX154_TX_INTERVAL_MS
	int "Milliseconds between transmitted frames"
	range 5 10000
	default 20
	help
	  20 ms is 50 frames a second, which gathers a statistically useful
	  count in a minute without saturating the channel - at 4.25 ms a frame
	  that is a 21 % duty cycle, well clear of the CCA backoff region where
	  the generator's own retries would become the thing being measured.

config COEX154_TX_COUNT
	int "How many frames to send, 0 for endless"
	default 0

config COEX154_ANT_MASTERS
	int "ANT+ master channels the receiver runs alongside 802.15.4"
	depends on COEX154_ROLE_RX && RADIANT_CORE
	range 0 8
	default 8
	help
	  THE BLACKOUT GENERATOR, and it is masters rather than a receiver on
	  purpose.

	  docs/radiant-bridge.md section 7.3a models loss as N blackouts per
	  period against frame duration, and its rows are labelled "tracked
	  sensors". A RECEIVER cannot produce that: a channel that is searching
	  blacks out on a sweep schedule, and a channel that is tracking blacks
	  out only for as long as a real sensor keeps transmitting to it. Both
	  make the ANT duty cycle a property of the room. A MASTER transmits
	  every channel period whether anyone is listening or not, so N is
	  exactly this number and the measurement is repeatable on a bench with
	  no sensors on it at all.

	  8 is section 7.3a's headline row - "8 tracked sensors, ~4 % aggregate
	  duty, 18 % of max-size frames clipped" - which is the figure P3.5
	  exists to confirm or refute. 16 and 32 are the other rows and this
	  hardware cannot reach them; 8 channels is the ceiling the range above
	  records rather than hides.

	  0 turns ANT off while leaving radiant_core linked and initialised,
	  which is a THIRD arm of the A/B and a useful one: it separates the
	  cost of the arbiter merely being present from the cost of the air it
	  takes away.

config COEX154_ANT_BUNCHED
	bool "Open every ANT master at offset zero instead of spreading them"
	depends on COEX154_ROLE_RX && RADIANT_CORE
	help
	  THE THIRD ARM. With this n (the default) the masters' start offsets are
	  spread evenly across the channel period, which is what section 7.3a's
	  arithmetic assumes: N independent blackouts scattered through the
	  period, each clipping whatever 802.15.4 frame happens to be in the air.

	  With it y every master opens at offset zero, so all N transmit slots
	  land in the same few milliseconds and are followed by ~240 ms of clear
	  air. The aggregate duty cycle is identical; only its shape changes.
	  Section 7.3a asserts that clustering is guaranteed rather than
	  avoidable, and this arm is what tests that: if the bunched loss is much
	  lower than the spread loss at the same duty, then the shape matters and
	  scattering the offsets is worth doing.

	  Note what bunching does to worst_gap: spread losses are isolated single
	  frames, bunched losses are runs. Read worst_gap, not just the
	  percentage - a retrying stack absorbs the first and not the second.

config COEX154_ARBITRATED
	bool
	default y if RADIANT_CORE_BACKEND_NRF_GATE_MPSL
	select NRF_802154_MULTIPROTOCOL_SUPPORT
	help
	  Not user-facing. Exists solely to reach
	  NRF_802154_MULTIPROTOCOL_SUPPORT, which has no prompt and so cannot be
	  set from a .conf file at all - assigning it there is a hard Kconfig
	  error, not a silent drop, which is the one merciful thing about it.

	  THIS SELECT IS REDUNDANT, AND THE PARAGRAPH THAT USED TO BE HERE WAS
	  WRONG. It claimed the symbol is "selected only by the OpenThread
	  integration", so that an application reaching nrf_802154 directly would
	  get a driver that ignores MPSL and programs the RADIO over the top of
	  the gate's timeslot. Checked against the generated .config on
	  2026-08-12: not so. NRF_802154_RADIO_DRIVER=y is sufficient on its own -
	  nrfxlib's Kconfig.nrfxlib defaults NRF_802154_SOURCE_NRFXLIB and then
	  NRF_802154_SL, NRF_802154_SL does `select MPSL`, and MPSL does
	  `select NRF_802154_MULTIPROTOCOL_SUPPORT if NRF_802154_RADIO_DRIVER`.
	  Every coex154 image already had both symbols set.

	  Kept anyway, and only because the intent is worth stating: nothing in
	  this application would fail if it were deleted, and a reader who deletes
	  it should know they are relying on an nrfxlib choice default rather than
	  on anything here.

	  THE CONSEQUENCE FOR THE A/B IS THE PART THAT MATTERS. This symbol cannot
	  key arbitration off the control arm, because nothing can: on nRF54L
	  there is no build of this driver that does not talk to MPSL. So the
	  "uncontended" arm is 15.4-with-an-arbiter-and-no-competitor, not
	  15.4-with-no-arbiter, and the A/B measures what a second stack's DEMAND
	  costs rather than what arbitration itself costs. Getting the latter
	  would mean NRF_802154_SL_OPENSOURCE=y or NRF_802154_SOURCE_HAL_NORDIC=y,
	  which swaps the Service Layer wholesale - a different driver, not this
	  one with arbitration removed - and is therefore not a control arm for
	  this experiment either.

config COEX154_REPORT_S
	int "Seconds between receiver reports"
	default 10

source "Kconfig.zephyr"
```

## prj.conf
```kconfig
# SPDX-License-Identifier: Apache-2.0
#
# P3.5's stub 802.15.4 pair. See src/main.c for what is being measured and why
# it is not OpenThread.

CONFIG_LOG=y
# IMMEDIATE, not deferred. Deferred logging needs its own thread to run, and
# this application spends its life inside radio callbacks; the first symptom of
# getting that wrong here was a boot banner (printk, synchronous) followed by
# total silence, which reads exactly like a hang in nrf_802154_init(). The
# throughput cost is irrelevant - this prints once every ten seconds.
CONFIG_LOG_MODE_IMMEDIATE=y
CONFIG_SERIAL=y
CONFIG_CONSOLE=y
CONFIG_UART_CONSOLE=y
CONFIG_MAIN_STACK_SIZE=2048

# THE LOG GOES OUT THE VCOM, NOT RTT, and this is not the default. Without
# these three the image boots, runs, and prints absolutely nothing to COM7 -
# which on a board with no other output is indistinguishable from a dead image.
# Same reasoning as boards/nrf54l15dk_nrf54l15_cpuapp.conf in the root
# application: the VCOM is a COM port over the cable that already programs the
# board, whereas RTT would need SEGGER's JLinkARM DLL on the host.
CONFIG_LOG_BACKEND_UART=y
CONFIG_USE_SEGGER_RTT=n
CONFIG_LOG_BACKEND_RTT=n

# The radio driver, from nrfxlib rather than serialised to another core. On the
# nRF54L15 the RADIO is on the only core there is; the nRF5340 build overrides
# this - see nrf5340.conf.
#
# WHICH driver, not WHETHER. NRF_802154_SOURCE_NRFXLIB on its own adds no
# include path and no library: the build fails on a missing nrf_802154.h with
# every symbol apparently set. NRF_802154_RADIO_DRIVER is the one that matters,
# and nothing in tree ever sets it explicitly - it is defaulted to y by
# nrf/subsys/net/openthread's defconfig - so an application that wants the
# driver WITHOUT OpenThread has to ask.
#
# IT IS ASKED FOR PER BOARD, NOT HERE, because the two boards this application
# runs on cannot both have it. RADIO_DRIVER `depends on
# HAS_HW_NRF_RADIO_IEEE802154`, and on the nRF5340 the RADIO is on the NETWORK
# core - so on cpuapp the symbol is unsatisfiable and setting it here would be
# dropped with a warning among a hundred others, leaving an image with no radio
# at all and an exit code of 0. See boards/.
CONFIG_NRF_802154_SOURCE_NRFXLIB=y

# NOT the Zephyr ieee802154 driver, and not the network stack it delivers into.
# main.c explains at length; the short version is that a frame counter does not
# need an L2 and an L2 is one more place for a frame to vanish for a reason that
# is not the arbiter.
CONFIG_NETWORKING=n
CONFIG_IEEE802154=n

# NO TEMPERATURE COMPENSATION, and it is not an optimisation.
#
# NRF_802154_TEMPERATURE_UPDATE defaults on and drags in SENSOR and TEMP_NRF5 -
# which on this SoC resolves to TEMP_NRF5_MPSL, a driver that reads the die
# temperature THROUGH MPSL at POST_KERNEL priority 91. The observed failure was
# a boot banner and then nothing at all: main() was never reached and no fault
# was printed, because the hang is before the application exists.
#
# What it buys is CCA threshold and crystal drift compensation over
# temperature, on a bench at room temperature, for a measurement that runs for
# a minute. Nothing. What it costs is a second MPSL client in the arm of the
# A/B that is supposed to have none.
CONFIG_NRF_802154_TEMPERATURE_UPDATE=n

# The receive callback runs in the driver's own context and does a handful of
# byte loads. Nothing here needs a deep stack.
CONFIG_ISR_STACK_SIZE=2048
```

## rx_ant.conf
```kconfig
# SPDX-License-Identifier: Apache-2.0
#
# THE CONTENDED HALF OF P3.5: 802.15.4 receive with radiant_core taking the
# radio away underneath it.
#
#   west ... -- "-DEXTRA_CONF_FILE=rx_ant.conf"
#
# The other half is the SAME image without this fragment - 802.15.4 alone, no
# ANT, no MPSL contention - and the number P3.5 reports is the DIFFERENCE. A
# single run of the contended build measures the antenna, the channel and the
# distance between two boards on a desk as much as it measures the arbiter.
#
# THE UNCONTENDED HALF IS NOT OPTIONAL AND IS NOT A FORMALITY. docs section
# 7.3a predicts 18-24 % loss. Two boards a metre apart on channel 26 can easily
# lose a percent or two to nothing at all, and a bench that has never measured
# its own floor cannot tell 24 % of arbitration from 22 % of arbitration plus
# 2 % of room. tools/ant_verify.py's `loss (exact)` exists for the same reason
# on the other radio, and this is the same quantity so the two are comparable.

CONFIG_RADIANT_CORE=y
CONFIG_RADIANT_CORE_BACKEND_NRF=y

# The arbiter. Without it radiant_core drives the RADIO directly and nrf_802154
# never gets a look in - the two would simply fight over the peripheral, which
# is not coexistence and is not what section 7.3a models.
CONFIG_RADIANT_CORE_BACKEND_NRF_GATE_MPSL=y

# Two MPSL timeslot users now, not one: the gate holds a session and the
# 802.15.4 driver's RAAL holds another.
CONFIG_MPSL_TIMESLOT_SESSION_COUNT=2

# THE LINE WITHOUT WHICH THIS MEASURES NOTHING, and it is not on by default.
#
# Its own Kconfig help, verbatim: "In dynamic multiprotocol applications, access
# to the radio peripheral must be distributed by an arbiter. To support this
# arbitration in the driver, this option must be enabled. OTHERWISE, THE DRIVER
# ASSUMES THAT ACCESS TO THE RADIO PERIPHERAL IS GRANTED INDEFINITELY."
#
# So without it the 802.15.4 driver does not ask MPSL for anything - it simply
# programs the RADIO whenever it likes, straight over whatever timeslot the gate
# is holding. That is not the coexistence section 7.3a models; it is two drivers
# fighting over one peripheral, and the loss figure it produced would be a
# number about a bug in this configuration rather than about the arbiter.
#
# It CANNOT BE SET HERE. It is promptless, and assigning a promptless symbol in
# a .conf file is a hard Kconfig error rather than a silent drop - which is the
# one merciful thing about it. See COEX154_ARBITRATED in Kconfig, which selects
# it off the gate symbol below.

# The counters section 7.3a's scheduler column is read from.
#
# LEAVE IT ON FOR GATE COUNTERS, TURN IT OFF FOR ANY LOSS NUMBER YOU INTEND TO
# QUOTE. Measured 2026-08-13, both arms back to back on the same boards:
#
#   SWEEP_DEBUG=y, 8 masters spread : loss 27.9 %, drv_assert=7
#   SWEEP_DEBUG=n, 8 masters spread : loss 21.8 %, drv_assert=0
#
# prj.conf sets CONFIG_LOG_MODE_IMMEDIATE=y - it has to, see the note there - so
# every one of these lines is written to the UART synchronously, in whatever
# context produced it, and the gate's dump alone is several hundred bytes at
# 1 Hz. That is enough to push the 802.15.4 driver past MAX_RAMPDOWN_CYCLES in
# wait_until_radio_is_disabled() (nrf_802154_trx.c:380, inlined into
# rxframe_finish()), whose NRF_802154_ASSERT then fires. With the stock __weak
# nrf_802154_assert_handler() that is k_panic(), and the board dies about a
# second after the first ANT master opens - which is exactly what it did before
# src/main.c grew its own non-fatal, counting override.
#
# So: 6 pp of the SWEEP_DEBUG=y loss figure is the instrument, not the arbiter.
# Read drv_assert in every report line; a non-zero value invalidates the
# percentage beside it.
CONFIG_RADIANT_CORE_SWEEP_DEBUG=y
```

## boards/nrf54l15dk_nrf54l15_cpuapp.conf
```kconfig
# SPDX-License-Identifier: Apache-2.0
#
# nRF54L15 DK - single core, the RADIO is right here. The driver runs locally.

CONFIG_NRF_802154_RADIO_DRIVER=y
```

## boards/nrf54l15dk_nrf54l15_cpuapp.overlay
```dts
/*
 * nRF54L15 DK - the P3.5 DUT.
 *
 * Only what radiant's nrf backend needs. This application has no ANT
 * serial transport and no host: it is a frame counter that prints, so uart20's
 * default console is the whole interface.
 *
 * ---------------------------------------------------------------------------
 * THE TIMER COLLISION THE PLAN ASKED TO CHECK BEFORE ANYTHING ELSE, CHECKED
 * ---------------------------------------------------------------------------
 *
 * The multiprotocol plan flags one hardware conflict as the first thing to
 * settle on nRF54L in this branch: the 802.15.4 driver's own timer instance is
 * TIMER10 (nrf_802154_peripherals_nrf54l.h), which is also the instance MPSL
 * hands to timeslot users as MPSL_TIMER0. That is a real third claim on one
 * instance - but it is NOT a claim on this one.
 *
 * radiant takes timer20, and timer20 alone, and it takes it outright
 * rather than through MPSL: the backend runs it at 1 MHz continuously and
 * hardware-captures t_sync into it from RADIO's ADDRESS event, so it cannot be
 * an arbitrated resource even in principle. The two do not overlap, and the
 * plan's TIMER audit can record that as settled for this pairing. What remains
 * arbitrated between the gate and the 15.4 driver is TIMER10 and the RADIO,
 * which is exactly the contention P3.5 is here to measure.
 */

/ {
	chosen {
		radiant,radio-timer = &timer20;
	};
};

&timer20 {
	status = "okay";
};
```

## src/main.c
```c
/*
 * SPDX-License-Identifier: Apache-2.0
 *
 * P3.5 - measures 802.15.4 frame loss caused by ANT blackouts. Stub RX/TX,
 * deliberately not OpenThread: a retrying stack would turn air loss into
 * latency and hide the number being measured. See docs/radiant-bridge.md
 * section 7.3a.
 *
 * Uses nrf_802154 directly rather than Zephyr's ieee802154 driver: the
 * Zephyr driver always routes frames through net_pkt/L2 even in RAW_MODE,
 * one more place to lose a frame for reasons unrelated to the arbiter. The
 * direct API is also what carries MPSL arbitration, via RAAL.
 *
 * Loss is computed over the span the receiver actually saw
 * (last_seq - first_seq + 1), not "expected minus received" - the two
 * boards are never started together, and that difference would land
 * entirely in the reported loss. Matches tools/ant_verify.py's
 * `loss (exact)` for comparability.
 */

#include <zephyr/kernel.h>
#include <zephyr/logging/log.h>
#include <zephyr/sys/printk.h>
#include <string.h>

#include <nrf_802154.h>

LOG_MODULE_REGISTER(coex154, LOG_LEVEL_INF);

/* ---------------------------------------------------------------------------
 * THE 802.15.4 DRIVER'S OWN ASSERT, MADE NON-FATAL AND COUNTED
 * ---------------------------------------------------------------------------
 *
 * Measured on 2026-08-13: with radiant_core opening even one ANT master this
 * image panicked about one second in, every time. Symbolicated, the panic is
 *
 *   NRF_802154_ASSERT(radio_is_disabled)
 *   nrfxlib/nrf_802154/driver/src/nrf_802154_trx.c:380,
 *   in wait_until_radio_is_disabled(), inlined into rxframe_finish() (:1718)
 *
 * i.e. the driver finished receiving a frame, triggered TASKS_DISABLE, spun
 * MAX_RAMPDOWN_CYCLES waiting for RADIO->STATE to read DISABLED, and never saw
 * it - because by then the gate had taken the RADIO for an ANT slot and ramped
 * it back up. That is a real coexistence defect and it is reported as one; it
 * is NOT a property of this application.
 *
 * nrf_802154_assert_handler() is __weak in
 * zephyr/modules/hal_nordic/nrf_802154/nrf_802154_assert_handler.c, whose only
 * body is k_panic(). Overriding it here is the supported hook and it is the
 * difference between "P3.5 cannot be measured at all" and "P3.5 measured, with
 * the driver's invariant violated N times, N printed beside the loss figure".
 *
 * READ drv_assert BEFORE READING loss. A run with drv_assert > 0 is a run in
 * which the 15.4 driver continued past a state check it does not expect to
 * survive; its loss number is a lower bound on a broken configuration, not a
 * clean measurement of arbitration. Do not quote the percentage without it.
 */
static volatile uint32_t drv_assert;

void nrf_802154_assert_handler(void)
{
	drv_assert++;
}

/* ---------------------------------------------------------------------------
 * The frame: a plain 802.15.4-2006 data frame, short addressing, PAN id
 * compressed. Nine bytes of MHR:
 *
 *   [0]     PSDU length, including 2-byte FCS, not including this byte
 *   [1..2]  FCF 0x8841: data, PAN id compression, short dst/src addressing
 *   [3]     MAC sequence number (8-bit, wraps every 256 frames - not what
 *           the loss arithmetic uses; see the 32-bit counter in the payload)
 *   [4..5]  destination PAN id
 *   [6..7]  destination short address
 *   [8..9]  source short address
 *
 * then the payload, then two bytes the radio's CRC engine fills in.
 * ---------------------------------------------------------------------------
 */
#define MHR_LEN     10u
#define FCS_LEN     2u
#define MAGIC       0x52414e54u /* "RANT" */
#define PAYLOAD_MIN 8u          /* magic + counter */

#define PSDU_LEN ((uint8_t)CONFIG_COEX154_PSDU_LEN)

BUILD_ASSERT(CONFIG_COEX154_PSDU_LEN >= (int)(MHR_LEN - 1u + PAYLOAD_MIN + FCS_LEN),
	     "PSDU too short to carry the magic and the counter");
BUILD_ASSERT(CONFIG_COEX154_PSDU_LEN <= 127,
	     "127 is the 802.15.4 maximum PSDU");

#define ADDR_TX 0x1111u
#define ADDR_RX 0x2222u

/* Offset of the payload within the raw buffer (which includes the length byte
 * at [0], so the MHR occupies [0..9]). */
#define PAYLOAD_OFF MHR_LEN

static void frame_build(uint8_t *buf, uint8_t mac_seq, uint32_t counter)
{
	uint32_t i;

	buf[0] = PSDU_LEN;
	buf[1] = 0x41u; /* data frame, PAN id compression */
	buf[2] = 0x88u; /* short dst, short src */
	buf[3] = mac_seq;
	buf[4] = (uint8_t)(CONFIG_COEX154_PAN_ID & 0xffu);
	buf[5] = (uint8_t)((CONFIG_COEX154_PAN_ID >> 8) & 0xffu);
	buf[6] = (uint8_t)(ADDR_RX & 0xffu);
	buf[7] = (uint8_t)(ADDR_RX >> 8);
	buf[8] = (uint8_t)(ADDR_TX & 0xffu);
	buf[9] = (uint8_t)(ADDR_TX >> 8);

	buf[PAYLOAD_OFF + 0u] = (uint8_t)(MAGIC >> 24);
	buf[PAYLOAD_OFF + 1u] = (uint8_t)(MAGIC >> 16);
	buf[PAYLOAD_OFF + 2u] = (uint8_t)(MAGIC >> 8);
	buf[PAYLOAD_OFF + 3u] = (uint8_t)MAGIC;
	buf[PAYLOAD_OFF + 4u] = (uint8_t)(counter >> 24);
	buf[PAYLOAD_OFF + 5u] = (uint8_t)(counter >> 16);
	buf[PAYLOAD_OFF + 6u] = (uint8_t)(counter >> 8);
	buf[PAYLOAD_OFF + 7u] = (uint8_t)counter;

	/* Filler up to the FCS (hardware-written). A fixed pattern rather than
	 * zeroes so a frame truncated mid-air and somehow passing CRC would
	 * still be visible in a dump. */
	for (i = PAYLOAD_OFF + PAYLOAD_MIN; i < (uint32_t)PSDU_LEN + 1u - FCS_LEN;
	     i++) {
		buf[i] = (uint8_t)i;
	}
}

/* Returns false if this is not one of ours. */
static bool frame_counter(const uint8_t *psdu, uint8_t len, uint32_t *out)
{
	uint32_t magic;

	if (len < MHR_LEN - 1u + PAYLOAD_MIN + FCS_LEN) {
		return false;
	}
	/* nrf_802154 hands the buffer back with the length byte at [0], the
	 * same layout transmit_raw takes. */
	magic = ((uint32_t)psdu[PAYLOAD_OFF + 0u] << 24) |
		((uint32_t)psdu[PAYLOAD_OFF + 1u] << 16) |
		((uint32_t)psdu[PAYLOAD_OFF + 2u] << 8) |
		(uint32_t)psdu[PAYLOAD_OFF + 3u];
	if (magic != MAGIC) {
		return false;
	}
	*out = ((uint32_t)psdu[PAYLOAD_OFF + 4u] << 24) |
	       ((uint32_t)psdu[PAYLOAD_OFF + 5u] << 16) |
	       ((uint32_t)psdu[PAYLOAD_OFF + 6u] << 8) |
	       (uint32_t)psdu[PAYLOAD_OFF + 7u];
	return true;
}

/* ---------------------------------------------------------------------------
 * Receiver
 * ---------------------------------------------------------------------------
 */

#if defined(CONFIG_COEX154_ROLE_RX)

static struct {
	uint32_t received;   /* ours, counted */
	uint32_t foreign;    /* on channel, not ours - ambient, and worth seeing */
	uint32_t first_seq;
	uint32_t last_seq;
	bool     have_first;
	/* Largest run of consecutive missing counters. A blackout is a
	 * burst - losses from one ANT slot are adjacent - so mean loss
	 * rate alone can't distinguish "4% spread evenly" (a retrying
	 * stack absorbs it) from "one 300ms hole" (it doesn't). */
	uint32_t worst_gap;
	uint32_t out_of_order;
	/* The PSDU length actually seen on air. CONFIG_COEX154_PSDU_LEN is a
	 * property of the GENERATOR, and the generator is a different image on a
	 * different board - so printing the receiver's own copy of that symbol
	 * would report 127 through an entire 40-byte pass and label the wrong
	 * column of section 7.3a's table. */
	uint8_t  last_len;
	/* Frames the radio started and could not finish. `aborted` is the
	 * subset the driver blames on losing the radio - an ANT blackout seen
	 * from inside 802.15.4, and the only counter here that names the
	 * mechanism rather than the symptom. */
	uint32_t failed;
	uint32_t aborted;
} rx;

/*
 * The driver actually calls the TIMESTAMP callback, not received_raw -
 * getting this wrong means a receiver that initialises cleanly and counts
 * zero frames forever, including zero ambient traffic (the tell).
 * nrf_802154 supplies a default received_raw that forwards to
 * received_timestamp_raw, so defining the wrong one is not a link error.
 * Both are defined here and both funnel into rx_count().
 */
static void rx_count(uint8_t *data)
{
	uint32_t counter;

	if (!frame_counter(data, data[0], &counter)) {
		rx.foreign++;
		nrf_802154_buffer_free_raw(data);
		return;
	}

	rx.last_len = data[0];

	if (!rx.have_first) {
		rx.have_first = true;
		rx.first_seq = counter;
		rx.last_seq = counter;
		rx.received = 1u;
		nrf_802154_buffer_free_raw(data);
		return;
	}

	rx.received++;
	if (counter > rx.last_seq) {
		uint32_t gap = counter - rx.last_seq - 1u;

		if (gap > rx.worst_gap) {
			rx.worst_gap = gap;
		}
		rx.last_seq = counter;
	} else {
		/* The generator numbers monotonically and the radio doesn't
		 * reorder, so this is a duplicate or a corrupt counter that
		 * passed CRC. Counted separately rather than folded into
		 * loss, which it would flatter. */
		rx.out_of_order++;
	}

	nrf_802154_buffer_free_raw(data);
}

void nrf_802154_received_raw(uint8_t *data, int8_t power, uint8_t lqi)
{
	ARG_UNUSED(power);
	ARG_UNUSED(lqi);
	rx_count(data);
}

void nrf_802154_received_timestamp_raw(uint8_t *data, int8_t power, uint8_t lqi,
				       uint64_t time)
{
	ARG_UNUSED(power);
	ARG_UNUSED(lqi);
	ARG_UNUSED(time);
	rx_count(data);
}

void nrf_802154_receive_failed(nrf_802154_rx_error_t error, uint32_t id)
{
	ARG_UNUSED(id);
	rx.failed++;
	if (error == NRF_802154_RX_ERROR_ABORTED) {
		rx.aborted++;
	}
	/* A frame the radio started and couldn't finish. Logged, not counted
	 * into loss - it's the same event as a missing counter seen from the
	 * other side. NRF_802154_RX_ERROR_ABORTED is what an ANT blackout
	 * looks like from inside 802.15.4; seeing it confirms real contention.
	 */
	LOG_DBG("rx failed: %u", (unsigned int)error);
}

static void report(void)
{
	uint32_t sent;
	uint32_t lost;
	uint32_t ppm;

	if (!rx.have_first) {
		LOG_INF("P3.5 rx: nothing heard yet (foreign=%u rxfail=%u "
			"drv_assert=%u)", rx.foreign, rx.failed, drv_assert);
		return;
	}

	sent = rx.last_seq - rx.first_seq + 1u;
	lost = (sent > rx.received) ? (sent - rx.received) : 0u;
	/* Parts per million, printed as a percentage with three decimals.
	 * Integer arithmetic - a float here would pull in a formatter this
	 * image has no other use for. */
	ppm = (sent > 0u) ? (uint32_t)(((uint64_t)lost * 1000000u) / sent) : 0u;

	LOG_INF("P3.5 rx: span=%u recv=%u lost=%u loss=%u.%03u %% | "
		"worst_gap=%u dup=%u foreign=%u | rxfail=%u abort=%u "
		"drv_assert=%u | psdu=%u ch=%u",
		sent, rx.received, lost, ppm / 10000u, (ppm % 10000u) / 10u,
		rx.worst_gap, rx.out_of_order, rx.foreign,
		rx.failed, rx.aborted, drv_assert,
		(unsigned int)rx.last_len, (unsigned int)CONFIG_COEX154_CHANNEL);
}

/* ---------------------------------------------------------------------------
 * The ANT load - the thing that takes the radio away
 * ---------------------------------------------------------------------------
 */

#if defined(CONFIG_RADIANT_CORE)

#include "ant_radio.h"
#include "ant_wire.h"

/*
 * Device profile numbers are irrelevant - nothing decodes these frames.
 * What matters is the shape of the demand: one transmit slot per channel
 * per period, at a real ANT+ sensor's period, so the blackout cadence the
 * receiver sees matches what 7.3a's arithmetic is written against.
 *
 * 8070 counts @ 32768 Hz = 246.3 ms, the ANT+ HR period and the slowest
 * common profile - the conservative choice, since a faster profile would
 * blank the radio out more and inflate the loss figure.
 */
#define ANT_PERIOD    8070u
#define ANT_FREQ      57u   /* 2457 MHz, the ANT+ channel */
#define ANT_DEV_TYPE  0x78u
#define ANT_TRANS     1u

/*
 * Guarded divisor. CONFIG_COEX154_ANT_MASTERS is legitimately 0 in the
 * arbiter-only arm, and the offset expression below divides by it - a
 * compile-time division by zero is a hard error even on a branch that never
 * runs, because the constant is folded before the branch is discarded.
 */
#define ANT_N       ((unsigned int)CONFIG_COEX154_ANT_MASTERS)
#define ANT_N_DIV   (ANT_N > 0u ? ANT_N : 1u)

static void ant_load_start(void)
{
	static const uint8_t net_key[8] = {
		/* All-zero: nothing receives these frames, so the real ANT+
		 * network key isn't needed and this file stays free of one it
		 * has no right to. */
		0, 0, 0, 0, 0, 0, 0, 0
	};
	uint8_t ch;

	if (antr_init() != 0) {
		LOG_ERR("antr_init failed - no ANT load, this is NOT the "
			"contended build any more");
		return;
	}
	(void)antr_network_address_set(0u, net_key);

	/*
	 * THE ARBITER-ONLY ARM, and it stops here on purpose. radiant_core is
	 * linked, initialised and holding its MPSL session; no channel is open,
	 * so it asks MPSL for no air at all. That is the arm that separates "an
	 * arbiter is present" from "air was taken away" - and it only means that
	 * if antr_init() above has actually run, which is why the zero case is
	 * inside this function rather than compiled out around it.
	 */
	if (ANT_N == 0u) {
		LOG_INF("ANT load: none - radiant_core is up but owns no "
			"channel. ARBITER-ONLY arm.");
		return;
	}

	for (ch = 0u; ch < (uint8_t)ANT_N; ch++) {
		antr_err_t rc;

		/* MASTER_TX_ONLY, not MASTER: a bidirectional master opens a
		 * receive window after each slot that nothing will reply to,
		 * which this measurement would misattribute to the transmit
		 * blackout. */
		rc = antr_channel_assign(ch, ANTW_CHANNEL_TYPE_MASTER_TX_ONLY,
					 0u, 0u);
		if (rc != 0) {
			LOG_ERR("ch%u assign: %u", ch, (unsigned int)rc);
			return;
		}
		(void)antr_channel_id_set(ch, (uint16_t)(0x7000u + ch),
					  ANT_DEV_TYPE, ANT_TRANS);
		(void)antr_channel_period_set(ch, ANT_PERIOD);
		(void)antr_channel_radio_freq_set(ch, ANT_FREQ);

		/*
		 * Offsets are spread across the period rather than all zero.
		 * With no offset all masters bunch into a few ms of blackout
		 * followed by ~240 ms clear air - a real but worst-case shape.
		 * 7.3a's arithmetic assumes loss spread over the period, so
		 * spreading offsets is what actually measures that prediction;
		 * the bunched case is a separate run (set every offset to
		 * zero).
		 */
#if defined(CONFIG_COEX154_ANT_BUNCHED)
		(void)antr_channel_open_with_offset(ch, 0u);
#else
		(void)antr_channel_open_with_offset(
			ch, (uint16_t)((ANT_PERIOD / ANT_N_DIV) * ch));
#endif
	}

	LOG_INF("ANT load: %u masters at %u ms, freq 24%02u MHz, offsets %s",
		ANT_N, (unsigned int)((ANT_PERIOD * 1000u) / 32768u),
		(unsigned int)ANT_FREQ,
		IS_ENABLED(CONFIG_COEX154_ANT_BUNCHED) ? "BUNCHED (all zero)"
						       : "spread");
}

/*
 * radiant_core delivers events through antr_on_message(), the same seam the
 * USB bridge uses. Refill the payload on EVENT_TX, or the channel silently
 * repeats the last one - fine for a blackout generator but would hide a
 * channel that has actually stopped.
 */
void antr_on_message(const struct antr_msg *msg)
{
	static uint32_t tx_events;
	uint8_t payload[8];

	if (msg == NULL || msg->data == NULL) {
		return;
	}
	if (msg->id != ANTW_MESG_RESPONSE_EVENT_ID || msg->len < 3u) {
		return;
	}
	if (msg->data[2] != ANTW_EVENT_TX) {
		return;
	}

	tx_events++;
	memset(payload, 0, sizeof(payload));
	payload[0] = msg->data[0];            /* which channel */
	payload[7] = (uint8_t)tx_events;      /* something that changes */
	(void)antr_broadcast_message_tx(msg->data[0], sizeof(payload), payload);
}

#else

static void ant_load_start(void)
{
	LOG_INF("ANT load: none - radiant_core is not even linked. BENCH FLOOR "
		"arm: this is the room, the antennas and the two boards, with "
		"no arbiter in the image at all.");
}

#endif /* CONFIG_RADIANT_CORE */

static void role_run(void)
{
	ant_load_start();

	nrf_802154_promiscuous_set(true);
	nrf_802154_auto_ack_set(false);
	if (!nrf_802154_receive()) {
		LOG_ERR("nrf_802154_receive() refused");
		return;
	}

	LOG_INF("P3.5 receiver up: channel %u, PSDU %u bytes",
		(unsigned int)CONFIG_COEX154_CHANNEL, (unsigned int)PSDU_LEN);

	for (;;) {
		k_sleep(K_SECONDS(CONFIG_COEX154_REPORT_S));
		report();
	}
}

#else /* CONFIG_COEX154_ROLE_TX */

/* ---------------------------------------------------------------------------
 * Transmitter
 * ---------------------------------------------------------------------------
 */

static uint8_t  tx_buf[128];
static uint32_t tx_sent;
static K_SEM_DEFINE(tx_done, 0, 1);

void nrf_802154_transmitted_raw(uint8_t *frame, const nrf_802154_transmit_done_metadata_t *meta)
{
	ARG_UNUSED(frame);
	ARG_UNUSED(meta);
	tx_sent++;
	k_sem_give(&tx_done);
}

static uint32_t tx_cb_failed;   /* the driver said no, asynchronously */
static uint32_t tx_refused;     /* transmit_raw() said no, synchronously */
static uint8_t  tx_last_error;

void nrf_802154_transmit_failed(uint8_t *frame, nrf_802154_tx_error_t error,
				const nrf_802154_transmit_done_metadata_t *meta)
{
	ARG_UNUSED(frame);
	ARG_UNUSED(meta);
	/*
	 * Kept separate from the synchronous refusal counter (tx_refused):
	 * sharing one counter produced offered=2000 sent=1999 failed=2000 -
	 * every frame apparently both succeeding and failing. Same class of
	 * bug as the gate's `deny` counter conflating EDENIED with
	 * STATUS_DENIED.
	 */
	tx_cb_failed++;
	tx_last_error = (uint8_t)error;
	k_sem_give(&tx_done);
}

static void role_run(void)
{
	nrf_802154_transmit_metadata_t meta = {
		/*
		 * CCA off is the measurement, not a shortcut: with CCA on the
		 * generator would defer around the DUT's ANT slot, turning
		 * receiver-side loss into transmitter-side deferral (reading
		 * lower - the wrong direction). A real stack's deferral is a
		 * genuine cost, but it's the scheduler cost (7.3a), separate
		 * from the air cost measured here.
		 */
		.cca = false,
		.tx_power = { .use_metadata_value = false },
		.tx_channel = { .use_metadata_value = false },
	};
	uint32_t counter = 0u;
	uint8_t  mac_seq = 0u;

	/*
	 * The driver must leave SLEEP before it accepts a transmit -
	 * nrf_802154_init() leaves it there, and transmit_raw() from SLEEP is
	 * refused synchronously with no callback. Calling receive() first
	 * puts it in a transmit-capable state at no cost, since nothing is
	 * addressed to this role.
	 */
	if (!nrf_802154_receive()) {
		LOG_ERR("nrf_802154_receive() refused - the driver is not in a "
			"state that will transmit either");
	}

	LOG_INF("P3.5 generator up: channel %u, PSDU %u bytes, every %u ms",
		(unsigned int)CONFIG_COEX154_CHANNEL, (unsigned int)PSDU_LEN,
		(unsigned int)CONFIG_COEX154_TX_INTERVAL_MS);

	for (;;) {
		frame_build(tx_buf, mac_seq++, counter);

		/*
		 * transmit_raw() returns nrf_802154_tx_error_t where NONE == 0,
		 * so `if (transmit_raw(...))` would be inverted - unlike
		 * nrf_802154_receive() above, which returns a plain bool.
		 * Symptom of getting this wrong: offered=2000 sent=1998
		 * refused=1999, every frame apparently both transmitted and
		 * refused. Compare explicitly against NRF_802154_TX_ERROR_NONE.
		 */
		if (nrf_802154_transmit_raw(tx_buf, &meta) ==
		    NRF_802154_TX_ERROR_NONE) {
			/* Wait for the terminal callback rather than firing
			 * blind: the buffer is the radio's until it comes
			 * back, and overwriting it mid-air would corrupt the
			 * very counter the receiver is reading. */
			(void)k_sem_take(&tx_done, K_MSEC(200));
		} else {
			tx_refused++;
		}
		counter++;

		if ((counter % 500u) == 0u) {
			LOG_INF("P3.5 tx: offered=%u sent=%u cb_failed=%u "
				"refused=%u last_err=%u",
				counter, tx_sent, tx_cb_failed, tx_refused,
				(unsigned int)tx_last_error);
		}
		if (CONFIG_COEX154_TX_COUNT != 0 &&
		    counter >= (uint32_t)CONFIG_COEX154_TX_COUNT) {
			LOG_INF("P3.5 tx: done, offered=%u sent=%u cb_failed=%u "
				"refused=%u", counter, tx_sent, tx_cb_failed,
				tx_refused);
			return;
		}
		k_sleep(K_MSEC(CONFIG_COEX154_TX_INTERVAL_MS));
	}
}

#endif

/* ---------------------------------------------------------------------------
 * Callbacks the driver requires a definition for whichever role is built.
 * nrf_802154 declares these as plain functions, not weak symbols with a
 * default, so a missing one is a link error and an unused one is dead code
 * rather than a mistake.
 * ---------------------------------------------------------------------------
 */

#if defined(CONFIG_COEX154_ROLE_RX)
void nrf_802154_transmitted_raw(uint8_t *frame, const nrf_802154_transmit_done_metadata_t *meta)
{
	ARG_UNUSED(frame);
	ARG_UNUSED(meta);
}

void nrf_802154_transmit_failed(uint8_t *frame, nrf_802154_tx_error_t error,
				const nrf_802154_transmit_done_metadata_t *meta)
{
	ARG_UNUSED(frame);
	ARG_UNUSED(error);
	ARG_UNUSED(meta);
}
#else
void nrf_802154_received_raw(uint8_t *data, int8_t power, uint8_t lqi)
{
	ARG_UNUSED(power);
	ARG_UNUSED(lqi);
	nrf_802154_buffer_free_raw(data);
}

void nrf_802154_received_timestamp_raw(uint8_t *data, int8_t power, uint8_t lqi,
				       uint64_t time)
{
	ARG_UNUSED(power);
	ARG_UNUSED(lqi);
	ARG_UNUSED(time);
	nrf_802154_buffer_free_raw(data);
}

void nrf_802154_receive_failed(nrf_802154_rx_error_t error, uint32_t id)
{
	ARG_UNUSED(error);
	ARG_UNUSED(id);
}
#endif

#if defined(CONFIG_NRF_802154_SERIALIZATION)
#include <serialization/nrf_802154_serialization_error.h>

/*
 * Required only on the serialised build - the Spinel host calls this when
 * the IPC link to the network core fails, and it's `extern` with no
 * default, so leaving it out is a link error. The in-tree default lives in
 * Zephyr's ieee802154_nrf5 driver, which this app doesn't use.
 *
 * Must log loudly: this is the traffic generator, so a silent
 * serialisation failure would land in the loss column and be misread as an
 * ANT blackout. See boards/nrf5340dk_nrf5340_cpuapp.conf.
 */
void nrf_802154_serialization_error(const nrf_802154_ser_err_data_t *p_err)
{
	LOG_ERR("802.15.4 SERIALISATION ERROR %d - the generator is not a "
		"reference any more; discard this run",
		(int)(p_err != NULL ? p_err->reason : 0));
}
#endif

void nrf_802154_cca_done(bool channel_free)
{
	ARG_UNUSED(channel_free);
}

void nrf_802154_cca_failed(nrf_802154_cca_error_t error)
{
	ARG_UNUSED(error);
}

void nrf_802154_energy_detected(const nrf_802154_energy_detected_t *result)
{
	ARG_UNUSED(result);
}

void nrf_802154_energy_detection_failed(nrf_802154_ed_error_t error)
{
	ARG_UNUSED(error);
}

void nrf_802154_tx_ack_started(const uint8_t *data)
{
	ARG_UNUSED(data);
}

int main(void)
{
	static const uint8_t ext_addr_rx[8] = { 8, 7, 6, 5, 4, 3, 2, 1 };
	static const uint8_t ext_addr_tx[8] = { 1, 2, 3, 4, 5, 6, 7, 8 };
	uint8_t short_addr[2];

	/* printk, synchronously, before anything that can hang. The one thing
	 * worse than a board that prints nothing is not knowing whether it
	 * reached main() at all. */
	printk("coex154: main(), calling nrf_802154_init()\n");
	nrf_802154_init();
	printk("coex154: nrf_802154_init() returned\n");
	nrf_802154_channel_set(CONFIG_COEX154_CHANNEL);
	nrf_802154_pan_id_set((const uint8_t[]){
		(uint8_t)(CONFIG_COEX154_PAN_ID & 0xffu),
		(uint8_t)((CONFIG_COEX154_PAN_ID >> 8) & 0xffu) });

#if defined(CONFIG_COEX154_ROLE_RX)
	short_addr[0] = (uint8_t)(ADDR_RX & 0xffu);
	short_addr[1] = (uint8_t)(ADDR_RX >> 8);
	nrf_802154_extended_address_set(ext_addr_rx);
#else
	short_addr[0] = (uint8_t)(ADDR_TX & 0xffu);
	short_addr[1] = (uint8_t)(ADDR_TX >> 8);
	nrf_802154_extended_address_set(ext_addr_tx);
#endif
	ARG_UNUSED(ext_addr_rx);
	ARG_UNUSED(ext_addr_tx);
	nrf_802154_short_address_set(short_addr);

	role_run();
	return 0;
}
```
